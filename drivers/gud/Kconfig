## drivers/media/platform/exynos/fimc-is2/vendor/mcd/Kconfig
```kconfig
config CAMERA_EEPROM_SUPPORT_REAR
        bool "Enable eeprom for rear cam"
        depends on VENDER_MCD
        default n
        help
          Enable eeprom for rear cam.
config CAMERA_EEPROM_SUPPORT_FRONT
        bool "Enable eeprom for front cam"
        depends on VENDER_MCD
        default n
        help
          Enable eeprom for front cam.
config COMPANION_USE
        bool "Use companion"
        depends on VENDER_MCD
        default n
        help
          Use companion.
 config COMPANION_C1_USE
        bool "Use companion C1"
        depends on VENDER_MCD
        default n
        help
          Use companion C1.
 config COMPANION_C2_USE
        bool "Use companion C2"
        depends on VENDER_MCD
        default n
        help
          Use companion C2.
 config COMPANION_C3_USE
        bool "Use companion C3"
        depends on VENDER_MCD
        default n
        help
          Use companion C3.
 config COMPANION_DIRECT_USE
        bool "Use direct control for companion"
        depends on VENDER_MCD
        depends on COMPANION_USE
        depends on USE_DIRECT_IS_CONTROL
        default n
        help
          Use device companion direct control.
 config COMPANION_C2_DIRECT_USE
        bool "Use direct control for companion C2"
        depends on VENDER_MCD
        depends on COMPANION_C2_USE
        depends on COMPANION_DIRECT_USE
        default n
        help
          Use device companion C2.
 config COMPANION_C3_DIRECT_USE
        bool "Use direct control for companion C3"
        depends on VENDER_MCD
        depends on COMPANION_C3_USE
        depends on COMPANION_DIRECT_USE
        default n
        help
          Use device companion C3.
config COMPANION_DCDC_USE
        bool "Use companion DCDC regulator"
        depends on VENDER_MCD
        default n
        help
          Use companion DCDC regulator.
config PREPROCESSOR_STANDBY_USE
        bool "Use companion standby"
        depends on VENDER_MCD
        default n
        help
          Use companion standby.
config SENSOR_RETENTION_USE
	bool "Use sensor retention"
	depends on VENDER_MCD
	default n
	help
	  Use sensor retention.
config OIS_USE
        bool "Use ois"
        depends on VENDER_MCD
        default n
        help
          Use ois.
config OIS_FW_UPDATE_THREAD_USE
        bool "Enable ois fw update thread"
        depends on OIS_USE
        default n
        help
          Enable ois fw update thread.
config AF_HOST_CONTROL
        bool "Enable host af control"
        depends on VENDER_MCD
        default n
        help
          Enable host af control.
config TORCH_CURRENT_CHANGE_SUPPORT
        bool "Change torch current in recording mode"
        depends on VENDER_MCD
        default n
        help
          Change torch current in recording mode.
config CAMERA_HERO
        bool "This camera is hero project"
        depends on VENDER_MCD
        default n
        help
          This camera is hero project.
config CAMERA_VJFLTE
        bool "This camera is vjflte project"
        depends on VENDER_MCD
        default n
        help
          This camera is vjflte project.
config CAMERA_DREAM
        bool "This camera is dream project"
        depends on VENDER_MCD
        default n
        help
          This camera is hero project.
config CAMERA_DREAM2
        bool "This camera is dream2 project"
        depends on VENDER_MCD
        default n
        help
          This camera is hero project.
config CAMERA_HERO2DREAM2
        bool "This camera is hero2dream2 project"
        depends on VENDER_MCD
        default n
        help
          This camera is hero2dream2 project.
config CAMERA_BAIKAL
        bool "This camera is baikal project"
        depends on VENDER_MCD
        default n
        help
          This camera is baikal project.
config CAMERA_GREAT
        bool "This camera is great project"
        depends on VENDER_MCD
        default n
        help
          This camera is great project.
config CAMERA_VALLEY
        bool "This camera is valley project"
        depends on VENDER_MCD
        default n
        help
          This camera is great project.
config OIS_USE_RUMBA_S4
        bool "Use RUMBA S4 ois driver IC"
        depends on OIS_USE
        default n
        help
          Use RUMBA S4 ois driver IC.		  
config OIS_USE_RUMBA_S6
        bool "Use RUMBA S6 ois driver IC"
        depends on OIS_USE
        default n
        help
          Use RUMBA S6 ois driver IC.
config COMPANION_FACTORY_VALIDATION
        bool "Use factory validation for companion ic"
        depends on COMPANION_USE
        default n
        help
          Use factory validation for companion ic.          
config SECURE_CAMERA_USE
        bool "Use secure camera"
        depends on VENDER_MCD
        default n
        help
          Use secure camera.
config USE_SIGNED_BINARY
        bool "Enable signed binary processing."
        depends on VENDER_MCD
        default n
        help
          Enable signed binary processing.
```

## drivers/media/platform/exynos/fimc-is2/vendor/psv/Kconfig
```kconfig
config PSV_SFR_VERIFICATION
        bool "|-> Enable SFR verfication feature"
        depends on VENDER_PSV
        default n

config PSV_VECTOR_VERIFICATION
		bool "|-> Enable vector verfication feature"
		depends on VENDER_PSV
		default n

config PSV_ASB
		bool "|-> Enable ASB feature"
		depends on VENDER_PSV
		default n
```

## drivers/media/platform/exynos/g2d1shot/Kconfig
```kconfig
#
# Copyright (c) 2015 Samsung Electronics Co., Ltd.
#		http://www.samsung.com/
#
# Licensed under GPLv2

config VIDEO_EXYNOS_G2D1SHOT
prompt "G2D m2m1shot2 version"
	bool
	select MEDIA_M2M1SHOT2
```

## drivers/media/platform/exynos/mfc/Kconfig
```kconfig
config VIDEO_EXYNOS_MFC
	bool "Exynos MFC Driver"
	default n
	depends on VIDEO_EXYNOS
	select VIDEOBUF2_CORE
	select EXYNOS_MFC_V11
	---help---
	  MFC driver for V4L2.

choice
depends on VIDEO_EXYNOS_MFC
prompt "MFC version"
default EXYNOS_MFC_V11
config EXYNOS_MFC_V11
prompt "MFC version 11"
	bool
	depends on ARCH_EXYNOS8
endchoice
```

## drivers/media/usb/dl1750/Kconfig
```kconfig
config SEC_DL1750
	bool "DL1750 drv"
	default n
	---help---
	  Add dl1750 driver.
```

## drivers/misc/five_tee_driver/Kconfig
```kconfig
#
# TEE Driver configuration
#

config FIVE_TEE_DRIVER
    bool "Integrity TEE Driver"
    depends on FIVE && TRUSTONIC_TEE && FIRMWARE_IN_KERNEL
    default y
    ---help---
      Enable Integrity Trusted Execution Environment support

config TEE_DRIVER_DEBUG
    bool "Integrity TEE Driver Debug mode"
    depends on FIVE_TEE_DRIVER
    default n
    ---help---
      Enable Debug mode in TEE Driver

config FIVE_TRUSTLET_PATH
    string "FIVE trustlet"
    depends on FIVE_TEE_DRIVER
    default "five/ffffffff000000000000000000000072.tlbin"
    ---help---
      This option defines FIVE trustlet path which will be built-in kernel
```

## drivers/misc/modem_if/Kconfig
```kconfig
comment "Samsung Modem Interface Driver for Memory-type Interface"
menuconfig SEC_MODEM_IF
	bool "Samsung Mobile Modem Interface"
	default n
	---help---
	  Samsung Modem Interface Driver.

config LTE_MODEM_CMC221
	bool "modem chip : SEC CMC221"
	depends on SEC_MODEM_IF
	default n

config UMTS_MODEM_SS222
	bool "modem chip : SEC SS222"
	depends on SEC_MODEM_IF
	default n

config LTE_MODEM_S5E4270
	bool "modem chip : LSI S5E4270(onechip)"
	depends on SEC_MODEM_IF
	default n

config LTE_MODEM_S5E7580
	bool "modem chip : LSI S5E7580(onechip)"
	depends on SEC_MODEM_IF
	default n

config LTE_MODEM_S5E7890
	bool "modem chip : LSI S5E7890(onechip)"
	depends on SEC_MODEM_IF
	default n

config LTE_MODEM_S5E8890
	bool "modem chip : LSI S5E8890(onechip)"
	depends on SEC_MODEM_IF
	default n

config LTE_MODEM_S5E7880
	bool "modem chip : LSI S5E7880(onechip)"
	depends on SEC_MODEM_IF
	default n

config LTE_MODEM_S5E7570
	bool "modem chip : LSI S5E7570(onechip)"
	depends on SEC_MODEM_IF
	default n

config LTE_MODEM_S5E8895
	bool "modem chip : LSI S5E8895(onechip)"
	depends on SEC_MODEM_IF
	default n

config LTE_MODEM_S5E9810
	bool "modem chip : LSI S5E9810(onechip)"
	depends on SEC_MODEM_IF
	default n

config LTE_MODEM_S5E7872
	bool "modem chip : LSI S5E7872(onechip)"
	depends on SEC_MODEM_IF
	default n

config LINK_DEVICE_SHMEM
	bool "modem driver link device shared memory"
	depends on SEC_MODEM_IF
	default y

config CP_SECURE_BOOT
	bool "Support CP Secure Boot"
	default n

config DEBUG_MODEM_IF
	bool "enable modem if debug option"
	depends on SEC_MODEM_IF
	default n

config WORKQUEUE_FRONT
	bool "IPC: SPI workqueue front"
	depends on SEC_MODEM_IF
	default n

config SIM_DETECT
	bool "SIM_DETECT pin"
	depends on SEC_MODEM_IF
	default n

config SIM_SLOT_SWITCH
	bool "SIM_SLOT_SWITCH"
	depends on SEC_MODEM_IF
	default n
```

## drivers/motor/Kconfig
```kconfig
config MOTOR_DRV_MAX77854
	tristate "Maxim MAX77854 motor"
	default n
	depends on (MFD_MAX77854 && ANDROID_TIMED_OUTPUT)
	help
	  If you say yes here you will get support for the
	  motor of Maxim MAX77854 PMIC.

config MOTOR_DRV_MAX77865
	tristate "Maxim MAX77854 motor"
	default n
	depends on (MFD_MAX77865 && ANDROID_TIMED_OUTPUT)
	help
	  If you say yes here you will get support for the
	  motor of Maxim MAX77865 PMIC.
	  
config MOTOR_DRV2624
	tristate "motor"
	default n
	help
	  Say Y to enable MOTOR DRV2624.
```

## drivers/mpsd/Kconfig
```kconfig
menu "MPSD System Intelligence kernel module"

config MPSD
	bool "Samsung Electronics Co. Ltd. MPSD driver"
	help
	  Kernel module to interact with the kernel drivers from
	  user land to initiate the QoS dialog and get feedback
	  about the current kernel configuration of different performance
	  centric modules.

config MPSD_DEBUG
	bool "Samsung Electronics Co. Ltd. MPSD driver debugger"
	help
	  MPSD debugger for verification of the functionalities.
	  use /sys/mpsd interface
	  enable only during engineer build to avoid overhead

endmenu
```
