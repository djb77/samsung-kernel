## drivers/gud/Kconfig
```kconfig
#
# Mobicore Configuration
#

if SOC_EXYNOS8895
source "drivers/gud/gud-exynos8895_kinibi400/Kconfig"
endif
```

## drivers/input/keyboard/cypress/Kconfig
```kconfig
#
# Cypress touchkey configuration
#

config KEYBOARD_CYPRESS_TOUCH_20075
	tristate "Cypress touchkey support"
	help
	  Say Y here to enable the cypress touchkey.

	  To compile this driver as a module, choose M here.
	  
config KEYBOARD_CYPRESS_TOUCH_MBR31X5
	tristate "Cypress touchkey support"
	help
	  Say Y here to enable the cypress touchkey.

	  To compile this driver as a module, choose M here.
```

## drivers/input/keyboard/melfas_mip4/Kconfig
```kconfig
#
# Kconfig for MELFAS MIP4 Touchkey Driver
#

if INPUT_KEYBOARD

config KEYBOARD_MELFAS_MHS204
        tristate "MELFAS MHS204 Touchkey"
        depends on I2C
        help
          Say Y here if you have a MELFAS MHS204 Touchkey device in your system.

          If unsure, say N.

          To compile this driver as a module, choose M here: the module will be called mip4_tk.
          
endif
```

## drivers/input/touchscreen/himax/Kconfig
```kconfig
#
# Touchscreen driver configuration
#

config TOUCHSCREEN_HIMAX_I2C
        tristate "HIMAX 83100 incell serious i2c touchscreen"
		depends on I2C
		help
		This enables support for HIMAX 83100 over I2C based touchscreens.

config TOUCHSCREEN_HIMAX_DEBUG
        tristate "HIMAX debug function"
		depends on TOUCHSCREEN_HIMAX_I2C
		help
		This enables support for HIMAX debug function.
```

## drivers/input/touchscreen/imagis_30xxc/Kconfig
```kconfig
#
# Imagis IST30XXC Touchscreen driver
#

config TOUCHSCREEN_IST30XXC
  tristate "IST30XXC I2C Touchscreen"
	depends on I2C
	help
	  Say Y here if you have the Imagis IST30XXC I2C touchscreen
	  connected to your system.

config TOUCHSCREEN_IST3026C
  tristate "IST3026C I2C Touchscreen"
	depends on I2C
	help
	  Say Y here if you have the Imagis IST3026C I2C touchscreen
	  connected to your system.

config TOUCHSCREEN_IST3032C
  tristate "IST3032C I2C Touchscreen"
	depends on I2C
	help
	  Say Y here if you have the Imagis IST3032C I2C touchscreen
	  connected to your system.

config TOUCHSCREEN_IST3038C
  tristate "IST3038C I2C Touchscreen"
	depends on I2C
	help
	  Say Y here if you have the Imagis IST3038C I2C touchscreen
	  connected to your system.

config TOUCHSCREEN_IST3044C
  tristate "IST3044C I2C Touchscreen"
	depends on I2C
	help
	  Say Y here if you have the Imagis IST3044C I2C touchscreen
	  connected to your system.

config TOUCHSCREEN_IST3048C
  tristate "IST3048C I2C Touchscreen"
	depends on I2C
	help
	  Say Y here if you have the Imagis IST3048C I2C touchscreen
	  connected to your system.
```

## drivers/input/touchscreen/imagis_30xxh/Kconfig
```kconfig
#
# Imagis IST30XXH Touchscreen driver
#

config TOUCHSCREEN_IST30XXH
  tristate "IST30XXH I2C Touchscreen"
	depends on I2C
	help
	  Say Y here if you have the Imagis IST30XXH I2C touchscreen
	  connected to your system.

config TOUCHSCREEN_IST3038H
  tristate "IST3038H I2C Touchscreen"
	depends on I2C
	help
	  Say Y here if you have the Imagis IST3038H I2C touchscreen
	  connected to your system.

config TOUCHSCREEN_IMAGIS_LPM_NO_RESET
  tristate "TOUCHSCREEN IMAGIS LPM NO RESET"
	depends on I2C
	help
	  Say Y here if you use
	  LPM No Reset Sequence.
```

## drivers/input/touchscreen/melfas/Kconfig
```kconfig
#
# Kconfig for MELFAS MMS400 Touchscreen driver
#

if INPUT_TOUCHSCREEN

config TOUCHSCREEN_MELFAS_MMS449
        tristate "MELFAS Touchscreen"
        depends on I2C
        help
          Say Y here if you have a MELFAS touchscreen device in your system.

          If unsure, say N.

          To compile this driver as a module, choose M here: the module will be called mms_ts.

config TOUCHSCREEN_MELFAS_MMS438
        tristate "MELFAS Touchscreen"
        depends on I2C
        help
          Say Y here if you have a MELFAS touchscreen device in your system.

          If unsure, say N.

          To compile this driver as a module, choose M here: the module will be called mms_ts.

config TOUCHSCREEN_DUMP_MODE
        tristate "TSP dump mode"
        depends on I2C

endif
```

## drivers/input/touchscreen/zinitix/Kconfig
```kconfig
#
# Zinitix Touchscreen driver configuration
#

config TOUCHSCREEN_ZINITIX_ZT75XX_TCLM
	bool "ZINITIX ZT75XX touchscreen driver"
	depends on I2C
	default n
	help
	  Say Y here if you have a ZINITIX ZT75XX touchscreen.
	  If unsure, say N.
```

## drivers/input/wacom/Kconfig
```kconfig
#
# Wacom configuration
#

config INPUT_WACOM
	tristate "Wacom penabled i2c touchscreen"
	depends on I2C
	help
	  Say Y here if you have an Wacom penabled i2c touchscreen
	  connected to your system.

	  If unsure, say N.

	  To compile this driver as a module, choose M here: the
	  module will be called wacom_GXXX.

config EPEN_WACOM_W9018
	tristate "Wacom W9018 penabled i2c touchscreen"
	depends on I2C
	help
	  Say Y here if you have an Wacom G10PM penabled i2c touchscreen
	  connected to your system.

	  If unsure, say N.

	  To compile this driver as a module, choose M here: the
	  module will be called wacom_W9018.

config WACOM_LCD_FREQ_COMPENSATE
	bool "Wacom LCD vsync/hsync frequency compensate rotuine"
	help
	  Say Y here if you have an Wacom lcd freq compensate config

	  If unsure, say N.

	  To compile this driver as a module, choose M here: the
	  module will be called wacom.
```

## drivers/media/platform/exynos/astc/Kconfig
```kconfig
#
# Exynos multimedia device drivers
#
config VIDEO_EXYNOS_ASTC
        bool "Exynos ASTC encoder driver"
        depends on ARCH_EXYNOS
        select CONFIG_VIDEO_EXYNOS_ASTC
        default n
        help
          This is a representative exynos astc device.
```

## drivers/media/platform/exynos/camera-pp/Kconfig
```kconfig
#
# Exynos Camera PostProcessing IP device drivers
#
config VIDEO_EXYNOS_CAMREA_POSTPROCESS
		bool "Exynos Camera PostProcessing Devices"
		depends on VIDEO_EXYNOS
		select V4L2_MEM2MEM_DEV
		select MEDIA_M2M1SHOT
		select VIDEOBUF2_ION
		default n
		help
			This is a representative exynos Camera PostProcessing device.

	source "drivers/media/platform/exynos/camera-pp/gdc/Kconfig"
```

## drivers/media/platform/exynos/camera-pp/gdc/Kconfig
```kconfig
menuconfig VIDEO_EXYNOS_CAMREA_POSTPROCESS_GDC
	bool "EXYNOS CAMERA POSTPROCESS GDC Driver"
	depends on VIDEO_EXYNOS_CAMREA_POSTPROCESS
	default y
	help
		This is a representative exynos CAMERA-PP GDC device.

config CAMERA_PP_GDC_V1_0_0_OBJ
	bool "use GDC v1.0"
	depends on VIDEO_EXYNOS_CAMREA_POSTPROCESS_GDC
	default n
	help
		Use to build v1.0 driver

config CAMERA_PP_GDC_V2_0_0_OBJ
	bool "use GDC v2.0"
	depends on VIDEO_EXYNOS_CAMREA_POSTPROCESS_GDC
	default n
	help
		Use to build v2.0 driver
```

## drivers/media/platform/exynos/fimc-is2/hardware/api/Kconfig
```kconfig
config USE_HW_API_COMMON
	bool "Use HW API Common library"
	depends on EXYNOS_FIMC_IS_HARDWARE
	default y
	help
	  Enalbe HW API Common library.

config USE_HOST_FD_LIBRARY
	bool "Use FD library in host"
	depends on EXYNOS_FIMC_IS_HARDWARE
	default n
	help
	  Enalbe SW FD library in host.
```

## drivers/media/platform/exynos/fimc-is2/sensor/module_framework/cis/Kconfig
```kconfig
menuconfig CAMERA_CIS_SELECT
	bool "Sensor cis select"
	depends on USE_DIRECT_IS_CONTROL
	help
	  Say Y here to enable support for platform-specific V4L drivers.

config CAMERA_CIS_6B2_OBJ
        bool "Use 6B2 camera cis"
	depends on USE_DIRECT_IS_CONTROL
	depends on CAMERA_CIS_SELECT
        default n
        help
          Use to build 6B2 camera sensor.

config CAMERA_CIS_5E2_OBJ
        bool "Use 5E2 camera cis"
	depends on USE_DIRECT_IS_CONTROL
	depends on CAMERA_CIS_SELECT
        default n
        help
          Use to build 5E2 camera sensor.

config CAMERA_CIS_5E3_OBJ
        bool "Use 5E3 camera cis"
	depends on USE_DIRECT_IS_CONTROL
	depends on CAMERA_CIS_SELECT
        default n
        help
          Use to build 5E3 camera sensor.

config CAMERA_CIS_4H5YC_OBJ
        bool "Use 4H5YC camera cis"
	depends on USE_DIRECT_IS_CONTROL
	depends on CAMERA_CIS_SELECT
        default n
        help
          Use to build 4H5YC camera sensor.

config CAMERA_CIS_4H5_OBJ
        bool "Use 4H5 camera cis"
	depends on USE_DIRECT_IS_CONTROL
	depends on CAMERA_CIS_SELECT
        default n
        help
          Use to build 4H5 camera sensor.

config CAMERA_CIS_2P2_OBJ
		bool "Use 2P2 camera cis"
	depends on USE_DIRECT_IS_CONTROL
	depends on CAMERA_CIS_SELECT
		default n
		help
		  Use to build 2P2 camera sensor.
config CAMERA_CIS_2P8_OBJ
		bool "Use 2P8 camera cis"
	depends on USE_DIRECT_IS_CONTROL
	depends on CAMERA_CIS_SELECT
		default n
		help
		  Use to build 2P8 camera sensor.

config CAMERA_CIS_3P3_OBJ
		bool "Use 3P3 camera cis"
	depends on USE_DIRECT_IS_CONTROL
	depends on CAMERA_CIS_SELECT
		default n
		help
		  Use to build 3P3 camera sensor.

config CAMERA_CIS_3L2_OBJ
		bool "Use 3L2 camera cis"
	depends on USE_DIRECT_IS_CONTROL
	depends on CAMERA_CIS_SELECT
		default n
		help
		  Use to build 3L2 camera sensor.

config CAMERA_CIS_3H1_OBJ
		bool "Use 3H1 camera cis"
	depends on USE_DIRECT_IS_CONTROL
	depends on CAMERA_CIS_SELECT
		default n
		help
		  Use to build 3H1 camera sensor.

config CAMERA_CIS_3H1_C3_OBJ
		bool "Use 3H1 camera cis for companion"
	depends on USE_DIRECT_IS_CONTROL
	depends on CAMERA_CIS_SELECT
		default n
		help
		  Use to build 3H1 camera sensor.


config CAMERA_CIS_4E6_OBJ
		bool "Use 4E6 camera cis"
	depends on USE_DIRECT_IS_CONTROL
	depends on CAMERA_CIS_SELECT
		default n
		help
		  Use to build 4E6 camera sensor.

config CAMERA_CIS_5E6_OBJ
		bool "Use 5E6 camera cis"
	depends on USE_DIRECT_IS_CONTROL
	depends on CAMERA_CIS_SELECT
		default n
		help
		  Use to build 5E6 camera sensor.

config CAMERA_CIS_3M2_OBJ
		bool "Use 3M2 camera cis"
	depends on USE_DIRECT_IS_CONTROL
	depends on CAMERA_CIS_SELECT
		default n
		help
		  Use to build 3M2 camera sensor.

config CAMERA_CIS_3M3_OBJ
		bool "Use 3M3 camera cis"
	depends on USE_DIRECT_IS_CONTROL
	depends on CAMERA_CIS_SELECT
		default n
		help
		  Use to build 3M3 camera sensor.

config CAMERA_CIS_2L1_OBJ
		bool "Use 2L1 camera cis"
	depends on USE_DIRECT_IS_CONTROL
	depends on CAMERA_CIS_SELECT
		default n
		help
		  Use to build 2L1 camera sensor.

config CAMERA_CIS_2L2_OBJ
		bool "Use 2L2 camera cis"
	depends on USE_DIRECT_IS_CONTROL
	depends on CAMERA_CIS_SELECT
		default n
		help
		  Use to build 2L2 camera sensor.

config CAMERA_CIS_IMX260_OBJ
		bool "Use IMX260 camera cis"
	depends on USE_DIRECT_IS_CONTROL
	depends on CAMERA_CIS_SELECT
		default n
		help
		  Use to build IMX260 camera sensor.

config CAMERA_CIS_IMX333_OBJ
		bool "Use IMX333 camera cis"
	depends on USE_DIRECT_IS_CONTROL
	depends on CAMERA_CIS_SELECT
		default n
		help
		  Use to build IMX333 camera sensor.
		  
config CAMERA_CIS_2L7_OBJ
		bool "Use 2L7 camera cis"
	depends on USE_DIRECT_IS_CONTROL
	depends on CAMERA_CIS_SELECT
		default n
		help
		  Use to build 2L7 camera sensor.
config CAMERA_CIS_IMX320_OBJ
		bool "Use IMX320 camera cis"
	depends on USE_DIRECT_IS_CONTROL
	depends on CAMERA_CIS_SELECT
		default n
		help
		  Use to build IMX320 camera sensor.

config CAMERA_CIS_IMX320_C3_OBJ
		bool "Use IMX320_C3 camera cis"
	depends on USE_DIRECT_IS_CONTROL
	depends on CAMERA_CIS_SELECT
		default n
		help
		  Use to build IMX320_C3 camera sensor.		  
```
