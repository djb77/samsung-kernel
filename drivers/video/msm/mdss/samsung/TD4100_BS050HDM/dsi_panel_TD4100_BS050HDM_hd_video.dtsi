/* Copyright (c) 2013-14, Samsung Electronics Corporation. All rights reserved.
 *
 * This program is free software; you can redistribute it and/or modify
 * it under the terms of the GNU General Public License version 2 and
 * only version 2 as published by the Free Software Foundation.
 *
 * This program is distributed in the hope that it will be useful,
 * but WITHOUT ANY WARRANTY; without even the implied warranty of
 * MERCHANTABILITY or FITNESS FOR A PARTICULAR PURPOSE.  See the
 * GNU General Public License for more details.
 */

/*---------------------------------------------------------------------------
 * This file is autogenerated file using gcdb parser. Please do not edit it.
 * Update input XML file to add a new entry or update variable in this file
 * VERSION = "1.0"
 *---------------------------------------------------------------------------*/
&mdss_mdp {
	ss_dsi_panel_TD4100_BS050HDM_HD: ss_dsi_panel_TD4100_BS050HDM_HD {
		qcom,mdss-dsi-panel-name = "ss_dsi_panel_TD4100_BS050HDM_HD";
		qcom,mdss-dsi-panel-controller = <&mdss_dsi0>;
		qcom,mdss-dsi-panel-width = <720>;
		qcom,mdss-dsi-panel-height = <1280>;
		qcom,mdss-dsi-bpp = <24>;
		qcom,mdss-dsi-panel-destination = "display_1";
		qcom,mdss-dsi-panel-timings = [C5 2C 1E 00 5A 5C 24 30 25 03 04 00];
		qcom,mdss-dsi-on-command = [
			/* Initializing Sequence(1)*/
			39 00 00 00 00 00 02 B0 04
			39 00 00 00 00 00 04 B3 31 00 06
			39 00 00 00 00 00 08 B6 32 43 80 00 00 07 86
			39 00 00 00 00 00 07 B8 00 78 64 10 64 B4
			39 00 00 00 00 00 07 B9 00 78 64 10 64 B4
			39 00 00 00 00 00 07 BA 07 77 4A 0A 38 55
			39 00 00 00 00 00 04 BB 00 B4 A0
			39 00 00 00 00 00 04 BC 00 B4 A0
			39 00 00 00 00 00 04 BD 00 B4 A0
			39 00 00 00 00 00 02 BE 04
			39 00 00 00 00 00 12 C0 00 00 00 00 00 00 00 00 00 00 00 00 00 00 00 00 00
			39 00 00 00 00 00 23 C1 04 48 01 00 10 01 11 00 11 00 30 29 29 11 00 00 00 00 00 00 00 00 00 00 00 00 DF 00 20 80 01 00 00 00
			39 00 00 00 00 00 14 C2 02 F0 05 00 0A 0A 08 00 24 09 00 00 00 00 00 00 11 00 01
			39 00 00 00 00 00 40 C3 00 05 26 00 00 00 00 00 00 00 00 02 88 00 00 00 02 89 00 00 01 01 03 28 01 00 01 01 00 00 00 00 00 00 00 00 00 00 00 00 00 00 00 00 00 00 00 00 00 00 29 00 00 00 00 00 29 00 00 00 40 20 00
			39 00 00 00 00 00 29 C4 70 01 00 00 00 00 00 00 00 00 00 00 00 00 00 00 00 00 00 00 00 00 00 00 00 00 00 00 00 00 00 00 00 00 00 00 00 00 01 01

			/* Initializing Sequence(2)*/
			39 00 00 00 00 00 0B C5 08 00 00 00 00 70 00 00 2D 41
			39 00 00 00 00 00 22 C6 B2 08 A0 00 00 08 A0 00 00 00 00 00 00 00 00 00 00 00 00 00 00 00 00 00 00 00 00 00 00 00 00 80 B2
			39 00 00 00 00 00 2F C7 08 25 35 48 57 62 7A 8A 96 A2 57 65 73 7E 86 91 9F AA BF 08 25 35 48 57 62 7A 8A 96 A1 4E 58 63 7E 86 91 9F AA BF 00 97 00 97 00 97 00 97
			39 00 00 00 00 00 38 C8 00 00 00 00 00 FC 00 00 00 00 00 FC 00 00 00 00 00 FC 00 00 00 00 00 FC 00 00 00 00 00 FC 00 00 00 00 00 FC 00 00 00 00 00 FC 00 00 00 00 00 FC 00 00 00 00 00 FC 00
			39 00 00 00 00 00 14 C9 00 00 00 00 00 FC 00 00 00 00 00 FC 00 00 00 00 00 FC 00
			39 00 00 00 00 00 2C CA 1D FC FC FC F3 06 FE 00 20 CD 00 0A 00 E5 00 EA 45 2B 00 00 EA 18 00 00 00 00 00 00 00 00 00 00 00 00 00 00 00 00 00 00 00 00 00
			39 00 00 00 00 00 2E CC 00 00 72 40 00 00 70 00 C4 10 14 D2 02 00 00 00 00 00 00 00 00 00 00 00 00 00 00 00 00 00 00 02 D2 16 12 C4 00 70 00 00 42 72 00 00 00

			/* Initializing Sequence(3)*/
			39 00 00 00 00 00 14 CD 0D 00 00 00 20 00 00 00 00 7A 00 82 00 6E 00 82 01 00 00
			39 00 00 00 00 00 19 CE 7D 40 48 56 67 78 88 98 A7 B5 C3 D1 DE E9 F2 FA FF 04 00 01 03 45 00 00
			39 00 00 00 00 00 03 CF 48 10
			39 00 00 00 00 00 13 D0 11 03 45 C5 03 10 10 40 19 08 99 00 00 00 00 00 00 00
			39 00 00 00 00 00 02 D1 00
			39 00 00 00 00 00 1C D3 BB 3B 33 3B 44 3B 44 3B 00 00 EC 91 91 23 22 D4 D4 3B BB 4F D0 3C 10 12 10 00 10
			39 00 00 00 00 00 19 D4 80 04 04 33 00 04 00 00 00 00 00 00 00 00 00 00 00 00 0A 90 05 00 64 94
			39 00 00 00 00 00 02 D6 C1
			39 00 00 00 00 00 25 D7 F6 FF 03 05 43 24 80 1F C7 1F 1B 00 0F 01 20 08 F8 3F 00 00 00 40 A4 75 00 33 02 C0 AF CB 60 30 F4 03 3D 00
			39 00 00 00 00 00 09 D8 00 00 00 00 00 00 00 00
			39 00 00 00 00 00 05 DD 30 06 23 65
			39 00 00 00 00 00 05 DE 00 FF FF 50
			39 00 00 00 00 00 02 5E 02

			/* PWM INIT */
			39 00 00 00 00 00 02 B0 04
			39 00 00 00 00 00 02 51 00
			39 00 00 00 00 00 02 53 0C
			39 00 00 00 00 00 02 55 00
			39 01 00 00 00 00 02 35 00

			/* Display on Sequence(4) */
			05 01 00 00 00 00 02 11 00	/* Sleep Out & 120ms(0x78) Delay. 120ms delay wait at DISPLAY_ON cmd */
		];
		qcom,mdss-dsi-off-command = [
					05 01 00 00 00 00 02 28 00	/* no wait */
					05 01 00 00 50 00 02 10 00	/* wait 80ms(0x50) */
					];
		//qcom,mdss-dsi-post-panel-on-command = ;

		//qcom,cmd-sync-wait-broadcast = ;
		//qcom,mdss-dsi-fbc-enable = ;
		//qcom,mdss-dsi-fbc-slice-height = ;
		//qcom,mdss-dsi-fbc-2d-pred-mode = ;
		//qcom,mdss-dsi-fbc-ver2-mode = ;
		//qcom,mdss-dsi-fbc-bpp = ;
		//qcom,mdss-dsi-fbc-packing = ;
		//qcom,mdss-dsi-fbc-quant-error = ;
		//qcom,mdss-dsi-fbc-bias = ;
		//qcom,mdss-dsi-fbc-pat-mode = ;
		//qcom,mdss-dsi-fbc-vlc-mode = ;
		//qcom,mdss-dsi-fbc-bflc-mode = ;
		//qcom,mdss-dsi-fbc-h-line-budget = ;
		//qcom,mdss-dsi-fbc-budget-ctrl = ;
		//qcom,mdss-dsi-fbc-block-budget = ;
		//qcom,mdss-dsi-fbc-lossless-threshold = ;
		//qcom,mdss-dsi-fbc-lossy-threshold = ;
		//qcom,mdss-dsi-fbc-rgb-threshold = ;
		//qcom,mdss-dsi-fbc-lossy-mode-idx = ;
		//qcom,mdss-dsi-fbc-max-pred-err = ;
		qcom,mdss-dsi-h-back-porch = <80>;
		qcom,mdss-dsi-h-front-porch = <748>;
		qcom,mdss-dsi-h-pulse-width = <1>;
		qcom,mdss-dsi-h-sync-skew = <0>;
		qcom,mdss-dsi-v-back-porch = <10>;
		qcom,mdss-dsi-v-front-porch = <10>;
		qcom,mdss-dsi-v-pulse-width = <1>;
		qcom,mdss-dsi-h-left-border = <0>;
		qcom,mdss-dsi-h-right-border = <0>;
		qcom,mdss-dsi-v-top-border = <0>;
		qcom,mdss-dsi-v-bottom-border = <0>;
		qcom,mdss-dsi-underflow-color = <0xff>;
		qcom,mdss-dsi-border-color = <0>;
		//qcom,mdss-dsi-pan-enable-dynamic-fps = ;
		//qcom,mdss-dsi-pan-fps-update = ;
		//qcom,min-refresh-rate = ;
		//qcom,max-refresh-rate = ;
		qcom,mdss-dsi-bl-pmic-control-type = "bl_ctrl_dcs";
		//qcom,mdss-dsi-bl-pwm-pmi = ;
		//qcom,mdss-dsi-bl-pmic-bank-select = ;
		//qcom,mdss-dsi-bl-pmic-pwm-frequency = ;
		//qcom,mdss-dsi-pwm-gpio = ;
		qcom,mdss-dsi-bl-min-level = <1>;
		qcom,mdss-dsi-bl-max-level = <256>;
		qcom,mdss-brightness-max-level = <256>;
		//qcom,mdss-dsi-interleave-mode = ;
		qcom,mdss-dsi-panel-type = "dsi_video_mode";
		//qcom,5v-boost-gpio = ;
		//qcom,mdss-dsi-te-check-enable = ;
		//qcom,mdss-dsi-te-using-te-pin = ;
		//qcom,mdss-dsi-te-pin-select = ;
		//qcom,mdss-dsi-te-dcs-command = ;
		//qcom,mdss-dsi-wr-mem-start = ;
		//qcom,mdss-dsi-wr-mem-continue = ;
		qcom,mdss-dsi-h-sync-pulse = <0>;
		qcom,mdss-dsi-hfp-power-mode;
		//qcom,mdss-dsi-hbp-power-mode;
		//qcom,mdss-dsi-hsa-power-mode;
		//qcom,mdss-dsi-last-line-interleave = ;
		qcom,mdss-dsi-bllp-eof-power-mode;
		qcom,mdss-dsi-bllp-power-mode;
		qcom,mdss-dsi-traffic-mode = "burst_mode";
		qcom,mdss-dsi-pixel-packing = "loose";
		qcom,mdss-dsi-virtual-channel-id = <0>;
		qcom,mdss-dsi-color-order = <0>;
		qcom,mdss-dsi-lane-0-state;
		qcom,mdss-dsi-lane-1-state;
		qcom,mdss-dsi-lane-2-state;
		qcom,mdss-dsi-lane-3-state;
		qcom,mdss-dsi-t-clk-post = <0x03>;
		qcom,mdss-dsi-t-clk-pre = <0x1C>;
		qcom,mdss-dsi-stream = <0>;
		qcom,mdss-dsi-mdp-trigger = "none";
		qcom,mdss-dsi-dma-trigger = "trigger_sw";
		qcom,mdss-dsi-panel-framerate = <60>;
		qcom,mdss-dsi-panel-clockrate = <728000000>;
		//qcom,mdss-mdp-transfer-time-us = ;
		qcom,mdss-dsi-on-command-state = "dsi_lp_mode"; /* TD4100 : CLK & DATA should be LP11 for 80ms after reset. So we send init_cmds before TG enable */
		qcom,mdss-dsi-off-command-state = "dsi_hs_mode";
		//qcom,mdss-dsi-post-mode-switch-on-command-state = ;
		qcom,mdss-pan-physical-width-dimension = <62>;
		qcom,mdss-pan-physical-height-dimension = <106>;
		//qcom,mdss-dsi-panel-mode-gpio-state = ;
		//qcom,mdss-tear-check-disable = ;
		//qcom,mdss-tear-check-sync-cfg-height = ;
		//qcom,mdss-tear-check-sync-init-val = ;
		//qcom,mdss-tear-check-sync-threshold-start = ;
		//qcom,mdss-tear-check-sync-threshold-continue = ;
		//qcom,mdss-tear-check-start-pos = ;
		//qcom,mdss-tear-check-rd-ptr-trigger-intr = ;
		//qcom,mdss-tear-check-frame-rate = ;
		qcom,mdss-dsi-reset-sequence = <1 1>, <0 1>, <1 0>;
		//qcom,partial-update-enabled = ;
		//qcom,mdss-dsi-horizontal-line-idle = ;
		//qcom,partial-update-roi-merge = ;
		//qcom,dcs-cmd-by-left = ;
		qcom,mdss-dsi-lp11-init;
		qcom,mdss-dsi-init-delay-us = <100>;
		qcom,mdss-dsi-rx-eot-ignore;
		qcom,mdss-dsi-tx-eot-append;
		//qcom,ulps-enabled = ;
		qcom,suspend-ulps-enabled;
		//qcom,panel-roi-alignment = ;
		qcom,esd-check-enabled;
		//qcom,mdss-dsi-panel-status-command = ;
		//qcom,mdss-dsi-panel-status-command-mode = ;
		qcom,mdss-dsi-panel-status-check-mode="reg_read_irq";
		//qcom,mdss-dsi-panel-status-read-length = ;
		//qcom,mdss-dsi-panel-status-valid-params = ;
		//qcom,mdss-dsi-panel-status-value = ;
		//qcom,mdss-dsi-panel-max-error-count = ;
		//qcom,dynamic-mode-switch-enabled = ;
		//qcom,dynamic-mode-switch-type = ;
		//qcom,mdss-dsi-post-mode-switch-on-command = ;
		//qcom,video-to-cmd-mode-switch-commands = ;
		//qcom,cmd-to-video-mode-switch-commands = ;
		//qcom,mdss-dsi-panel-orientation = ;
		//qcom,panel-ack-disabled = ;
		//qcom,mdss-dsi-force-clock-lane-hs; /* TD4100 : CLK & DATA should be LP11 for 80ms after reset.  samsung,dsi_force_clock_lane_hs is enabled*/
		//qcom,compression-mode = ;
		//qcom,panel-supply-entries = ;
		//qcom,config-select = ;
		//qcom,lm-split = ;
		//qcom,split-mode = ;
		//qcom,mdss-dsc-encoders = ;
		//qcom,mdss-dsc-slice-height = ;
		//qcom,mdss-dsc-slice-width = ;
		//qcom,mdss-dsc-slice-per-pkt = ;
		//qcom,mdss-dsc-bit-per-component = ;
		//qcom,mdss-dsc-bit-per-pixel = ;
		//qcom,mdss-dsc-block-prediction-enable = ;
		//qcom,mdss-dsc-config-by-manufacture-cmd = ;
		//qcom,dba-panel = ;
		//qcom,bridge-name = ;
		//qcom,adjust-timer-wakeup-ms = ;
		//qcom,mdss-dsi-display-timings = ;
		//qcom,mdss-dsi-timing-default = ;
		//qcom,mdss-dsi-timing-switch-command = ;
		//qcom,mdss-dsi-timing-switch-command-state  = ;

/*
 * ************************************************************************************************************************************
 *
 *
 *			Below  parameters are samsung dependent thigs
 *
 *
 * ************************************************************************************************************************************
 */
		samsung,panel-vendor = "BOE";
		samsung,tft-common-support;
		samsung,enter_hbm_lux = <20000>;
		samsung,support_mdnie_lite;

		samsung,mdss-power-off-reset-delay-us = <4000>;

		samsung,dsi_force_clock_lane_hs;  /* TD4100 : CLK & DATA should be LP11 for 80ms after reset. */

		/* To use device_resume & device_suspend for optimizing display on time */
		samsung,reduce_display_on_time;
		samsung,wait_after_reset_delay = <80>; /* Flash loading time */
		samsung,wait_after_sleep_out_delay = <100>; /* 6frames 16.6 * 6 = about 100ms*/

		samsung,level1_key_enable_tx_cmds_revA = [
			39 01 00 00 00 00 02 B0 04
		];
		samsung,level1_key_disable_tx_cmds_revA = [
			39 01 00 00 00 00 02 B0 04
		];

		samsung,packet_size_tx_cmds_revA = [
			37 01 00 00 00 00 02 07 00
		];

		samsung,display_on_tx_cmds_revA = [
			05 01 00 00 00 00 02 29 00
		];

		samsung,display_off_tx_cmds_revA = [05 01 00 00 00 00 02 28 00];

		/*
		 * First parameters can be changed
		 * by function of samsung_nv_read()
		 * because of that means offset of
		 * read position
		 */
		samsung,reg_read_pos_tx_cmds_revA = [
			15 01 00 00 00 00 02 B0 00
		];
		samsung,manufacture_id0_rx_cmds_revA = [06 01 00 00 00 00 01 da 01 00];
		samsung,manufacture_id1_rx_cmds_revA = [06 01 00 00 00 00 01 db 01 00];
		samsung,manufacture_id2_rx_cmds_revA = [06 01 00 00 00 00 01 dc 01 00];

		samsung,tft_pwm_tx_cmds_revA=[
			39 01 00 00 00 00 02 51 FF/*First command should be PWM duty change command*/
		];
		samsung,cabc_on_tx_cmds_revA = [
			39 01 00 00 00 00 02 55 01
		];
		samsung,cabc_off_tx_cmds_revA = [
			39 01 00 00 00 00 02 55 00
		];
		/*
		* ************************************************************************************************************************
		* Scaled level to index mappings
		* ************************************************************************************************************************
		*/
		samsung,candela_map_table_revA = <
		/*<idx>	  <from>  <till> <scaled_level> */
			0		0		0		0
			1		3		4		4		/* MIN 4 CD */
			2		5		6		9
			3		7		8		11
			4		9		10		13
			5		11		12		20
			6		13		14		23
			7		15		16		26		/* DIMMING 20 CD */
			8		17		18		28
			9		19		20		31
			10		21		22		34
			11		23		24		37
			12		25		26		40
			13		27		28		43
			14		29		30		45
			15		31		32		48
			16		33		34		51
			17		35		36		54
			18		37		38		57
			19		39		40		60
			20		41		42		62
			21		43		44		65
			22		45		45		68
			23		46		47		71
			24		48		49		74
			25		50		51		77
			26		52		53		79
			27		54		55		82
			28		56		57		85
			29		58		59		88
			30		60		61		91
			31		62		63		94
			32		64		65		96
			33		66		67		99
			34		68		69		102
			35		70		71		105
			36		72		73		108
			37		74		75		111
			38		76		77		113
			39		78		79		116
			40		80		81		119
			41		82		83		122
			42		84		85		125
			43		86		86		128
			44		87		88		130
			45		89		90		133
			46		91		92		136
			47		93		94		139
			48		95		96		142
			49		97		98		145
			50		99		100		147
			51		101		102		150
			52		103		104		153
			53		105		106		156
			54		107		108		159
			55		109		110		162
			56		111		112		164
			57		113		114		167
			58		115		116		170
			59		117		118		177
			60		119		120		184
			61		121		122		191
			62		123		124		198
			63		125		126		205
			64		127		127		212
			65		128		129		219		/* DEFAULT 170 CD */
			66		130		130		226
			67		131		131		233
			68		132		133		240
			69		134		134		247
			70		135		135		254
			71		136		136		261
			72		137		138		268
			73		139		139		275
			74		140		140		282
			75		141		141		288
			76		142		143		295
			77		144		144		302
			78		145		145		309
			79		146		147		316
			80		148		148		323
			81		149		149		330
			82		150		150		337
			83		151		152		344
			84		153		153		351
			85		154		154		358
			86		155		155		365
			87		156		157		372
			88		158		158		379
			89		159		159		386
			90		160		161		393
			91		162		162		400
			92		163		163		480
			93		164		164		400
			94		165		166		400
			95		167		167		400
			96		168		168		400
			97		169		169		400
			98		170		171		400
			99		172		172		400
			100		173		173		400
			101		174		174		400
			102		175		176		400
			103		177		177		400
			104		178		178		400
			105		179		180		400
			106		181		181		400
			107		182		182		400
			108		183		183		400
			109		184		185		400
			110		186		186		400
			111		187		187		400
			112		188		188		400
			113		189		190		400
			114		191		191		400
			115		192		192		400
			116		193		194		400
			117		195		195		400
			118		196		196		400
			119		197		197		400
			120		198		199		400
			121		200		200		400
			122		201		201		400
			123		202		202		400
			124		203		304		400
			125		205		205		400
			126		206		206		400
			127		207		208		400
			128		209		209		400
			129		210		210		400
			130		211		211		400
			131		212		213		400
			132		214		214		400
			133		215		215		400
			134		216		216		400
			135		217		218		400
			136		219		219		400
			137		220		220		400
			138		221		221		400
			139		222		223		400
			140		224		224		400
			141		225		225		400
			142		226		227		400
			143		228		228		400
			144		229		229		400
			145		230		230		400
			146		231		232		400
			147		233		233		400
			148		234		234		400
			149		235		235		400
			150		236		237		400
			151		238		238		400
			152		239		239		400
			153		240		241		400
			154		242		242		400
			155		243		243		400
			156		244		244		400
			157		245		246		400
			158		247		247		400
			159		248		248		400
			160		249		249		400
			161		250		251		400
			162		252		252		400
			163		253		253		400
			164		254		254		400
			165		255		255		400		/* MAX 400 CD */
			190		256		256		400		/* OUTDOOR 480 CD */
		>;
	};
};
