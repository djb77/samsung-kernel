/* Copyright (c) 2013-14, Samsung Electronics Corporation. All rights reserved.
 *
 * This program is free software; you can redistribute it and/or modify
 * it under the terms of the GNU General Public License version 2 and
 * only version 2 as published by the Free Software Foundation.
 *
 * This program is distributed in the hope that it will be useful,
 * but WITHOUT ANY WARRANTY; without even the implied warranty of
 * MERCHANTABILITY or FITNESS FOR A PARTICULAR PURPOSE.  See the
 * GNU General Public License for more details.
 */

/*---------------------------------------------------------------------------
 * This file is autogenerated file using gcdb parser. Please do not edit it.
 * Update input XML file to add a new entry or update variable in this file
 * VERSION = "1.0"
 *---------------------------------------------------------------------------*/
&mdss_mdp {
	ss_dsi_panel_HX83100A_C5001H3F_HD: ss_dsi_panel_HX83100A_C5001H3F_HD {
		qcom,mdss-dsi-panel-name = "ss_dsi_panel_HX83100A_C5001H3F_HD";
		qcom,mdss-dsi-panel-controller = <&mdss_dsi0>;
		qcom,mdss-dsi-panel-width = <720>;
		qcom,mdss-dsi-panel-height = <1280>;
		qcom,mdss-dsi-bpp = <24>;
		qcom,mdss-dsi-panel-destination = "display_1";
		qcom,mdss-dsi-panel-timings = [A2 24 18 00 4E 52 1C 28 1F 03 04 00];
		qcom,mdss-dsi-on-command = [
					29 01 00 00 00 00 04 B9 83 10 0A
					29 01 00 00 00 00 0C B1 08 7F 3F A1 19 22 22 4E EE 21 61
					29 01 00 00 00 00 02 BD 01
					29 01 00 00 00 00 0B B1 D8 C0 28 88 88 22 5C 5C 13 1A
					29 01 00 00 00 00 02 BD 00
					29 01 00 00 00 00 0A B2 00 40 64 0D 94 6F 0D 94 6F
					29 01 00 00 00 00 0E B4 00 FF 01 43 01 43 3C 3C 01 58 01 58 20
					29 01 00 00 00 00 04 B6 BC BC 00

					/* --- Choose one for specific scan dirction --- */
					/* Forward and left to right */
					29 01 00 00 00 00 02 CC 02
					/* Backward and right to left */
					/*29 01 00 00 00 00 02 CC 0E*/

					29 01 00 00 00 00 29 D5 18 18 18 18 39 39 18 18 23 22 21 20 05 04 07 06 01 00 03 02 18 18 18 18 38 38 19 19 18 18 18 18 18 18 18 18 18 18 18 18
					29 01 00 00 00 00 29 D6 18 18 18 18 39 39 19 19 20 21 22 23 02 03 00 01 06 07 04 05 18 18 18 18 38 38 18 18 18 18 18 18 18 18 18 18 18 18 18 18
					29 01 00 00 00 00 33 D3 10 00 00 01 01 08 00 32 10 07 10 07 32 10 01 00 00 00 00 00 00 00 34 33 09 09 37 00 00 00 00 00 00 00 00 0A 00 01 00 16 00 00 00 00 00 00 00 00 00 16
					29 01 00 00 00 00 3B E0 00 01 05 08 09 0C 0E 0B 18 27 39 39 46 5D 67 6E 7F 85 84 92 A1 4F 4F 53 57 59 5D 5E 5D 00 01 05 08 09 0C 0E 0B 18 27 39 39 46 5D 67 6E 7F 85 84 92 A1 4F 4F 53 57 59 5D 5E 5D
					29 01 00 00 00 00 13 E7 20 28 0C C2 10 C3 20 3C 0A DC 09 E6 32 32 02 02 00 0A
					29 01 00 00 00 00 02 BD 01
					29 01 00 00 00 00 02 E7 01
					29 01 00 00 00 00 02 BD 00

					/* Display on Sequence(4) */
					05 01 00 00 78 00 02 11 00	/* Sleep Out & 120ms(0x78) Delay */
					];
		qcom,mdss-dsi-off-command = [
					05 01 00 00 32 00 02 28 00	/* wait 50ms(0x32) */
					05 01 00 00 05 00 02 10 00	/* wait 5ms(0x96) */
					];
		//qcom,mdss-dsi-post-panel-on-command = ;

		//qcom,cmd-sync-wait-broadcast = ;
		//qcom,mdss-dsi-fbc-enable = ;
		//qcom,mdss-dsi-fbc-slice-height = ;
		//qcom,mdss-dsi-fbc-2d-pred-mode = ;
		//qcom,mdss-dsi-fbc-ver2-mode = ;
		//qcom,mdss-dsi-fbc-bpp = ;
		//qcom,mdss-dsi-fbc-packing = ;
		//qcom,mdss-dsi-fbc-quant-error = ;
		//qcom,mdss-dsi-fbc-bias = ;
		//qcom,mdss-dsi-fbc-pat-mode = ;
		//qcom,mdss-dsi-fbc-vlc-mode = ;
		//qcom,mdss-dsi-fbc-bflc-mode = ;
		//qcom,mdss-dsi-fbc-h-line-budget = ;
		//qcom,mdss-dsi-fbc-budget-ctrl = ;
		//qcom,mdss-dsi-fbc-block-budget = ;
		//qcom,mdss-dsi-fbc-lossless-threshold = ;
		//qcom,mdss-dsi-fbc-lossy-threshold = ;
		//qcom,mdss-dsi-fbc-rgb-threshold = ;
		//qcom,mdss-dsi-fbc-lossy-mode-idx = ;
		//qcom,mdss-dsi-fbc-max-pred-err = ;
		qcom,mdss-dsi-h-back-porch = <118>;
		qcom,mdss-dsi-h-front-porch = <254>;
		qcom,mdss-dsi-h-pulse-width = <25>;
		qcom,mdss-dsi-h-sync-skew = <0>;
		/*
			HX83100A DDI need to keep VBP & VSW only.
			VFP value could be anything.
		*/
		qcom,mdss-dsi-v-back-porch = <13>;
		qcom,mdss-dsi-v-front-porch = <400>;
		qcom,mdss-dsi-v-pulse-width = <2>;
		qcom,mdss-dsi-h-left-border = <0>;
		qcom,mdss-dsi-h-right-border = <0>;
		qcom,mdss-dsi-v-top-border = <0>;
		qcom,mdss-dsi-v-bottom-border = <0>;
		qcom,mdss-dsi-underflow-color = <0xff>;
		qcom,mdss-dsi-border-color = <0>;
		//qcom,mdss-dsi-pan-enable-dynamic-fps = ;
		//qcom,mdss-dsi-pan-fps-update = ;
		//qcom,min-refresh-rate = ;
		//qcom,max-refresh-rate = ;
		qcom,mdss-dsi-bl-pmic-control-type = "bl_ctrl_dcs";
		//qcom,mdss-dsi-bl-pwm-pmi = ;
		//qcom,mdss-dsi-bl-pmic-bank-select = ;
		//qcom,mdss-dsi-bl-pmic-pwm-frequency = ;
		//qcom,mdss-dsi-pwm-gpio = ;
		qcom,mdss-dsi-bl-min-level = <1>;
		qcom,mdss-dsi-bl-max-level = <255>;
		//qcom,mdss-brightness-max-level = ;
		//qcom,mdss-dsi-interleave-mode = ;
		qcom,mdss-dsi-panel-type = "dsi_video_mode";
		//qcom,5v-boost-gpio = ;
		//qcom,mdss-dsi-te-check-enable = ;
		//qcom,mdss-dsi-te-using-te-pin = ;
		//qcom,mdss-dsi-te-pin-select = ;
		//qcom,mdss-dsi-te-dcs-command = ;
		//qcom,mdss-dsi-wr-mem-start = ;
		//qcom,mdss-dsi-wr-mem-continue = ;
		qcom,mdss-dsi-h-sync-pulse = <0>;
		qcom,mdss-dsi-hfp-power-mode;
		//qcom,mdss-dsi-hbp-power-mode;
		//qcom,mdss-dsi-hsa-power-mode;
		//qcom,mdss-dsi-last-line-interleave = ;
		qcom,mdss-dsi-bllp-eof-power-mode;
		qcom,mdss-dsi-bllp-power-mode;
		qcom,mdss-dsi-traffic-mode = "burst_mode";
		qcom,mdss-dsi-pixel-packing = "loose";
		qcom,mdss-dsi-virtual-channel-id = <0>;
		qcom,mdss-dsi-color-order = <0>;
		qcom,mdss-dsi-lane-0-state;
		qcom,mdss-dsi-lane-1-state;
		qcom,mdss-dsi-lane-2-state;
		qcom,mdss-dsi-lane-3-state;
		qcom,mdss-dsi-t-clk-post = <0x04>;
		qcom,mdss-dsi-t-clk-pre = <0x1C>;
		qcom,mdss-dsi-stream = <0>;
		qcom,mdss-dsi-mdp-trigger = "none";
		qcom,mdss-dsi-dma-trigger = "trigger_sw";
		qcom,mdss-dsi-panel-framerate = <60>;
		qcom,mdss-dsi-panel-clockrate = <600000000>;
		//qcom,mdss-mdp-transfer-time-us = ;
		qcom,mdss-dsi-on-command-state = "dsi_hs_mode";
		qcom,mdss-dsi-off-command-state = "dsi_hs_mode";
		//qcom,mdss-dsi-post-mode-switch-on-command-state = ;
		qcom,mdss-pan-physical-width-dimension = <62>;
		qcom,mdss-pan-physical-height-dimension = <106>;
		//qcom,mdss-dsi-panel-mode-gpio-state = ;
		//qcom,mdss-tear-check-disable = ;
		//qcom,mdss-tear-check-sync-cfg-height = ;
		//qcom,mdss-tear-check-sync-init-val = ;
		//qcom,mdss-tear-check-sync-threshold-start = ;
		//qcom,mdss-tear-check-sync-threshold-continue = ;
		//qcom,mdss-tear-check-start-pos = ;
		//qcom,mdss-tear-check-rd-ptr-trigger-intr = ;
		//qcom,mdss-tear-check-frame-rate = ;
		qcom,mdss-dsi-reset-sequence = <1 10>, <0 10>, <1 30>;
		//qcom,partial-update-enabled = ;
		//qcom,mdss-dsi-horizontal-line-idle = ;
		//qcom,partial-update-roi-merge = ;
		//qcom,dcs-cmd-by-left = ;
		qcom,mdss-dsi-lp11-init;
		qcom,mdss-dsi-init-delay-us = <100>;
		qcom,mdss-dsi-rx-eot-ignore;
		qcom,mdss-dsi-tx-eot-append;
		//qcom,ulps-enabled = ;
		//qcom,suspend-ulps-enabled = ;
		//qcom,panel-roi-alignment = ;
		//qcom,esd-check-enabled = ;
		//qcom,mdss-dsi-panel-status-command = ;
		//qcom,mdss-dsi-panel-status-command-mode = ;
		//qcom,mdss-dsi-panel-status-check-mode = ;
		//qcom,mdss-dsi-panel-status-read-length = ;
		//qcom,mdss-dsi-panel-status-valid-params = ;
		//qcom,mdss-dsi-panel-status-value = ;
		//qcom,mdss-dsi-panel-max-error-count = ;
		//qcom,dynamic-mode-switch-enabled = ;
		//qcom,dynamic-mode-switch-type = ;
		//qcom,mdss-dsi-post-mode-switch-on-command = ;
		//qcom,video-to-cmd-mode-switch-commands = ;
		//qcom,cmd-to-video-mode-switch-commands = ;
		//qcom,mdss-dsi-panel-orientation = ;
		//qcom,panel-ack-disabled = ;
		qcom,mdss-dsi-force-clock-lane-hs;
		//qcom,compression-mode = ;
		//qcom,panel-supply-entries = ;
		//qcom,config-select = ;
		//qcom,lm-split = ;
		//qcom,split-mode = ;
		//qcom,mdss-dsc-encoders = ;
		//qcom,mdss-dsc-slice-height = ;
		//qcom,mdss-dsc-slice-width = ;
		//qcom,mdss-dsc-slice-per-pkt = ;
		//qcom,mdss-dsc-bit-per-component = ;
		//qcom,mdss-dsc-bit-per-pixel = ;
		//qcom,mdss-dsc-block-prediction-enable = ;
		//qcom,mdss-dsc-config-by-manufacture-cmd = ;
		//qcom,dba-panel = ;
		//qcom,bridge-name = ;
		//qcom,adjust-timer-wakeup-ms = ;
		//qcom,mdss-dsi-display-timings = ;
		//qcom,mdss-dsi-timing-default = ;
		//qcom,mdss-dsi-timing-switch-command = ;
		//qcom,mdss-dsi-timing-switch-command-state  = ;

/*
 * ************************************************************************************************************************************
 *
 *
 *			Below  parameters are samsung dependent thigs
 *
 *
 * ************************************************************************************************************************************
 */
		samsung,panel-vendor = "BOE";
		samsung,tft-common-support;

		samsung,level1_key_enable_tx_cmds_revA = [
			29 01 00 00 00 00 04 B9 83 10 0A
		];
		samsung,level1_key_disable_tx_cmds_revA = [
			29 01 00 00 00 00 04 B9 00 00 00
		];

		samsung,packet_size_tx_cmds_revA = [
			37 01 00 00 00 00 02 07 00
		];

		samsung,display_on_tx_cmds_revA = [
			29 01 00 00 00 00 02 51 FF
			29 01 00 00 00 00 02 53 24
			05 01 00 00 00 00 02 29 00
		];
		samsung,display_off_tx_cmds_revA = [05 01 00 00 00 00 02 28 00];

		/*
		 * First parameters can be changed
		 * by function of samsung_nv_read()
		 * because of that means offset of
		 * read position
		 */
		samsung,reg_read_pos_tx_cmds_revA = [
			15 01 00 00 00 00 02 B0 00
		];
		samsung,manufacture_id0_rx_cmds_revA = [06 01 00 00 00 00 01 da 01 00];
		samsung,manufacture_id1_rx_cmds_revA = [06 01 00 00 00 00 01 db 01 00];
		samsung,manufacture_id2_rx_cmds_revA = [06 01 00 00 00 00 01 dc 01 00];

		samsung,tft_pwm_tx_cmds_revA=[
			39 01 00 00 00 00 02 51 FF/*First command should be PWM duty change command*/
		];
		samsung,cabc_on_tx_cmds_revA = [
			39 01 00 00 00 00 02 55 01
		];
		samsung,cabc_off_tx_cmds_revA = [
			39 01 00 00 00 00 02 55 00
		];
		/*
		* ************************************************************************************************************************
		* Scaled level to index mappings
		* ************************************************************************************************************************
		*/
		samsung,candela_map_table_revA = <
		/*<idx>	  <from>  <till> <scaled_level> */
			0		0		0		0
			1		1		7		2
			2		8		11		4
			3		12		14		6
			4		15		17		8
			5		18		19		10
			6		20		22		12
			7		23		24		14
			8		25		27		16
			9		28		29		18
			10		30		32		19
			11		33		34		20
			12		35		37		21
			13		38		39		22
			14		40		42		24
			15		43		44		25
			16		45		47		26
			17		48		49		27
			18		50		52		28
			19		53		54		29
			20		55		57		30
			21		58		59		31
			22		60		62		32
			23		63		64		33
			24		65		67		34
			25		68		70		35
			26		71		72		36
			27		73		75		37
			28		76		77		38
			29		78		80		39
			30		81		82		40
			31		83		85		41
			32		86		87		42
			33		88		90		43
			34		91		92		44
			35		93		95		45
			36		96		97		46
			37		98		100		48
			38		101		102		50
			39		103		105		52
			40		106		107		54
			41		108		110		56
			42		111		112		58
			43		113		115		60
			44		116		117		62
			45		118		120		64
			46		121		122		66
			47		123		125		68
			48		126		127		70
			49		128		130		72
			50		131		133		74
			51		134		135		76
			52		136		138		78
			53		139		140		80
			54		141		143		82
			55		144		145		84
			56		146		148		86
			57		149		150		88
			58		151		153		90
			59		154		155		92
			60		156		158		94
			61		159		160		96
			62		161		163		98
			63		164		165		100
			64		166		168		103
			65		169		170		106
			66		171		173		109
			67		174		175		112
			68		176		178		115
			69		179		180		118
			70		181		183		121
			71		184		185		124
			72		186		188		127
			72		189		190		130
			74		191		193		133
			75		194		196		137
			76		197		198		141
			77		199		201		145
			78		202		203		149
			79		204		206		153
			80		207		208		157
			81		209		211		161
			82		212		213		165
			83		214		216		169
			84		217		218		173
			85		219		221		177
			86		222		223		181
			87		224		226		185
			88		227		228		189
			89		229		231		193
			90		232		233		197
			91		234		236		201
			92		237		238		205
			93		239		241		209
			94		242		243		213
			95		244		246		217
			96		247		248		221
			97		249		251		225
			98		252		253		229
			99		254		255		233
		>;
	};
};
