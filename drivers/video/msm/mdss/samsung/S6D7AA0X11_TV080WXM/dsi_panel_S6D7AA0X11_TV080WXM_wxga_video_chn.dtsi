/* Copyright (c) 2013-14, Samsung Electronics Corporation. All rights reserved.
 *
 * This program is free software; you can redistribute it and/or modify
 * it under the terms of the GNU General Public License version 2 and
 * only version 2 as published by the Free Software Foundation.
 *
 * This program is distributed in the hope that it will be useful,
 * but WITHOUT ANY WARRANTY; without even the implied warranty of
 * MERCHANTABILITY or FITNESS FOR A PARTICULAR PURPOSE.  See the
 * GNU General Public License for more details.
 */

/*---------------------------------------------------------------------------
 * This file is autogenerated file using gcdb parser. Please do not edit it.
 * Update input XML file to add a new entry or update variable in this file
 * VERSION = "1.0"
 *---------------------------------------------------------------------------*/
&mdss_mdp {
	ss_dsi_panel_S6D7AA0X11_TV080WXM_WXGA: ss_dsi_panel_S6D7AA0X11_TV080WXM_WXGA {

		/*Change chn mipi clk to 484.31 to meet HW RF issue.*/
		qcom,mdss-dsi-h-pulse-width = <8>;
		qcom,mdss-dsi-h-back-porch = <150>;  //<144>;
		qcom,mdss-dsi-h-front-porch = <40>;  //<36>;
		qcom,mdss-dsi-h-sync-skew = <0>;
		qcom,mdss-dsi-v-pulse-width = <12>;
		qcom,mdss-dsi-v-back-porch = <28>;
		qcom,mdss-dsi-v-front-porch = <28>;
		qcom,mdss-dsi-h-left-border = <0>;
		qcom,mdss-dsi-h-right-border = <0>;
		qcom,mdss-dsi-v-top-border = <0>;
		qcom,mdss-dsi-v-bottom-border = <0>;
		qcom,mdss-dsi-panel-timings = [8B 1E 14 00 44 48 18 22 11 03 04 00];   //484.31M

		/*
		* ************************************************************************************************************************
		* add chn brightness table
		* ************************************************************************************************************************
		*/
		samsung,candela_map_table_revA = <
		/*<idx>	  <from>  <till> <scaled_level> */
			0		0		0		0
			1		1		6		1		/* Min brightness */	
			2		7		13		2	
			3		14		17		3	
			4		18		20		4	
			5		21		22		5	
			6		23		25		6	
			7		26		27		7		/* Dim brightness */
			8		28		30		8	
			9		31		32		9
			10		33		35		10
			11		36		37		11
			12		38		40		12
			13		41		42		13
			14		43		45		14
			15		46		47		15
			16		48		50		16
			17		51		52		17
			18		53		55		18
			19		56		57		19
			20		58		60		20
			21		61		62		21
			22		63		65		22
			23		66		67		23
			24		68		70		24
			25		71		72		25
			26		73		75		26
			27		76		77		27
			28		78		80		28
			29		81		82		29
			30		83		83		30
			31		84		84		31
			32		85		85		32
			33		86		86		33
			34		87		87		34
			35		88		89		35
			36		90		90		36
			37		91		91		37
			38		92		92		38
			39		93		93		39
			40		94		94		40
			41		95		95		41
			42		96		96		42
			43		97		97		43
			44		98		98		44
			45		99		99		45
			46		100		100		46
			47		101		101		47
			48		102		102		48
			49		103		103		49
			50		104		104		50
			51		105		105		50
			52		106		106		51
			53		107		107		51
			54		108		108		52
			55		109		109		52
			56		110		110		53
			57		111		111		53
			58		112		112		54
			59		113		113		54
			60		114		114		55
			61		115		115		55
			62		116		116		56
			63		117		117		56
			64		118		118		57
			65		119		119		57
			66		120		120		58
			67		121		121		58
			68		122		122		59
			69		123		123		59
			70		124		124		60
			71		125		125		60		
			72		126		126		61
			73		127		127		62
			74		128		128		63              /* Default brightness level(170CD) */
			75		129		129		64
			76		130		130		65
			77		131		131		66
			78		132		132		67
			79		133		133		68
			80		134		134		69
			81		135		135		70
			82		136		136		71		
			83		137		137		72
			84		138		138		73
			85		139		139		74
			86		140		140		75
			87		141		141		76
			88		142		142		77
			89		143		143		78
			90		144		144		79
			91		145		145		80
			92		146		146		81
			93		147		147		82
			94		148		148		83
			95		149		149		84
			96		150		150		85
			97		151		151		86
			98		152		152		87
			99		153		153		88
			100		154		154		89
			101		155		155		90
			102		156		156		91
			103		157		157		92
			104		158		158		93
			105		159		159		94
			106		160		160		95
			107		161		161		96
			108		162		162		97
			109		163		163		98
			110		164		164		99
			111		165		165		100
			112		166		166		101
			113		167		167		102
			114		168		168		103
			115		169		169		104
			116		170		170		105
			117		171		171		106
			118		172		172		107
			119		173		173		108
			120		174		174		109
			121		175		175		110
			122		176		176		111
			123		177		177		112
			124		178		178		113
			125		179		179		114
			126		180		180		116
			127		181		181		117
			128		182		182		118
			129		183		183		119
			130		184		184		120
			131		185		185		121
			132		186		186		122
			133		187		187		123
			134		188		188		124
			135		189		189		125
			136		190		190		126
			137		191		191		127
			138		192		192		128
			139		193		193		129
			140		194		194		130
			141		195		195		131
			142		196		196		132
			143		197		197		133
			144		198		198		134
			145		199		199		135
			146		200		200		136
			147		201		201		137
			148		202		202		138
			149		203		203		139
			150		204		204		140
			151		205		205		141
			152		206		206		142
			153		207		207		143
			154		208		208		145
			155		209		209		147
			156		210		210		149
			157		211		211		151
			158		212		212		153
			159		213		213		155
			160		214		214		157
			161		215		215		159
			162		216		216		161
			163		217		217		163
			164		218		218		165
			165		219		219		167
			166		220		220		169
			167		221		221		171
			168		222		222		173
			169		223		223		175
			170		224		224		177
			171		225		229		179
			172		230		234		181
			173		235		244		183
			174		245		249		185
			175		250		254		187
			176		255		255		189		/* MAX brightness(202) */
			177		256		256		223		/* Outdoor brightness(320) */
		>;
	};
};
