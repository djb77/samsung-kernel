/* Copyright (c) 2013-14, Samsung Electronics Corporation. All rights reserved.
 *
 * This program is free software; you can redistribute it and/or modify
 * it under the terms of the GNU General Public License version 2 and
 * only version 2 as published by the Free Software Foundation.
 *
 * This program is distributed in the hope that it will be useful,
 * but WITHOUT ANY WARRANTY; without even the implied warranty of
 * MERCHANTABILITY or FITNESS FOR A PARTICULAR PURPOSE.  See the
 * GNU General Public License for more details.
 */

/*---------------------------------------------------------------------------
 * This file is autogenerated file using gcdb parser. Please do not edit it.
 * Update input XML file to add a new entry or update variable in this file
 * VERSION = "1.0"
 *---------------------------------------------------------------------------*/
&mdss_mdp {
	ss_dsi_panel_S6D7AA0X11_TV080WXM_WXGA: ss_dsi_panel_S6D7AA0X11_TV080WXM_WXGA {
		qcom,mdss-dsi-h-back-porch = <140>;
		qcom,mdss-dsi-on-command = [
					39 01 00 00 00 00 03 F0 5A 5A
					39 01 00 00 00 00 03 F1 5A 5A
					39 01 00 00 00 00 03 FC A5 A5
					39 01 00 00 00 00 03 D0 00 10

					/* PWM Setting */
					39 01 00 00 00 00 04 C3 C7 00 29 /* PWM Freq. 24KHz */
					39 01 00 00 00 00 02 B3 51 /* PWM reference clock */
					39 01 00 00 00 00 02 53 24 /* PWM on, dimming off */
					39 01 00 00 00 00 02 51 7F /* PWM duty */
					39 01 00 00 00 00 02 C1 01 /* PWM manual mode */

					/* Porch Setting + 10ms(0xA) Delay */
					39 01 00 00 0A 00 06 F2 02 30 1C 94 24 /* 02,(VBP+VPW),(VFP),(HBP+HPW),HFP */

					/* Sleep Out + 120ms(0x78) Delay */
					05 01 00 00 78 00 02 11 00

					39 01 00 00 00 00 03 F0 A5 A5
					39 01 00 00 00 00 03 F1 A5 A5
					39 01 00 00 00 00 03 FC 5A 5A
		];
		qcom,mdss-dsi-panel-timings = [87 1E 14 00 42 46 18 24 25 03 04 00];

	};
};
