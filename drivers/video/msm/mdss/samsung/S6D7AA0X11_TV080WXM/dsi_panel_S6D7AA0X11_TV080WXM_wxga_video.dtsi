/* Copyright (c) 2013-14, Samsung Electronics Corporation. All rights reserved.
 *
 * This program is free software; you can redistribute it and/or modify
 * it under the terms of the GNU General Public License version 2 and
 * only version 2 as published by the Free Software Foundation.
 *
 * This program is distributed in the hope that it will be useful,
 * but WITHOUT ANY WARRANTY; without even the implied warranty of
 * MERCHANTABILITY or FITNESS FOR A PARTICULAR PURPOSE.  See the
 * GNU General Public License for more details.
 */

/*---------------------------------------------------------------------------
 * This file is autogenerated file using gcdb parser. Please do not edit it.
 * Update input XML file to add a new entry or update variable in this file
 * VERSION = "1.0"
 *---------------------------------------------------------------------------*/
&mdss_mdp {
	ss_dsi_panel_S6D7AA0X11_TV080WXM_WXGA: ss_dsi_panel_S6D7AA0X11_TV080WXM_WXGA {
		qcom,mdss-dsi-panel-name = "ss_dsi_panel_S6D7AA0X11_TV080WXM_WXGA";
		qcom,mdss-dsi-panel-controller = <&mdss_dsi0>;
		qcom,mdss-dsi-panel-type = "dsi_video_mode";
		qcom,mdss-dsi-panel-destination = "display_1";
		qcom,cont-splash-enabled;
		qcom,mdss-dsi-panel-framerate = <60>;
		qcom,mdss-dsi-virtual-channel-id = <0>;
		qcom,mdss-dsi-stream = <0>;
		qcom,mdss-dsi-panel-width = <800>;
		qcom,mdss-dsi-panel-height = <1280>;
		qcom,mdss-dsi-h-pulse-width = <8>;
		qcom,mdss-dsi-h-back-porch = <144>;
		qcom,mdss-dsi-h-front-porch = <36>;
		qcom,mdss-dsi-h-sync-skew = <0>;
		qcom,mdss-dsi-v-pulse-width = <20>;
		qcom,mdss-dsi-v-back-porch = <28>;
		qcom,mdss-dsi-v-front-porch = <28>;
		qcom,mdss-dsi-h-left-border = <0>;
		qcom,mdss-dsi-h-right-border = <0>;
		qcom,mdss-dsi-v-top-border = <0>;
		qcom,mdss-dsi-v-bottom-border = <0>;
		qcom,mdss-dsi-bpp = <24>;
		qcom,mdss-dsi-underflow-color = <0xff>;
		qcom,mdss-dsi-border-color = <0>;
		qcom,mdss-dsi-on-command = [
					39 01 00 00 00 00 03 F0 5A 5A
					39 01 00 00 00 00 03 F1 5A 5A
					39 01 00 00 00 00 03 FC A5 A5
					39 01 00 00 00 00 03 D0 00 10

					/* PWM Setting */
					39 01 00 00 00 00 04 C3 C7 00 29 /* PWM Freq. 24KHz */
					39 01 00 00 00 00 02 B3 51 /* PWM reference clock */
					39 01 00 00 00 00 02 53 24 /* PWM on, dimming off */
					39 01 00 00 00 00 02 51 7F /* PWM duty */
					39 01 00 00 00 00 02 C1 01 /* PWM manual mode */

					/* Porch Setting + 10ms(0xA) Delay */
					39 01 00 00 0A 00 06 F2 02 30 1C 98 24 /* 02,(VBP+VPW),(VFP),(HBP+HPW),HFP */

					/* Sleep Out + 120ms(0x78) Delay */
					05 01 00 00 78 00 02 11 00

					39 01 00 00 00 00 03 F0 A5 A5
					39 01 00 00 00 00 03 F1 A5 A5
					39 01 00 00 00 00 03 FC 5A 5A
		];
		qcom,mdss-dsi-off-command = [05 01 00 00 00 00 02 28 00
					05 01 00 00 82 00 02 10 00
		];

		samsung,display_on_tx_cmds_revA = [
			05 01 00 00 00 00 02 29 00
		];

		samsung,manufacture_id0_rx_cmds_revA = [06 01 00 00 00 00 01 da 01 00];
		samsung,manufacture_id1_rx_cmds_revA = [06 01 00 00 00 00 01 db 01 00];
		samsung,manufacture_id2_rx_cmds_revA = [06 01 00 00 00 00 01 dc 01 00];
		samsung,reg_read_pos_tx_cmds_revA = [ 15 01 00 00 00 00 02 B0 00];
		samsung,mtp_read_sysfs_rx_cmds_revA = [06 01 00 00 00 00 01 00 00 00];

		qcom,mdss-dsi-on-command-state = "dsi_lp_mode";
		qcom,mdss-dsi-off-command-state = "dsi_hs_mode";
		qcom,mdss-dsi-h-sync-pulse = <0>;
		qcom,mdss-dsi-bllp-eof-power-mode;
		qcom,mdss-dsi-bllp-power-mode;
		qcom,mdss-dsi-lane-0-state;
		qcom,mdss-dsi-lane-1-state;
		qcom,mdss-dsi-lane-2-state;
		qcom,mdss-dsi-lane-3-state;
		qcom,mdss-dsi-panel-timings = [87 1E 14 00 44 46 18 24 25 03 04 00];
		qcom,mdss-dsi-t-clk-post = <0x04>;
		qcom,mdss-dsi-t-clk-pre = <0x1D>;
		qcom,mdss-dsi-bl-min-level = <1>;
		qcom,mdss-dsi-bl-max-level = <256>;
		qcom,mdss-brightness-max-level = <256>;
		qcom,mdss-dsi-dma-trigger = "trigger_sw";
		qcom,mdss-dsi-mdp-trigger = "none";
		qcom,mdss-dsi-bl-pmic-control-type = "bl_ctrl_dcs";
		qcom,mdss-dsi-reset-sequence = <1 5>, <0 1>, <1 20>;
		qcom,mdss-pan-physical-width-dimension = <108>;
		qcom,mdss-pan-physical-height-dimension = <172>;
		qcom,mdss-dsi-lp11-init;
		qcom,mdss-dsi-init-delay-us = <20000>;
		qcom,mdss-dsi-force-clock-lane-hs = <1>;
		qcom,mdss-dsi-traffic-mode = "burst_mode";
		/*qcom,mdss-dsi-panel-clockrate = <482300000>;*/
		qcom,mdss-dsi-hbp-power-mode;
		samsung,tft-common-support;
		samsung,enter_hbm_lux = <20000>;
		samsung,support_mdnie_lite;
		samsung,panel-vendor = "BOE";
		/*samsung,tft-module-name = "S6D7AA0X11";*/
		samsung,mdss-dsi-off-lp11-delay-us = <30000>;
		samsung,mdss-power-pre-off-reset-delay-us = <5000>;

		samsung,tft_pwm_tx_cmds_revA=[
			39 01 00 00 00 00 02 51 FF/*First command should be PWM duty change command*/
		];
		samsung,cabc_on_tx_cmds_revA = [
			39 01 00 00 00 00 02 55 01
		];
		samsung,cabc_off_tx_cmds_revA = [
			39 01 00 00 00 00 02 55 00
		];
		/*
		* ************************************************************************************************************************
		* Scaled level to index mappings
		* ************************************************************************************************************************
		*/
		samsung,candela_map_table_revA = <
		/*<idx>	  <from>  <till> <scaled_level> */
			0		0		0		0
			1		1		2		1
			2		3		3		2
			3		4		4		3
			4		5		5		4
			5		6		7		5
			6		8		8		6
			7		9		9		7
			8		10		10		8
			9		11		12		9
			10		13		13		10
			11		14		14		11
			12		15		15		12
			13		16		17		13
			14		18		18		14
			15		19		19		15
			16		20		20		16
			17		21		22		17
			18		23		23		18
			19		24		24		19
			20		25		25		20
			21		26		27		21
			22		28		28		22
			23		29		29		23
			24		30		30		24
			25		31		32		25
			26		33		33		26
			27		34		34		27
			28		35		35		28
			29		36		37		29
			30		38		38		30
			31		39		39		31
			32		40		40		32
			33		41		42		33
			34		43		43		34
			35		44		44		35
			36		45		45		36
			37		46		47		37
			38		48		48		38
			39		49		49		39
			40		50		50		40
			41		51		52		41
			42		53		53		42
			43		54		54		43
			44		55		56		44
			45		57		57		45
			46		58		58		46
			47		59		59		47
			48		60		61		48
			49		62		62		49
			50		63		63		50
			51		64		64		51
			52		65		66		52
			53		67		67		53
			54		68		68		54
			55		69		69		55
			56		70		71		56
			57		72		72		57
			58		73		73		58
			59		74		74		59
			60		75		76		60
			61		77		77		61
			62		78		78		62
			63		79		79		63
			64		80		81		64
			65		82		82		65
			66		83		83		66
			67		84		84		67
			68		85		86		68
			69		87		87		69
			70		88		88		70
			71		89		89		71
			72		90		91		72
			73		92		92		73
			74		93		93		74
			75		94		94		75
			76		95		96		76
			77		97		97		77
			78		98		98		78
			79		99		99		79
			80		100		101		80
			81		102		102		81
			82		103		103		82
			83		104		105		83
			84		106		106		84
			85		107		107		85
			86		108		108		86
			87		109		110		87
			88		111		111		88
			89		112		112		89
			90		113		113		90
			91		114		115		91
			92		116		116		92
			93		117		117		93
			94		118		118		94
			95		119		120		95
			96		121		121		96
			97		122		122		97
			98		123		123		98
			99		124		125		99
			100		126		126		100
			101		127		127		101
			102		128		128		102
			103		129		130		103
			104		131		131		104
			105		132		132		105
			106		133		133		106
			107		134		135		107
			108		136		136		108
			109		137		137		109
			110		138		138		110
			111		139		140		111
			112		141		141		112
			113		142		142		113
			114		143		143		114
			115		144		145		115
			116		146		146		116
			117		147		147		117
			118		148		148		118
			119		149		150		119
			120		151		151		120
			121		152		152		121
			122		153		153		122
			123		154		155		123
			124		156		156		124
			125		157		157		125
			126		158		159		126
			127		160		160		127
			128		161		161		128
			129		162		162		129
			130		163		164		130
			131		165		165		131
			132		166		166		132
			133		167		167		133
			134		168		169		134
			135		170		170		135
			136		171		171		136
			137		172		172		137
			138		173		174		138
			139		175		175		139
			140		176		176		140
			141		177		177		141
			142		178		179		142
			143		180		180		143
			144		181		181		144
			145		182		182		145
			146		183		184		146
			147		185		185		147
			148		186		186		148
			149		187		187		149
			150		188		189		150
			151		190		190		151
			152		191		191		152
			153		192		192		153
			154		193		194		154
			155		195		195		155
			156		196		196		156
			157		197		197		157
			158		198		199		158
			159		200		200		159
			160		201		201		160
			161		202		202		161
			162		203		204		162
			163		205		205		163
			164		206		206		164
			165		207		207		165
			166		208		209		166
			167		210		210		167
			168		211		211		168
			169		212		213		169
			170		214		214		170
			171		215		215		171
			172		216		216		172
			173		217		218		173
			174		219		219		174
			175		220		220		175
			176		221		221		176
			177		222		223		177
			178		224		224		178
			179		225		225		179
			180		226		226		180
			181		227		228		181
			182		229		229		182
			183		230		230		183
			184		231		231		184
			185		232		233		185
			186		234		234		186
			187		235		235		187
			188		236		236		188
			189		237		238		189
			190		239		239		190
			191		240		240		191
			192		241		241		192
			193		242		243		193
			194		244		244		194
			195		245		245		195
			196		246		246		196
			197		247		248		197
			198		249		249		198
			199		250		250		199
			200		251		251		200
			201		252		253		201
			202		254		254		202
			203		255		255		203
			204		256		256		255
		>;
	};
};
