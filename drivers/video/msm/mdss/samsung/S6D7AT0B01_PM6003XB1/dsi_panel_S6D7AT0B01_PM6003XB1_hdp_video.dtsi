/* Copyright (c) 2013-14, Samsung Electronics Corporation. All rights reserved.
 *
 * This program is free software; you can redistribute it and/or modify
 * it under the terms of the GNU General Public License version 2 and
 * only version 2 as published by the Free Software Foundation.
 *
 * This program is distributed in the hope that it will be useful,
 * but WITHOUT ANY WARRANTY; without even the implied warranty of
 * MERCHANTABILITY or FITNESS FOR A PARTICULAR PURPOSE.  See the
 * GNU General Public License for more details.
 */

/*---------------------------------------------------------------------------
 * This file is autogenerated file using gcdb parser. Please do not edit it.
 * Update input XML file to add a new entry or update variable in this file
 * VERSION = "1.0"
 *---------------------------------------------------------------------------*/
&mdss_mdp {
	ss_dsi_panel_S6D7AT0B01_PM6003XB1_HDP: ss_dsi_panel_S6D7AT0B01_PM6003XB1_HDP {
		qcom,mdss-dsi-panel-name = "ss_dsi_panel_S6D7AT0B01_PM6003XB1_HDP";
		qcom,mdss-dsi-panel-controller = <&mdss_dsi0>;
		qcom,mdss-dsi-panel-width = <720>;
		qcom,mdss-dsi-panel-height = <1480>;
		qcom,mdss-dsi-h-back-porch = <100>;
		qcom,mdss-dsi-v-back-porch = <8>;
		qcom,mdss-dsi-v-front-porch = <56>;
		qcom,mdss-dsi-v-pulse-width = <8>;
		qcom,mdss-dsi-h-front-porch = <83>;
		qcom,mdss-dsi-h-pulse-width = <8>;
		qcom,mdss-dsi-bpp = <24>;
		qcom,mdss-dsi-panel-destination = "display_1";
		qcom,mdss-dsi-panel-timings = [94 20 14 00 46 48 1A 24 18 03 04 00];
		qcom,mdss-dsi-t-clk-post = <0x04>;
		qcom,mdss-dsi-t-clk-pre = <0x1D>;
		qcom,mdss-dsi-on-command = [

			/* PASS WD */
			39 01 00 00 00 00 03 F0 5A 5A
			39 01 00 00 00 00 03 FC 5A 5A
			39 01 00 00 00 00 03 9F 5A 5A

			/* TDDI_CTL1 */
			39 01 00 00 00 00 02 71 0A

			/* TDDI Control3 */
			39 01 00 00 00 00 07 73 B0 32 10 
									01 48 00

			/* DISP_RSEL */
			39 01 00 00 00 00 05 B1 11 32 11 00

			/* Display Control 1  */
			39 01 00 00 00 00 11 B3 01 B9 07
									70 18 68 08
									08 07 80 00
									E7 00 E7 00
									E7


			/* DISP_TSC1  */
			39 01 00 00 00 00 58 BA 01 13 02
									13 02 13 02
									88 02 58 00
									84 08 43 03
									45 C1 00 94
									00 14 00 01
									20 01 10 C2
									89 50 2C 99
									46 46 00 01
									F1 01 01 28
									32 38 3F 48
									50 54 FF FF
									FF FF FF FF
									FF FF FF 2F
									48 64 98 BF
									DF FF FF FF
									FF FF FF FF
									FF FF 00 00
									08 00 00 00
									00 00 00 00
									00 00 00 00
									00 00 00 00

			/* Abnormal Control  */
			39 01 00 00 00 00 05 BB 21 68 00 00

			/* GOUTLR_CTL  */
			39 01 00 00 00 00 2D EC 00 08 00
									07 00 15 14
									02 0F 0D 0C
									0E 05 09 06
									02 02 00 00
									02 03 03 02
									08 02 07 02
									15 14 02 0E
									0C 0F 0D 04
									09 06 02 02
									00 00 02 03
									03

			/* GG_GSP  */
			39 01 00 00 00 00 47 ED 12 40 00
									15 11 00 0C
									13 40 00 15
									11 00 0C 00
									01 00 00 00
									00 10 00 41
									00 00 00 00
									10 00 01 00
									00 00 00 20
									00 21 00 00
									00 00 10 00
									40 01 72 61
									00 E0 20 41
									01 72 61 00
									C0 40 08 92
									4C 40 00 80
									28 00 3C 00
									00 00 00

			/* GG_GCK */
			39 01 00 00 00 00 25 EE 12 C4 80
									19 05 06 00
									00 68 12 C5
									80 19 05 06
									00 00 68 12
									C6 80 19 05
									06 00 00 6A
									12 C7 80 19
									05 06 00 00
									6A

			/* GG_CTRL */
			39 01 00 00 00 00 3C EF 00 00 00
									00 00 0C 40
									76 76 10 18
									09 80 00 08
									50 10 00 00
									48 00 00 00
									00 00 00 00
									00 00 00 11
									77 00 22 00
									00 00 00 00
									00 00 00 00
									00 00 00 00
									00 00 00 00
									00 00 00 00
									00 00 00 00

			/* Source Control */
			39 01 00 00 00 00 1B F2 48 23 33
									33 E3 44 43
									00 01 00 00
									0D 84 00 80
									00 A6 1E 08
									03 34 00 00
									00 00 00
			
			/* Address Shift */
			39 01 00 00 00 00 02 B0 02 
			
			/* PWRCTL */
			39 01 00 00 00 00 19 F4 00 17 8A
									DE DE 05 0A
									16 95 55 59
									3B 10 55 15
									26 FA 00 00
									00 00 00 00
									00 
			
			/* ETC */
			39 01 00 00 00 00 32 F9 88 88 00
									C0 C0 04 7A
									00 0D C0 94
									0C 4B A0 1F
									A0 00 00 00
									00 00 0C 00
									10 00 00 00
									00 00 00 00
									0C 00 11 00
									00 00 00 00
									00 00 0C 00
									11 00 00 77
									FF 00

			/* EDS TEST 0 */
			39 01 00 00 00 00 13 FE 02 00 01
									4C 00 00 00
									60 00 03 00
									00 00 00 00
									00 00 00

			/* CABC Control 1 */
			39 01 00 00 00 00 10 C0 03 08 29
									01 00 80 01
									24 0F FF 30
									40 86 DA 8E

			/* CABC Control 2 */
			39 01 00 00 00 00 25 C1 E5 A6 80
									25 66 A7 A7
									AC B3 B3 B3
									B3 BA BD BF
									BF C4 D6 E8
									FF 88 96 A5
									B4 BE C8 CD
									D0 D3 D7 DF
									E6 EA F0 F5
									FF

			/* ESDFG*/
			39 01 00 00 00 00 18 C8 00 24 00
									41 3A 00 00
									00 B0 02 00
									00 00 85 48
									00 00 00 00
									00 00 40 4B 

			/*GAMMA*/
			39 01 00 00 00 00 23 E8 02 0D 17
									13 1A 20 1F
									21 27 2D 2D
									2A 29 27 27
									2E 30 02 0D
									17 13 1A 20
									1F 21 27 27
									27 2A 29 27
									27 2E 34
									
			/* WRDISBV */
			39 01 00 00 00 00 03 51 FF F1
			
			/* WRCTRLD */
			39 01 00 00 00 00 02 53 24
			
			/* WRCABC */
			39 01 00 00 00 00 02 55 00

			/* Sleep Out */
			05 01 00 00 78 00 02 11 00 /* Wait 120 ms */
		];
		qcom,mdss-dsi-off-command = [
			/*password unlock*/
			39 01 00 00 00 00 03 9F 5A 5A

			/* Display Off and Wait 1 frame = 16.67 ms minimum */
			05 01 00 00 14 00 02 28 00

			/* Sleep in and Wait 5 frame =~ 90 ms minimum */
			05 01 00 00 5A 00 02 10 00
		];

		qcom,mdss-dsi-h-sync-skew = <0>;
		qcom,mdss-dsi-h-left-border = <0>;
		qcom,mdss-dsi-h-right-border = <0>;
		qcom,mdss-dsi-v-top-border = <0>;
		qcom,mdss-dsi-v-bottom-border = <0>;
		qcom,mdss-dsi-underflow-color = <0xff>;
		qcom,mdss-dsi-border-color = <0>;
		qcom,mdss-dsi-bl-pmic-control-type = "bl_ctrl_dcs";
		qcom,mdss-dsi-bl-min-level = <1>;
		qcom,mdss-dsi-bl-max-level = <256>;
		qcom,mdss-brightness-max-level = <256>;
		qcom,mdss-dsi-panel-type = "dsi_video_mode";
		qcom,mdss-dsi-h-sync-pulse = <1>;
		/*qcom,mdss-dsi-hfp-power-mode; 
		qcom,mdss-dsi-hbp-power-mode; */ 
		qcom,mdss-dsi-bllp-eof-power-mode; 
		qcom,mdss-dsi-bllp-power-mode;
		qcom,mdss-dsi-traffic-mode = "burst_mode";
		qcom,mdss-dsi-pixel-packing = "loose";
		qcom,mdss-dsi-virtual-channel-id = <0>;
		qcom,mdss-dsi-color-order = <0>;
		qcom,mdss-dsi-lane-0-state;
		qcom,mdss-dsi-lane-1-state;
		qcom,mdss-dsi-lane-2-state;
		qcom,mdss-dsi-lane-3-state;
		qcom,mdss-dsi-stream = <0>;
		qcom,mdss-dsi-mdp-trigger = "none";
		qcom,mdss-dsi-dma-trigger = "trigger_sw";
		qcom,mdss-dsi-panel-framerate = <60>;
		/*qcom,mdss-dsi-panel-clockrate = <509000000>;*/
		qcom,mdss-dsi-on-command-state = "dsi_lp_mode";
		qcom,mdss-dsi-off-command-state = "dsi_hs_mode";
		qcom,mdss-pan-physical-width-dimension = <66>;
		qcom,mdss-pan-physical-height-dimension = <137>;
		qcom,mdss-dsi-rx-eot-ignore;
		qcom,mdss-dsi-tx-eot-append;
		qcom,mdss-dsi-reset-sequence = <1 15>, <0 10>, <1 10>;
		qcom,mdss-dsi-init-delay-us = <1000>;

/*
 * ************************************************************************************************************************************
 *
 *
 *			Below  parameters are samsung dependent thigs
 *
 *
 * ************************************************************************************************************************************
 */
		samsung,panel-vendor = "CST";
		samsung,tft-common-support;
		samsung,enter_hbm_lux = <20000>;

		qcom,mdss-dsi-force-clock-lane-hs;

		samsung,packet_size_tx_cmds_revA = [
			37 01 00 00 00 00 02 07 00
		];

		samsung,display_on_tx_cmds_revA = [

			/* Display On and Wait 1 frame = 16.67 ms minimum */
			05 01 00 00 14 00 02 29 00
			
			 /* TE on */
			15 01 00 00 00 00 02 35 00

			/*password unlock*/
			39 01 00 00 00 00 03 F0 A5 A5
			39 01 00 00 00 00 03 FC A5 A5
			39 01 00 00 00 00 03 9F A5 A5

		];

		samsung,display_off_tx_cmds_revA = [05 01 00 00 00 00 02 28 00];

		/*
		 * First parameters can be changed
		 * by function of samsung_nv_read()
		 * because of that means offset of
		 * read position
		 */
		samsung,reg_read_pos_tx_cmds_revA = [
			15 01 00 00 00 00 02 B0 00
		];
		samsung,manufacture_id0_rx_cmds_revA = [06 01 00 00 00 00 01 da 01 00];
		samsung,manufacture_id1_rx_cmds_revA = [06 01 00 00 00 00 01 db 01 00];
		samsung,manufacture_id2_rx_cmds_revA = [06 01 00 00 00 00 01 dc 01 00];

		samsung,mtp_read_sysfs_rx_cmds_revA = [06 01 00 00 00 00 01 00 00 00];

		samsung,tft_pwm_tx_cmds_revA=[
			39 01 00 00 00 00 03 51 FF FF
		];

		samsung,level1_key_enable_tx_cmds_revA = [
			39 01 00 00 00 00 03 F0 5A 5A
		];
		samsung,level1_key_disable_tx_cmds_revA = [
			39 01 00 00 00 00 03 F0 A5 A5
		];
		samsung,level2_key_enable_tx_cmds_revA = [
			39 01 00 00 00 00 03 F1 5A 5A
		];
		samsung,level2_key_disable_tx_cmds_revA = [
			39 01 00 00 00 00 03 F1 A5 A5
		];

		samsung,cabc_on_tx_cmds_revA = [
			39 01 00 00 00 00 03 F0 5A 5A
			39 01 00 00 00 00 03 FC 5A 5A
			39 01 00 00 00 00 03 9F 5A 5A

			39 01 00 00 00 00 02 55 01

			39 01 00 00 00 00 03 F0 A5 A5
			39 01 00 00 00 00 03 FC A5 A5
			39 01 00 00 00 00 03 9F A5 A5
		];
		samsung,cabc_off_tx_cmds_revA = [
			39 01 00 00 00 00 03 F0 5A 5A
			39 01 00 00 00 00 03 FC 5A 5A
			39 01 00 00 00 00 03 9F 5A 5A
		
			39 01 00 00 00 00 02 55 00

			39 01 00 00 00 00 03 F0 A5 A5
			39 01 00 00 00 00 03 FC A5 A5
			39 01 00 00 00 00 03 9F A5 A5
		];

		
		/*
		* ************************************************************************************************************************
		* Scaled level to index mappings
		* ************************************************************************************************************************
		*/
		samsung,candela_map_table_revA = <
		/*<idx>	  <from>  <till> <scaled_level> */
			0		0		0		0
			1		1		1		0
			2		2		2		20
			3		3		3		28
			4		4		4		36
			5		5		5		44
			6		6		6		52
			7		7		7		60
			8		8		8		68
			9		9		9		76
			10		10		10		84
			11		11		11		92
			12		12		12		100
			13		13		13		104
			14		14		14		117
			15		15		15		125
			16		16		16		133
			17		17		17		141
			18		18		18		149
			19		19		19		157
			20		20		20		165
			21		21		21		173
			22		22		22		181
			23		23		23		190
			24		24		24		198
			25		25		25		206
			26		26		26		214
			27		27		27		222
			28		28		28		230
			29		29		29		238
			30		30		30		246
			31		31		31		254
			32		32		32		262
			33		33		33		270
			34		34		34		279
			35		35		35		287
			36		36		36		295
			37		37		37		303
			38		38		38		311
			39		39		39		319
			40		40		40		327
			41		41		41		335
			42		42		42		343
			43		43		43		351
			44		44		44		360
			45		45		45		368
			46		46		46		376
			47		47		47		384
			48		48		48		392
			49		49		49		400
			50		50		50		408
			51		51		51		416
			52		52		52		424
			53		53		53		432
			54		54		54		440
			55		55		55		449
			56		56		56		457
			57		57		57		465
			58		58		58		473
			59		59		59		481
			60		60		60		489
			61		61		61		497
			62		62		62		505
			63		63		63		513
			64		64		64		521
			65		65		65		530
			66		66		66		538
			67		67		67		546
			68		68		68		554
			69		69		69		562
			70		70		70		570
			71		71		71		578
			72		72		72		586
			73		73		73		594
			74		74		74		602
			75		75		75		610
			76		76		76		619
			77		77		77		627
			78		78		78		635
			79		79		79		643
			80		80		80		651
			81		81		81		659
			82		82		82		667
			83		83		83		675
			84		84		84		683
			85		85		85		691
			86		86		86		700
			87		87		87		708
			88		88		88		716
			89		89		89		724
			90		90		90		732
			91		91		91		740
			92		92		92		748
			93		93		93		756
			94		94		94		764
			95		95		95		772
			96		96		96		780
			97		97		97		789
			98		98		98		797
			99		99		99		805
			100		100		100		813
			101		101		101		821
			102		102		102		829
			103		103		103		837
			104		104		104		845
			105		105		105		853
			106		106		106		861
			107		107		107		870
			108		108		108		878
			109		109		109		886
			110		110		110		894
			111		111		111		902
			112		112		112		910
			113		113		113		918
			114		114		114		926
			115		115		115		934
			116		116		116		942
			117		117		117		950
			118		118		118		959
			119		119		119		967
			120		120		120		975
			121		121		121		983
			122		122		122		991
			123		123		123		999
			124		124		124		1007
			125		125		125		1015
			126		126		126		1023
			127		127		127		1031
			128		128		128		1040
			129		129		129		1053
			130		130		130		1067
			131		131		131		1081
			132		132		132		1094
			133		133		133		1108
			134		134		134		1122
			135		135		135		1135
			136		136		136		1149
			137		137		137		1163
			138		138		138		1177
			139		139		139		1190
			140		140		140		1204
			141		141		141		1218
			142		142		142		1231
			143		143		143		1245
			144		144		144		1259
			145		145		145		1272
			146		146		146		1286
			147		147		147		1300
			148		148		148		1314
			149		149		149		1327
			150		150		150		1341
			151		151		151		1355
			152		152		152		1368
			153		153		153		1382
			154		154		154		1396
			155		155		155		1409
			156		156		156		1423
			157		157		157		1437
			158		158		158		1451
			159		159		159		1464
			160		160		160		1478
			161		161		161		1492
			162		162		162		1505
			163		163		163		1519
			164		164		164		1533
			165		165		165		1546
			166		166		166		1560
			167		167		167		1574
			168		168		168		1588
			169		169		169		1601
			170		170		170		1615
			171		171		171		1629
			172		172		172		1642
			173		173		173		1656
			174		174		174		1670
			175		175		175		1683
			176		176		176		1697
			177		177		177		1711
			178		178		178		1725
			179		179		179		1738
			180		180		180		1752
			181		181		181		1766
			182		182		182		1779
			183		183		183		1793
			184		184		184		1807
			185		185		185		1820
			186		186		186		1834
			187		187		187		1848
			188		188		188		1862
			189		189		189		1875
			190		190		190		1889
			191		191		191		1903
			192		192		192		1916
			193		193		193		1930
			194		194		194		1944
			195		195		195		1957
			196		196		196		1971
			197		197		197		1985
			198		198		198		1999
			199		199		199		2012
			200		200		200		2026
			201		201		201		2040
			202		202		202		2053
			203		203		203		2067
			204		204		204		2081
			205		205		205		2094
			206		206		206		2108
			207		207		207		2122
			208		208		208		2136
			209		209		209		2149
			210		210		210		2163
			211		211		211		2177
			212		212		212		2190
			213		213		213		2204
			214		214		214		2218
			215		215		215		2231
			216		216		216		2245
			217		217		217		2259
			218		218		218		2273
			219		219		219		2286
			220		220		220		2300
			221		221		221		2314
			222		222		222		2327
			223		223		223		2341
			224		224		224		2355
			225		225		225		2368
			226		226		226		2382
			227		227		227		2396
			228		228		228		2410
			229		229		229		2423
			230		230		230		2437
			231		231		231		2451
			232		232		232		2464
			233		233		233		2478
			234		234		234		2492
			235		235		235		2505
			236		236		236		2519
			237		237		237		2533
			238		238		238		2547
			239		239		239		2560
			240		240		240		2574
			241		241		241		2588
			242		242		242		2601
			243		243		243		2615
			244		244		244		2629
			245		245		245		2642
			246		246		246		2656
			247		247		247		2670
			248		248		248		2684
			249		249		249		2697
			250		250		250		2711
			251		251		251		2725
			252		252		252		2738
			253		253		253		2752
			254		254		254		2766
			255		255		255		2780
			256		256		256		3220
		>;
	};
};
