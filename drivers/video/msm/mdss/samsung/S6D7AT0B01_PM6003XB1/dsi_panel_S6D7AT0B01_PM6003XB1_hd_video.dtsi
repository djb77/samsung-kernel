/* Copyright (c) 2013-14, Samsung Electronics Corporation. All rights reserved.
 *
 * This program is free software; you can redistribute it and/or modify
 * it under the terms of the GNU General Public License version 2 and
 * only version 2 as published by the Free Software Foundation.
 *
 * This program is distributed in the hope that it will be useful,
 * but WITHOUT ANY WARRANTY; without even the implied warranty of
 * MERCHANTABILITY or FITNESS FOR A PARTICULAR PURPOSE.  See the
 * GNU General Public License for more details.
 */

/*---------------------------------------------------------------------------
 * This file is autogenerated file using gcdb parser. Please do not edit it.
 * Update input XML file to add a new entry or update variable in this file
 * VERSION = "1.0"
 *---------------------------------------------------------------------------*/
&mdss_mdp {
	ss_dsi_panel_S6D7AT0B01_PM6003XB1_HDP: ss_dsi_panel_S6D7AT0B01_PM6003XB1_HDP {
		qcom,mdss-dsi-panel-height = <1280>;
		qcom,mdss-dsi-v-front-porch = <256>;
		qcom,mdss-pan-physical-height-dimension = <120>;
		qcom,mdss-dsi-on-command = [

			/* PASS WD */
			39 01 00 00 00 00 03 F0 5A 5A
			39 01 00 00 00 00 03 F1 5A 5A
			39 01 00 00 00 00 03 FC 5A 5A

			/* TDDI_CTL1 */
			39 01 00 00 00 00 02 71 0A

			/* TDDI Control3 */
			39 01 00 00 00 00 07 73 B0 64 00 01 68 00

			/* DISP_RSEL */
			39 01 00 00 00 00 05 B1 11 22 11 00

			/* Display Control 1  */
			39 01 00 00 00 00 11 B3 01 B9 07
									70 18 68 08
									08 07 80 00
									E5 00 E5 00
									E5

			/* DISP_TSC1  */
			39 01 00 00 00 00 58 BA 01 13 02
									13 02 13 02
									88 02 58 00
									84 08 43 07
									05 C1 00 94
									00 14 00 01
									26 01 10 C2
									89 50 2C 99
									46 46 00 01
									F1 01 01 28
									32 38 3F 48
									50 54 FF FF
									FF FF FF FF
									FF FF FF 2F
									48 64 98 BF
									DF FF FF FF
									FF FF FF FF
									FF FF 00 00
									08 00 00 00
									00 00 00 00
									00 00 00 00
									00 00 00 00

			/* Abnormal Control  */
			39 01 00 00 00 00 05 BB 21 68 00 00

			/* GOUTLR_CTL  */
			39 01 00 00 00 00 2D EC 00 08 00
									07 00 15 14
									02 0F 0D 0C
									0E 05 09 06
									02 02 00 00
									02 03 03 02
									08 02 07 02
									15 14 02 0E
									0C 0F 0D 04
									09 06 02 02
									00 00 02 03
									03

			/* GG_GSP  */
			39 01 00 00 00 00 48 ED 12 40 00
									15 11 00 0C
									13 40 00 15
									11 00 0C 00
									01 00 00 00
									00 10 00 41
									00 00 00 00
									10 00 01 00
									00 00 00 20
									00 21 00 00
									00 00 10 00
									40 01 72 61
									00 E0 20 41
									01 72 61 00
									C0 40 08 92
									4C 40 00 80
									28 00 3C 00
									00 00 00 00

			/* GG_GCK */
			39 01 00 00 00 00 25 EE 12 C4 80
									19 05 06 00
									00 68 12 C5
									80 19 05 06
									00 00 68 12
									C6 80 19 05
									06 00 00 6A
									12 C7 80 19
									05 06 00 00
									6A

			/* GG_CTRL */
			39 01 00 00 00 00 3C EF 00 00 00
									00 00 0C 40
									76 76 10 18
									09 80 00 08
									50 10 00 00
									48 00 00 00
									00 00 00 00
									00 00 00 11
									77 00 22 00
									00 00 00 00
									00 00 00 00
									00 00 00 00
									00 00 00 00
									00 00 00 00
									00 00 00 00

			/* Source Control */
			39 01 00 00 00 00 1B F2 48 22 33
									33 E3 4C 43
									80 01 00 00
									0D 8C 00 80
									00 A6 1E 08
									03 34 00 00
									00 00 00

			/* ETC */
			39 01 00 00 00 00 32 F9 88 88 00
									C0 C0 04 7A
									00 0D C0 94
									0C 4B A0 1F
									A0 00 00 00
									00 00 0C 00
									10 00 00 00
									00 00 00 00
									0C 00 11 00
									00 00 00 00
									00 00 0C 00
									11 00 00 77
									00 00

			/* EDS TEST 0 */
			39 01 00 00 00 00 13 FE 02 00 01
									4C 00 00 00
									60 00 03 00
									00 00 00 00
									00 00 00

			/* EDS TEST 0 */
			39 01 00 00 00 00 10 C0 01 08 29
									00 00 7F 01
									20 0F FF 30
									40 86 DA 8E

			/* CABC Control 2 */
			39 01 00 00 00 00 25 C1 BF 7F 7F
									25 66 7D 7F
									82 8A 8C 94
									A0 AE BA C2
									D4 DE F0 FA
									FF 88 96 A5
									B4 BE C8 CD
									D0 D3 D7 DF
									E6 EA F0 F5
									FF

			/* ESDFG*/
			39 01 00 00 00 00 18 C8 00 24 00
									41 3A 00 00
									00 B0 02 00
									00 00 85 48
									00 00 00 00
									00 00 40 4B 

			/*GAMMA*/
			39 01 00 00 00 00 23 E8 01 09 12
									0C 12 19 18
									1A 21 25 26
									26 25 25 22
									30 32 01 09
									12 0C 12 19
									18 1A 21 25
									26 26 25 25
									22 30 32
									
			/* WRDISBV */
			39 01 00 00 00 00 02 51 FF
			
			/* WRCTRLD */
			39 01 00 00 00 00 02 53 24
			
			/* WRCABC */
			39 01 00 00 00 00 02 55 00

			/* Sleep Out */
			05 01 00 00 78 00 02 11 00 /* Wait 120 ms */
		];
	};
};
