/* Copyright (c) 2013-14, Samsung Electronics Corporation. All rights reserved.
 *
 * This program is free software; you can redistribute it and/or modify
 * it under the terms of the GNU General Public License version 2 and
 * only version 2 as published by the Free Software Foundation.
 *
 * This program is distributed in the hope that it will be useful,
 * but WITHOUT ANY WARRANTY; without even the implied warranty of
 * MERCHANTABILITY or FITNESS FOR A PARTICULAR PURPOSE.  See the
 * GNU General Public License for more details.
 */

/*---------------------------------------------------------------------------
 * This file is autogenerated file using gcdb parser. Please do not edit it.
 * Update input XML file to add a new entry or update variable in this file
 * VERSION = "1.0"
 *---------------------------------------------------------------------------*/
&mdss_mdp {
	ss_dsi_panel_S6D7AT0B01_PM6003XB1_HDP: ss_dsi_panel_S6D7AT0B01_PM6003XB1_HDP {
		/*
		* ************************************************************************************************************************
		* Scaled level to index mappings
		* ************************************************************************************************************************
		*/
		samsung,candela_map_table_revA = <
		/*<idx>	  <from>  <till> <scaled_level> */
		/*<idx>	<from>  <till> <scaled_level> */
			0		0		0		0
			1		1		1		0
			2		2		2		20
			3		3		3		28
			4		4		4		36
			5		5		5		44
			6		6		6		52
			7		7		7		60
			8		8		8		68
			9		9		9		76
			10		10		10		84
			11		11		11		92
			12		12		12		100
			13		13		13		104
			14		14		14		111
			15		15		15		118
			16		16		16		125
			17		17		17		132
			18		18		18		139
			19		19		19		146
			20		20		20		153
			21		21		21		160
			22		22		22		167
			23		23		23		174
			24		24		24		181
			25		25		25		188
			26		26		26		195
			27		27		27		202
			28		28		28		209
			29		29		29		216
			30		30		30		223
			31		31		31		230
			32		32		32		237
			33		33		33		244
			34		34		34		251
			35		35		35		258
			36		36		36		265
			37		37		37		272
			38		38		38		279
			39		39		39		286
			40		40		40		293
			41		41		41		300
			42		42		42		307
			43		43		43		314
			44		44		44		321
			45		45		45		328
			46		46		46		335
			47		47		47		342
			48		48		48		349
			49		49		49		356
			50		50		50		363
			51		51		51		370
			52		52		52		377
			53		53		53		384
			54		54		54		391
			55		55		55		398
			56		56		56		405
			57		57		57		412
			58		58		58		419
			59		59		59		426
			60		60		60		433
			61		61		61		440
			62		62		62		447
			63		63		63		454
			64		64		64		461
			65		65		65		468
			66		66		66		475
			67		67		67		482
			68		68		68		489
			69		69		69		496
			70		70		70		503
			71		71		71		510
			72		72		72		517
			73		73		73		524
			74		74		74		531
			75		75		75		538
			76		76		76		545
			77		77		77		552
			78		78		78		559
			79		79		79		566
			80		80		80		573
			81		81		81		580
			82		82		82		587
			83		83		83		594
			84		84		84		601
			85		85		85		608
			86		86		86		615
			87		87		87		622
			88		88		88		629
			89		89		89		636
			90		90		90		643
			91		91		91		650
			92		92		92		657
			93		93		93		664
			94		94		94		671
			95		95		95		678
			96		96		96		685
			97		97		97		692
			98		98		98		699
			99		99		99		706
			100		100		100		713
			101		101		101		720
			102		102		102		727
			103		103		103		734
			104		104		104		741
			105		105		105		748
			106		106		106		755
			107		107		107		762
			108		108		108		769
			109		109		109		776
			110		110		110		783
			111		111		111		790
			112		112		112		798
			113		113		113		806
			114		114		114		814
			115		115		115		822
			116		116		116		830
			117		117		117		838
			118		118		118		846
			119		119		119		854
			120		120		120		862
			121		121		121		870
			122		122		122		878
			123		123		123		886
			124		124		124		894
			125		125		125		902
			126		126		126		910
			127		127		127		918
			128		128		128		926
			129		129		129		936
			130		130		130		946
			131		131		131		956
			132		132		132		966
			133		133		133		976
			134		134		134		986
			135		135		135		996
			136		136		136		1006
			137		137		137		1016
			138		138		138		1026
			139		139		139		1036
			140		140		140		1046
			141		141		141		1056
			142		142		142		1066
			143		143		143		1076
			144		144		144		1086
			145		145		145		1096
			146		146		146		1106
			147		147		147		1116
			148		148		148		1126
			149		149		149		1136
			150		150		150		1146
			151		151		151		1156
			152		152		152		1167
			153		153		153		1178
			154		154		154		1189
			155		155		155		1200
			156		156		156		1211
			157		157		157		1222
			158		158		158		1233
			159		159		159		1244
			160		160		160		1255
			161		161		161		1266
			162		162		162		1277
			163		163		163		1288
			164		164		164		1299
			165		165		165		1310
			166		166		166		1321
			167		167		167		1332
			168		168		168		1343
			169		169		169		1354
			170		170		170		1365
			171		171		171		1376
			172		172		172		1387
			173		173		173		1398
			174		174		174		1409
			175		175		175		1420
			176		176		176		1431
			177		177		177		1442
			178		178		178		1453
			179		179		179		1464
			180		180		180		1475
			181		181		181		1486
			182		182		182		1497
			183		183		183		1508
			184		184		184		1519
			185		185		185		1530
			186		186		186		1541
			187		187		187		1552
			188		188		188		1563
			189		189		189		1574
			190		190		190		1585
			191		191		191		1596
			192		192		192		1607
			193		193		193		1618
			194		194		194		1629
			195		195		195		1640
			196		196		196		1651
			197		197		197		1662
			198		198		198		1673
			199		199		199		1684
			200		200		200		1695
			201		201		201		1706
			202		202		202		1717
			203		203		203		1728
			204		204		204		1739
			205		205		205		1750
			206		206		206		1761
			207		207		207		1772
			208		208		208		1783
			209		209		209		1794
			210		210		210		1805
			211		211		211		1816
			212		212		212		1827
			213		213		213		1838
			214		214		214		1849
			215		215		215		1860
			216		216		216		1871
			217		217		217		1882
			218		218		218		1893
			219		219		219		1904
			220		220		220		1915
			221		221		221		1926
			222		222		222		1937
			223		223		223		1948
			224		224		224		1959
			225		225		225		1970
			226		226		226		1981
			227		227		227		1992
			228		228		228		2003
			229		229		229		2014
			230		230		230		2025
			231		231		231		2036
			232		232		232		2047
			233		233		233		2058
			234		234		234		2069
			235		235		235		2080
			236		236		236		2091
			237		237		237		2102
			238		238		238		2113
			239		239		239		2124
			240		240		240		2135
			241		241		241		2146
			242		242		242		2157
			243		243		243		2168
			244		244		244		2179
			245		245		245		2190
			246		246		246		2201
			247		247		247		2212
			248		248		248		2223
			249		249		249		2234
			250		250		250		2245
			251		251		251		2256
			252		252		252		2267
			253		253		253		2278
			254		254		254		2289
			255		255		255		2300
			256		256		256		3220
		>;
	};
};
