/* Copyright (c) 2013-14, Samsung Electronics Corporation. All rights reserved.
 *
 * This program is free software; you can redistribute it and/or modify
 * it under the terms of the GNU General Public License version 2 and
 * only version 2 as published by the Free Software Foundation.
 *
 * This program is distributed in the hope that it will be useful,
 * but WITHOUT ANY WARRANTY; without even the implied warranty of
 * MERCHANTABILITY or FITNESS FOR A PARTICULAR PURPOSE.  See the
 * GNU General Public License for more details.
 */

/*---------------------------------------------------------------------------
 * This file is autogenerated file using gcdb parser. Please do not edit it.
 * Update input XML file to add a new entry or update variable in this file
 * VERSION = "1.0"
 *---------------------------------------------------------------------------*/
&mdss_mdp {
	ss_dsi_panel_SC7798D_BV038WVM_WVGA: ss_dsi_panel_SC7798D_BV038WVM_WVGA/*qcom,mdss_dsi_sitronix_wvga_video*/ {
		qcom,mdss-dsi-panel-name = "ss_dsi_panel_SC7798D_BV038WVM_WVGA";
		label = "ss_dsi_panel_SC7798D_BV038WVM_WVGA";
		qcom,mdss-dsi-panel-controller = <&mdss_dsi0>;
		qcom,mdss-dsi-panel-type = "dsi_video_mode";
		qcom,mdss-dsi-panel-destination = "display_1";
		qcom,cont-splash-enabled;
		qcom,mdss-dsi-panel-framerate = <60>;
		qcom,mdss-dsi-virtual-channel-id = <0>;
		qcom,mdss-dsi-stream = <0>;
		qcom,mdss-dsi-panel-width = <480>;
		qcom,mdss-dsi-panel-height = <800>;
		qcom,mdss-pan-physical-width-dimension = <50>; /* <Width> real size of panel in mm */
		qcom,mdss-pan-physical-height-dimension = <83>; /*<Height> real size of panel in mm */
		qcom,mdss-dsi-lp11-init;
		qcom,mdss-dsi-init-delay-us = <100>;
		qcom,mdss-dsi-h-front-porch = <102>;
		qcom,mdss-dsi-h-back-porch = <80>;
		qcom,mdss-dsi-h-pulse-width = <60>;
		qcom,mdss-dsi-h-sync-skew = <0>;
		qcom,mdss-dsi-v-front-porch = <8>;
		qcom,mdss-dsi-v-back-porch = <12>;
		qcom,mdss-dsi-v-pulse-width = <4>;
		qcom,mdss-dsi-h-left-border = <0>;
		qcom,mdss-dsi-h-right-border = <0>;
		qcom,mdss-dsi-v-top-border = <0>;
		qcom,mdss-dsi-v-bottom-border = <0>;
		qcom,mdss-dsi-bpp = <24>;
		qcom,mdss-dsi-color-order = <0>;
		qcom,mdss-dsi-underflow-color = <0xff>;
		qcom,mdss-dsi-border-color = <0>;
		qcom,mdss-dsi-dma-trigger = "trigger_sw";
		qcom,mdss-dsi-mdp-trigger = "none";
		qcom,mdss-dsi-bl-min-level = <1>;
		qcom,mdss-dsi-bl-max-level = <324>;
		qcom,mdss-brightness-max-level = <324>;
		qcom,mdss-dsi-bl-pmic-control-type = "bl_ctrl_dcs";
		qcom,mdss-dsi-lane-0-state;
		qcom,mdss-dsi-lane-1-state;
		qcom,mdss-dsi-bllp-eof-power-mode;
		qcom,mdss-dsi-bllp-power-mode;
		qcom,mdss-dsi-hfp-power-mode;
		qcom,mdss-dsi-traffic-mode = "burst_mode";
		qcom,mdss-force-clk-lane-hs = <0>;
		qcom,mdss-dsi-reset-sequence = <1 10>, <0 10>, <1 60>;
		qcom,mdss-dsi-h-sync-pulse = <0>;
		qcom,mdss-dsi-panel-timings = [7A 1A 12 00 3E 42 16 1E 14 03 04 00];
		qcom,mdss-dsi-t-clk-pre = <0x1A>;
		qcom,mdss-dsi-t-clk-post = <0x04>;

		qcom,esd-check-enabled;
		qcom,mdss-dsi-panel-status-check-mode="reg_read_irq";
		qcom,mdss-dsi-panel-status-value=<1>;
		qcom,mdss-dsi-panel-status-irq-trigger1="rising";

		qcom,mdss-dsi-on-command = [
					/* < Power Setting Sequence(1) > */
					39 01 00 00 00 00 04 B9 F1 08 00 //EXTC
					39 01 00 00 00 00 08 B1 42 1D 1D A7 33 01 B7 //POWER
					39 01 00 00 00 00 05 E3 05 05 01 02 //SOURCE EQ
					39 01 00 00 0A 00 03 B8 06 22 //EXT POWER
					39 01 00 00 00 00 02 BC 67 //
					39 01 00 00 00 00 06 C0 73 50 00 08 70

					/* < Initializing Sequence(2) > */
					39 01 00 00 00 00 13 BA 31 00 44 25 90 0A 00 00 C2 34 00 00 04 02 4F B5 EE 40 //MIPI CHARACTERISTIC
					39 01 00 00 00 00 04 C6 00 00 FD
					39 01 00 00 00 00 02 CC 02 //DGC
					39 01 00 00 00 00 03 B2 03 20 //PANEL RSO
					39 01 00 00 00 00 02 B4 00//COLVMN INVERTION
					39 01 00 00 00 00 09 B3 00 00 00 00 0A 0A 25 20 //RGB INTERFACE

					//GIP1 TIMMING
					39 01 00 00 00 00 34 E9
									    00 00 04 00 00 2F 2C 12 30 00
									    48 08 2F 2C 47 00 60 00 00 00
									    00 14 88 88 86 64 42 20 00 29
									    00 00 00 87 75 53 31 11 39 00
									    00 00 00 01 00 00 00 00 00 00
									    00
					//GIP2 TIMMING
					39 01 00 00 00 00 25 EA
									    00 00 91 13 35 57 73 18 00 00
									    00 90 02 24 46 62 08 00 30 01
									    00 FF 00 E8 00 00 00 00 00 00
									    00 00 00 00 00 00

					/* < Gamma Setting Sequence(3) > */
					//GAMMA
					39 01 00 00 00 00 23 E0
									    02 1D 24 29 2A 25 25 3B 05 0B
									    0E 11 13 11 13 14 19 0A 1D 24
									    29 2A 35 25 3B 05 0B 0E 11 13
									    11 13 14 19

					//GAMMA
					39 01 00 00 00 00 80 C1
										01 00 08 10 18 20 28 30 38 40
										48 50 58 60 68 70 78 80 88 90
										98 A0 A8 B0 B8 C0 C8 D0 D8 E0
										E8 F0 F8 FF 00 00 00 00 00 00
										00 00 03 00 08 10 18 1F 27 2F
										37 3F 47 4F 57 5E 66 6E 76 7E
										86 8E 97 9E A6 AE B6 BE C5 CD
										D6 DD E5 ED F4 FB 00 00 00 00
										00 00 00 00 03 00 08 10 18 20
										28 30 38 40 48 50 58 60 68 70
										78 80 88 90 98 A0 A8 B0 B8 C0
										C8 D0 D8 E0 E8 F0 F8 FF 00 00
										00 00 00 00 00 00 03

					/* < Display on Sequence> */
					39 01 00 00 00 00 02 C7 80
					39 01 00 00 00 00 03 C8 21 01
					39 01 00 00 00 00 02 53 24

					05 01 00 00 78 00 02 11 00
					05 01 00 00 0A 00 02 29 00
					];

		qcom,mdss-dsi-on-command-state = "dsi_lp_mode";
		qcom,mdss-dsi-off-command-state = "dsi_hs_mode";
		qcom,mdss-dsi-off-command = [39 01 00 00 00 00 02 28 00
					39 01 00 00 78 00 02 10 00];
		samsung,tft-common-support;
		samsung,panel-vendor = "BOE";
		samsung,support_mdnie_lite;

		samsung,tft_pwm_tx_cmds_revA=[
			39 01 00 00 00 00 02 51 FF/*First command should be PWM duty change command*/
		];
		samsung,cabc_on_tx_cmds_revA = [
			39 01 00 00 00 00 02 55 01
		];
		samsung,cabc_off_tx_cmds_revA = [
			39 01 00 00 00 00 02 55 00
		];
		samsung,reg_read_pos_tx_cmds_revA = [ 15 01 00 00 00 00 02 B0 00];
		samsung,packet_size_tx_cmds_revA = [ 37 01 00 00 00 00 02 07 00];

		samsung,manufacture_id0_rx_cmds_revA = [06 01 00 00 00 00 01 da 03 00];
		samsung,manufacture_id1_rx_cmds_revA = [06 01 00 00 00 00 01 db 03 00];
		samsung,manufacture_id2_rx_cmds_revA = [06 01 00 00 00 00 01 dc 03 00];
		/*
		* ************************************************************************************************************************
		* Scaled level to index mappings
		* ************************************************************************************************************************
		*/
	};
};

