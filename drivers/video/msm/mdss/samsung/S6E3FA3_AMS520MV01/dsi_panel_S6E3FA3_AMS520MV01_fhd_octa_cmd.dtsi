/* Copyright (c) 2013-2014, The Linux Foundation. All rights reserved.
 *
 * This program is free software; you can redistribute it and/or modify
 * it under the terms of the GNU General Public License version 2 and
 * only version 2 as published by the Free Software Foundation.
 *
 * This program is distributed in the hope that it will be useful,
 * but WITHOUT ANY WARRANTY; without even the implied warranty of
 * MERCHANTABILITY or FITNESS FOR A PARTICULAR PURPOSE.  See the
 * GNU General Public License for more details.
 */

/*---------------------------------------------------------------------------
 * This file is autogenerated file using gcdb parser. Please do not edit it.
 * Update input XML file to add a new entry or update variable in this file
 * VERSION = "1.0"
 *---------------------------------------------------------------------------*/
&mdss_mdp {
	ss_dsi_panel_S6E3FA3_AMS520MV01_FHD: ss_dsi_panel_S6E3FA3_AMS520MV01_FHD {
		qcom,mdss-dsi-panel-name = "ss_dsi_panel_S6E3FA3_AMS520MV01_FHD";
		qcom,mdss-dsi-panel-controller = <&mdss_dsi0>;
		qcom,mdss-dsi-panel-width = <1080>;
		qcom,mdss-dsi-panel-height = <1920>;
		qcom,mdss-dsi-bpp = <24>;
		qcom,mdss-dsi-panel-destination = "display_1";

		qcom,mdss-dsi-panel-timings = [E6 38 26 00 68 6E 2A 46 2C 03 04 00];

		qcom,mdss-dsi-on-command= [
			05 01 00 00 14 00 02 11 00			/* Sleep out, wait 20ms(0x14) */

			/* TE Vsync On */
			29 01 00 00 00 00 02 35 00

			/* AVC setting */
			29 01 00 00 00 00 03 FC 5A 5A		/* TEST KEY Enable */
			29 01 00 00 00 00 02 B0 1E
			29 01 00 00 00 00 02 FD 94
			29 01 00 00 00 00 03 FC A5 A5

			/* PCD Setting */
			29 01 00 00 00 00 03 FC 5A 5A		/* TEST KEY Enable */
			29 01 00 00 00 00 02 CC 4C
			29 01 00 00 00 00 03 FC A5 A5

			/* ERR_FG Setting */
			29 01 00 00 00 00 03 FC 5A 5A		/* TEST KEY Enable */
			29 01 00 00 00 00 02 ED 44
			29 01 00 00 00 00 03 FC A5 A5

			/* Brightness condition set */
			29 01 00 00 00 00 03 F0 5A 5A		/* TEST KEY Enable */
			29 01 00 00 00 00 24 CA				/* 1) Gamma 2.2 Setting */
				01 00 01 00 01 00	/* V255 R,G,B */
				80 80 80			/* V203 R,G,B */
				80 80 80			/* V151 R,G,B */
				80 80 80			/* V87 R,G,B */
				80 80 80			/* V51 R,G,B */
				80 80 80			/* V35 R,G,B */
				80 80 80			/* V23 R,G,B */
				80 80 80			/* V11 R,G,B */
				80 80 80			/*  V3 R,G,B */
				00 00 00			/*  V0 R,G,B */
				00 00				/*  VT R,G,B */
			29 01 00 00 00 00 03 B2 00 10		/* AID set : AOR 0% */
			29 01 00 00 00 00 03 B6 BC 0A		/* CAPS ELVSS Set(ACL ON : 0x8C) */
			29 01 00 00 00 00 02 F7 03			/* Gamma, LTPS(AID) update */
			29 01 00 00 50 00 03 F0 A5 A5		/* TEST KEY Disable */

			/* Memory Access */
			05 01 00 00 00 00 02 2C 00
			05 01 00 00 00 00 02 3C 00
		];

		qcom,mdss-dsi-off-command=[
			05 01 00 00 0A 00 02 28 00	/* wait 10ms(0x0A) */
			05 01 00 00 96 00 02 10 00	/* wait 150ms(0x96) */
		];

		qcom,cont-splash-enabled;
		qcom,mdss-dsi-force-clk-lane-hs;
		/*qcom,cmd-sync-wait-broadcast;*/
		/*qcom,cmd-sync-wait-trigger;*/
		/*qcom,mdss-dsi-fbc-enable=*/
		/*qcom,mdss-dsi-fbc-bpp=*/
		/*qcom,mdss-dsi-fbc-packing=*/
		/*qcom,mdss-dsi-fbc-quant-error=*/
		/*qcom,mdss-dsi-fbc-bias=*/
		/*qcom,mdss-dsi-fbc-pat-mode=*/
		/*qcom,mdss-dsi-fbc-vlc-mode=*/
		/*qcom,mdss-dsi-fbc-bflc-mode=*/
		/*qcom,mdss-dsi-fbc-h-line-budget=*/
		/*qcom,mdss-dsi-fbc-budget-ctrl=*/
		/*qcom,mdss-dsi-fbc-block-budget=*/
		/*qcom,mdss-dsi-fbc-lossless-threshold=*/
		/*qcom,mdss-dsi-fbc-lossy-threshold=*/
		/*qcom,mdss-dsi-fbc-rgb-threshold=*/
		/*qcom,mdss-dsi-fbc-lossy-mode-idx=*/

		qcom,mdss-dsi-h-back-porch = <36>;
		qcom,mdss-dsi-h-front-porch = <160>;
		qcom,mdss-dsi-h-pulse-width = <12>;
		qcom,mdss-dsi-h-sync-skew = <0>;
		qcom,mdss-dsi-v-back-porch = <7>;
		qcom,mdss-dsi-v-front-porch = <7>;
		qcom,mdss-dsi-v-pulse-width = <2>;

		qcom,mdss-dsi-h-left-border = <0>;
		qcom,mdss-dsi-h-right-border = <0>;
		qcom,mdss-dsi-v-top-border = <0>;
		qcom,mdss-dsi-v-bottom-border = <0>;

		qcom,mdss-dsi-underflow-color = <0xFF>;
		qcom,mdss-dsi-border-color = <0>;

		/*qcom,mdss-dsi-pan-enable-dynamic-fps=*/
		/*qcom,mdss-dsi-pan-fps-update=*/

		qcom,mdss-dsi-bl-pmic-control-type = "bl_ctrl_dcs";
		/*qcom,mdss-dsi-bl-pmic-bank-select=*/
		/*qcom,mdss-dsi-bl-pmic-pwm-frequency=*/
		/*qcom,mdss-dsi-pwm-gpio=*/

		qcom,mdss-dsi-bl-min-level = <0>;
		qcom,mdss-dsi-bl-max-level = <365>;
		qcom,mdss-brightness-max-level = <365>;
		qcom,mdss-dsi-interleave-mode = <0>;
		qcom,mdss-dsi-panel-type = "dsi_cmd_mode";

		qcom,mdss-dsi-te-check-enable;
		qcom,mdss-dsi-te-using-te-pin;
		qcom,mdss-dsi-te-pin-select = <1>;

		qcom,mdss-dsi-te-dcs-command = <1>;
		qcom,mdss-dsi-wr-mem-start = <0x2C>;
		qcom,mdss-dsi-wr-mem-continue = <0x3C>;

		/* CMD mode panel doesn't need below stuff */
		qcom,mdss-dsi-h-sync-pulse= <0>;
		/*qcom,mdss-dsi-hfp-power-mode=*/
		/*qcom,mdss-dsi-hbp-power-mode=*/
		/*qcom,mdss-dsi-hsa-power-mode=*/
		/*qcom,mdss-dsi-last-line-interleave=*/
		qcom,mdss-dsi-bllp-eof-power-mode;
		qcom,mdss-dsi-bllp-power-mode;
		qcom,mdss-dsi-traffic-mode= "burst_mode";

		qcom,mdss-dsi-pixel-packing = "loose";

		qcom,mdss-dsi-virtual-channel-id = <0>;
		qcom,mdss-dsi-color-order = "rgb_swap_rgb";
		qcom,mdss-dsi-lane-0-state;
		qcom,mdss-dsi-lane-1-state;
		qcom,mdss-dsi-lane-2-state;
		qcom,mdss-dsi-lane-3-state;
		qcom,mdss-dsi-lane-map = "lane_map_0123";

		qcom,mdss-dsi-t-clk-pre = <0x2B>;
		qcom,mdss-dsi-t-clk-post = <0x02>;

		qcom,mdss-dsi-stream = <0>;
		qcom,mdss-dsi-mdp-trigger = "none";
		qcom,mdss-dsi-dma-trigger = "trigger_sw";
		qcom,mdss-dsi-panel-framerate = <60>;
		qcom,mdss-dsi-panel-clockrate = <850000000>;
		qcom,mdss-dsi-on-command-state = "dsi_lp_mode";
		qcom,mdss-dsi-off-command-state = "dsi_hs_mode";

		qcom,mdss-pan-physical-width-dimension = <75>;
		qcom,mdss-pan-physical-height-dimension = <132>;

		qcom,mdss-dsi-panel-mode-gpio-state = "invalid";

		qcom,mdss-dsi-reset-sequence = <1 5>, <0 5>, <1 5>;

		/* S6E3FA3(LDI) Does not support Partial Update */
		/*qcom,partial-update-enabled;*/
		/*qcom,panel-roi-alignment=<8 8 1 1 1 1>;*/
		/*qcom,mdss-dsi-horizontal-line-idle*/

		qcom,mdss-dsi-lp11-init;
		qcom,mdss-dsi-init-delay-us = <1000>;

		qcom,mdss-dsi-rx-eot-ignore;
		qcom,mdss-dsi-tx-eot-append;
		qcom,esd_irq_gpio = <&tlmm 41 0>; 
		qcom,ulps-enabled;
		/*qcom,mdss-dsi-panel-status-command=*/
		/*qcom,mdss-dsi-panel-status-command-mode="dsi_lp_mode";*/
		qcom,esd-check-enabled;
		qcom,mdss-dsi-panel-status-check-mode="reg_read_irq";
		qcom,mdss-dsi-panel-status-value = <1>;
		qcom,mdss-dsi-panel-status-irq-trigger="rising";
		/*qcom,dynamic-mode-switch-enabled*/
		/*qcom,video-to-cmd-mode-switch-commands=*/
		/*qcom,cmd-to-video-mode-switch-commands=*/
/*
 * ************************************************************************************************************************************
 *
 *
 *			Below  parameters are samsung dependent thigs
 *
 *
 * ************************************************************************************************************************************
 */
		samsung,enter_hbm_lux = <10000>;
 		samsung,support_panel_max = <1>;
		samsung,hw-config = "single_dsi";
		samsung,panel-lpm-enable;
		samsung,support_mdnie_lite;

		samsung,display_on_tx_cmds_revA = [05 01 00 00 00 00 02 29 00];
		samsung,display_off_tx_cmds_revA = [05 01 00 00 00 00 02 28 00];

		samsung,level1_key_enable_tx_cmds_revA = [
			29 01 00 00 00 00 03 F0 5A 5A
		];
		samsung,level1_key_disable_tx_cmds_revA = [
			29 01 00 00 00 00 03 F0 A5 A5
		];
		samsung,level2_key_enable_tx_cmds_revA = [
			29 00 00 00 00 00 03 F0 5A 5A
			29 01 00 00 00 00 03 FC 5A 5A
		];
		samsung,level2_key_disable_tx_cmds_revA = [
			29 00 00 00 00 00 03 F0 A5 A5
			29 01 00 00 00 00 03 FC A5 A5
		];

		samsung,packet_size_tx_cmds_revA = [
			37 01 00 00 00 00 02 07 00
		];

		/*
		 * First parameters can be changed
		 * by function of samsung_nv_read()
		 * because of that means offset of
		 * read position
		 */
		samsung,reg_read_pos_tx_cmds_revA = [
			15 01 00 00 00 00 02 B0 00
		];


		/*
		 * ************************************************************************************************************************
		 *	 06 01 00 00 00 00 01 c8 07 21
		 *	READ 0xC8 SIZE 0x07 OFFSET 0x21
		 * ************************************************************************************************************************
		 */
		samsung,smart_dimming_mtp_rx_cmds_revA = [ 06 01 00 00 00 00 01 c8 23 00];
		/* the last byte in all read commands will represent READ LENGH */
		samsung,manufacture_id0_rx_cmds_revA = [ 06 01 00 00 00 00 01 da 01 00];
		samsung,manufacture_id1_rx_cmds_revA = [ 06 01 00 00 00 00 01 db 01 00];
		samsung,manufacture_id2_rx_cmds_revA = [ 06 01 00 00 00 00 01 dc 01 00];

		samsung,manufacture_date_rx_cmds_revA = [ 06 01 00 00 00 00 01 c8 04 28];	/* read C8 41~44th , 40=0x28*/
		samsung,ddi_id_rx_cmds_revA = [ 06 01 00 00 00 00 01 d6 05 00];	/* read D6 1~5th */
		samsung,cell_id_rx_cmds_revA = [ 06 01 00 00 00 00 01 C8 07 28]; /* read C8 41th~47th */
		samsung,octa_id_rx_cmds_revA = [ 06 01 00 00 00 00 01 D6 05 28]; /* read C8 41th~47th */
		samsung,mtp_read_sysfs_rx_cmds_revA = [ 06 01 00 00 00 00 01 01 01 01];

		samsung,elvss_rx_cmds_revA = [ 06 01 00 00 00 00 01 b6 02 15];	/* read B6 22th~23 , 21=0x15*/
		samsung,mdnie_read_rx_cmds_revA	= [ 06 01 00 00 00 00 01 A1 04 00];

		samsung,ldi_debug0_rx_cmds_revA = [06 01 00 00 00 00 01 0A 01 00];
		samsung,ldi_debug1_rx_cmds_revA = [06 01 00 00 00 00 01 0E 01 00];
		samsung,ldi_debug2_rx_cmds_revA = [06 01 00 00 00 00 01 EA 08 00];
		samsung,hbm_rx_cmds_revA = [ 06 01 00 00 00 00 01 B4 04 00];	/* read B4 1th~4th */
		samsung,hbm2_rx_cmds_revA = [ 06 01 00 00 00 00 01 B4 1D 04];	/* read B4 5th~33th */

		/*
		 * ************************************************************************************************************************
		 *	 COMMON CMD LIST
		 * ************************************************************************************************************************
		 */

		samsung,elvss_lowtemp_tx_cmds_revA = [
			29 01 00 00 00 00 02 B8 19
		];	/* Low Temperature Command */

		samsung,elvss_lowtemp2_tx_cmds_revA = [
			29 01 00 00 00 00 02 B0 15
			29 01 00 00 00 00 02 B6 00
		];	/* Low Temperature Command: default */

		samsung,gamma_tx_cmds_revA = [
			29 01 00 00 00 00 24 CA				/* 1) Gamma 2.2 Setting */
				01 00 01 00 01 00	/* V255 R,G,B */
				80 80 80			/* V203 R,G,B */
				80 80 80			/* V151 R,G,B */
				80 80 80			/* V87 R,G,B */
				80 80 80			/* V51 R,G,B */
				80 80 80			/* V35 R,G,B */
				80 80 80			/* V23 R,G,B */
				80 80 80			/* V11 R,G,B */
				80 80 80			/*  V3 R,G,B */
				00 00 00			/*  V0 R,G,B */
				00 00				/*  VT R,G,B */
			29 01 00 00 00 00 02 F7 03	/* Gamma, LTPS(AID) update */

			29 01 00 00 00 00 3C		/* dummy for single transmission more 100ns delay */
			00 00 00 00 00 00 00 00 00 00
			00 00 00 00 00 00 00 00 00 00
			00 00 00 00 00 00 00 00 00 00
			00 00 00 00 00 00 00 00 00 00
			00 00 00 00 00 00 00 00 00 00
			00 00 00 00 00 00 00 00 00 00
		];

		samsung,hbm_gamma_tx_cmds_revA = [
			29 01 00 00 00 00 24 CA		/* 1) Gamma 2.2 Setting */
				01 00 01 00 01 00	/* V255 R,G,B */
				80 80 80			/* V203 R,G,B */
				80 80 80			/* V151 R,G,B */
				80 80 80			/* V87 R,G,B */
				80 80 80			/* V51 R,G,B */
				80 80 80			/* V35 R,G,B */
				80 80 80			/* V23 R,G,B */
				80 80 80			/* V11 R,G,B */
				80 80 80			/*  V3 R,G,B */
				00 00 00			/*  V0 R,G,B */
				00 00				/*  VT R,G,B */
			29 01 00 00 00 00 03 B2 00 10		/* AID set : AOR 0% */
			29 01 00 00 00 00 02 F7 03			/* Gamma, LTPS(AID) update */
		];

		samsung,hbm_etc_tx_cmds_revA = [		/* for HBM interpolation: 465~578nit */
			29 01 00 00 00 00 03 B6 BC 04		/* HBM ELVSS */
			29 01 00 00 00 00 02 B0 15
			29 01 00 00 00 00 02 B6 00
			29 01 00 00 00 00 05 B5 50 99 14 0A  	/* 1th : 0x50 32frame avg, 2th : 0x7F start point 50%, 4th: 0x0A ACL 8% */
			29 01 00 00 00 00 02 53 00				/* HBM Off */
			29 01 00 00 00 00 02 55 02				/* ACL ON */
		];

		samsung,hbm_etc2_tx_cmds_revA = [ 	/* for HBM pure mode : 600nit */
			29 01 00 00 00 00 03 B6 BC 04		/* HBM ELVSS */
			29 01 00 00 00 00 05 B5 50 99 14 0A  	/* 1th : 0x50 32frame avg, 2th : 0x7F start point 50%, 4th: 0x0A ACL 8% */
			29 01 00 00 00 00 02 55 02			/* ACL on*/
			29 01 00 00 00 00 02 53 C0		/* HBM On : elvss acl auto */
		];

		samsung,hbm_off_tx_cmds_revA = [
			29 01 00 00 00 00 02 53 00		/* HBM Off */
		];


		/*
		 * ************************************************************************************************************************
		 * AID command list and mappings
		 * ************************************************************************************************************************
		 */
		/* bl_level, Index in acl command list */
		samsung,aid_tx_cmds_revA = [
			/*	0	*/29 01 00 00 00 00 03 B2 70 73	/*   2CD */
			/*	1	*/29 01 00 00 00 00 03 B2 70 65 /*   3CD */
			/*	2	*/29 01 00 00 00 00 03 B2 70 55 /*   4CD */
			/*	3	*/29 01 00 00 00 00 03 B2 70 46 /*   5CD */
			/*	4	*/29 01 00 00 00 00 03 B2 70 37 /*   6CD */
			/*	5	*/29 01 00 00 00 00 03 B2 70 27 /*   7CD */
			/*	6	*/29 01 00 00 00 00 03 B2 70 17 /*   8CD */
			/*	7	*/29 01 00 00 00 00 03 B2 70 07 /*   9CD */
			/*	8	*/29 01 00 00 00 00 03 B2 60 F7 /*  10CD */
			/*	9	*/29 01 00 00 00 00 03 B2 60 E7 /*  11CD */
			/*	10	*/29 01 00 00 00 00 03 B2 60 D7 /*  12CD */
			/*	11	*/29 01 00 00 00 00 03 B2 60 D1 /*  13CD */
			/*	12	*/29 01 00 00 00 00 03 B2 60 B7 /*  14CD */
			/*	13	*/29 01 00 00 00 00 03 B2 60 B1 /*  15CD */
			/*	14	*/29 01 00 00 00 00 03 B2 60 A1 /*  16CD */
			/*	15	*/29 01 00 00 00 00 03 B2 60 91 /*  17CD */
			/*	16	*/29 01 00 00 00 00 03 B2 60 71 /*  19CD */
			/*	17	*/29 01 00 00 00 00 03 B2 60 61 /*  20CD */
			/*	18	*/29 01 00 00 00 00 03 B2 60 51 /*  21CD */
			/*	19	*/29 01 00 00 00 00 03 B2 60 42 /*  22CD */
			/*	20	*/29 01 00 00 00 00 03 B2 60 22 /*  24CD */
			/*	21	*/29 01 00 00 00 00 03 B2 60 12 /*  25CD */
			/*	22	*/29 01 00 00 00 00 03 B2 50 F3 /*  27CD */
			/*	23	*/29 01 00 00 00 00 03 B2 50 D3 /*  29CD */
			/*	24	*/29 01 00 00 00 00 03 B2 50 C3 /*  30CD */
			/*	25	*/29 01 00 00 00 00 03 B2 50 A3 /*  32CD */
			/*	26	*/29 01 00 00 00 00 03 B2 50 83 /*  34CD */
			/*	27	*/29 01 00 00 00 00 03 B2 50 53 /*  37CD */
			/*	28	*/29 01 00 00 00 00 03 B2 50 33 /*  39CD */
			/*	29	*/29 01 00 00 00 00 03 B2 50 13 /*  41CD */
			/*	30	*/29 01 00 00 00 00 03 B2 40 E2 /*  44CD */
			/*	31	*/29 01 00 00 00 00 03 B2 40 B2 /*  47CD */
			/*	32	*/29 01 00 00 00 00 03 B2 40 82 /*  50CD */
			/*	33	*/29 01 00 00 00 00 03 B2 40 51 /*  53CD */
			/*	34	*/29 01 00 00 00 00 03 B2 40 17 /*  56CD */
			/*	35	*/29 01 00 00 00 00 03 B2 30 E0 /*  60CD */
			/*	36	*/29 01 00 00 00 00 03 B2 30 95 /*  64CD */
			/*	37	*/29 01 00 00 00 00 03 B2 30 52 /*  68CD */
			/*	38	*/29 01 00 00 00 00 03 B2 30 11 /*  77CD */
			/*	39	*/29 01 00 00 00 00 03 B2 20 C4 /*  77 ~ 183CD*/
			/*	40	*/29 01 00 00 00 00 03 B2 20 67 /* 195CD */
			/*	41	*/29 01 00 00 00 00 03 B2 20 05 /* 207CD */
			/*	42	*/29 01 00 00 00 00 03 B2 10 97 /* 220CD */
			/*	43	*/29 01 00 00 00 00 03 B2 10 25 /* 234CD */
			/*	44	*/29 01 00 00 00 00 03 B2 00 C1 /* 249~365CD */
			/*	45	*/29 01 00 00 00 00 03 B2 00 AF /* 372 CD */
			/*	46	*/29 01 00 00 00 00 03 B2 00 79 /* 380 CD */
			/*	47	*/29 01 00 00 00 00 03 B2 00 6D /* 387 CD */
			/*	48	*/29 01 00 00 00 00 03 B2 00 43 /* 395 CD */
			/*	49	*/29 01 00 00 00 00 03 B2 00 33 /* 403 CD */
			/*	50	*/29 01 00 00 00 00 03 B2 00 21 /* 412 CD */
			/*	51	*/29 01 00 00 00 00 03 B2 00 10 /* 420 CD */
		];


		/* bl_level, Index in acl command list */
		samsung,aid_map_table_revA = <
			2	0		3	1		4	2		5	3		6	4
			7	5		8	6		9	7		10	8		11	9
			12	10		13	11		14	12		15	13		16	14
			17	15		19	16		20	17		21	18		22	19
			24	20		25	21		27	22		29	23		30	24
			32	25		34	26		37	27		39	28		41	29
			44	30		47	31		50	32		53	33		56	34
			60	35		64	36		68	37		72	38		77	39
			82	39		87	39		93	39		98	39		105	39
			111	39		119	39		126	39		134	39		143	39
			152	39		162	39		172	39		183	39		195	40
			207	41		220	42		234	43		249	44		265	44
			282	44		300	44		316	44		333	44		350	44
			357	44		365	44		372	45		380	46		387	47
			395	48		403	49		412	50		420	51
		>;

		samsung,aid_subdivision_tx_cmds_revA = [
			/*	0	*/	29	01	00	00	00	00	03	B2	70	73	/*	2	*/
			/*	1	*/	29	01	00	00	00	00	03	B2	70	71	/*	3	*/
			/*	2	*/	29	01	00	00	00	00	03	B2	70	6C	/*	3.5	*/
			/*	3	*/	29	01	00	00	00	00	03	B2	70	67	/*	4	*/
			/*	4	*/	29	01	00	00	00	00	03	B2	70	65	/*	5	*/
			/*	5	*/	29	01	00	00	00	00	03	B2	70	63	/*	6	*/
			/*	6	*/	29	01	00	00	00	00	03	B2	70	61	/*	7	*/
			/*	7	*/	29	01	00	00	00	00	03	B2	70	57	/*	8	*/
			/*	8	*/	29	01	00	00	00	00	03	B2	70	55	/*	9	*/
			/*	9	*/	29	01	00	00	00	00	03	B2	70	53	/*	10	*/
			/*	10	*/	29	01	00	00	00	00	03	B2	70	51	/*	11	*/
			/*	11	*/	29	01	00	00	00	00	03	B2	70	47	/*	12	*/
			/*	12	*/	29	01	00	00	00	00	03	B2	70	46	/*	13	*/
			/*	13	*/	29	01	00	00	00	00	03	B2	70	45	/*	14	*/
			/*	14	*/	29	01	00	00	00	00	03	B2	70	42	/*	15	*/
			/*	15	*/	29	01	00	00	00	00	03	B2	70	41	/*	16	*/
			/*	16	*/	29	01	00	00	00	00	03	B2	70	37	/*	17	*/
			/*	17	*/	29	01	00	00	00	00	03	B2	70	35	/*	18	*/
			/*	18	*/	29	01	00	00	00	00	03	B2	70	33	/*	19	*/
			/*	19	*/	29	01	00	00	00	00	03	B2	70	31	/*	20	*/
			/*	20	*/	29	01	00	00	00	00	03	B2	70	27	/*	21	*/
			/*	21	*/	29	01	00	00	00	00	03	B2	70	25	/*	22	*/
			/*	22	*/	29	01	00	00	00	00	03	B2	70	22	/*	24	*/
			/*	23	*/	29	01	00	00	00	00	03	B2	70	21	/*	25	*/
			/*	24	*/	29	01	00	00	00	00	03	B2	70	17	/*	26	*/
			/*	25	*/	29	01	00	00	00	00	03	B2	70	15	/*	27	*/
			/*	26	*/	29	01	00	00	00	00	03	B2	70	13	/*	29	*/
			/*	27	*/	29	01	00	00	00	00	03	B2	70	11	/*	30	*/
			/*	28	*/	29	01	00	00	00	00	03	B2	70	07	/*	31	*/
			/*	29	*/	29	01	00	00	00	00	03	B2	70	05	/*	32	*/
			/*	30	*/	29	01	00	00	00	00	03	B2	70	03	/*	33	*/
			/*	31	*/	29	01	00	00	00	00	03	B2	70	01	/*	34	*/
			/*	32	*/	29	01	00	00	00	00	03	B2	60	F7	/*	35.5	*/
			/*	33	*/	29	01	00	00	00	00	03	B2	60	F5	/*	37	*/
			/*	34	*/	29	01	00	00	00	00	03	B2	60	F3	/*	39	*/
			/*	35	*/	29	01	00	00	00	00	03	B2	60	F1	/*	40	*/
			/*	36	*/	29	01	00	00	00	00	03	B2	60	E7	/*	41	*/
			/*	37	*/	29	01	00	00	00	00	03	B2	60	E5	/*	42.5	*/
			/*	38	*/	29	01	00	00	00	00	03	B2	60	E3	/*	44	*/
			/*	39	*/	29	01	00	00	00	00	03	B2	60	E1	/*	45	*/
			/*	40	*/	29	01	00	00	00	00	03	B2	60	D7	/*	46	*/
			/*	41	*/	29	01	00	00	00	00	03	B2	60	D5	/*	47	*/
			/*	42	*/	29	01	00	00	00	00	03	B2	60	D3	/*	48.5	*/
			/*	43	*/	29	01	00	00	00	00	03	B2	60	D1	/*	50	*/
			/*	44	*/	29	01	00	00	00	00	03	B2	60	C7	/*	51.5	*/
			/*	45	*/	29	01	00	00	00	00	03	B2	60	C1	/*	53	*/
			/*	46	*/	29	01	00	00	00	00	03	B2	60	B7	/*	54.5	*/
			/*	47	*/	29	01	00	00	00	00	03	B2	60	B4	/*	56	*/
			/*	48	*/	29	01	00	00	00	00	03	B2	60	B1	/*	57.33333333	*/
			/*	49	*/	29	01	00	00	00	00	03	B2	60	A9	/*	58.66666667	*/
			/*	50	*/	29	01	00	00	00	00	03	B2	60	A1	/*	60	*/
			/*	51	*/	29	01	00	00	00	00	03	B2	60	99	/*	61.33333333	*/
			/*	52	*/	29	01	00	00	00	00	03	B2	60	91	/*	62.66666667	*/
			/*	53	*/	29	01	00	00	00	00	03	B2	60	81	/*	64	*/
			/*	54	*/	29	01	00	00	00	00	03	B2	60	71	/*	65.33333333	*/
			/*	55	*/	29	01	00	00	00	00	03	B2	60	69	/*	66.66666667	*/
			/*	56	*/	29	01	00	00	00	00	03	B2	60	61	/*	68	*/
			/*	57	*/	29	01	00	00	00	00	03	B2	60	59	/*	70	*/
			/*	58	*/	29	01	00	00	00	00	03	B2	60	51	/*	72	*/
			/*	59	*/	29	01	00	00	00	00	03	B2	60	4A	/*	73.25	*/
			/*	60	*/	29	01	00	00	00	00	03	B2	60	42	/*	74.5	*/
			/*	61	*/	29	01	00	00	00	00	03	B2	60	32	/*	75.75	*/
			/*	62	*/	29	01	00	00	00	00	03	B2	60	22	/*	77	*/
			/*	63	*/	29	01	00	00	00	00	03	B2	60	1A	/*	78.66666667	*/
			/*	64	*/	29	01	00	00	00	00	03	B2	60	12	/*	80.33333333	*/
			/*	65	*/	29	01	00	00	00	00	03	B2	60	03	/*	82	*/
			/*	66	*/	29	01	00	00	00	00	03	B2	50	F3	/*	83.25	*/
			/*	67	*/	29	01	00	00	00	00	03	B2	50	E3	/*	84.5	*/
			/*	68	*/	29	01	00	00	00	00	03	B2	50	D3	/*	85.75	*/
			/*	69	*/	29	01	00	00	00	00	03	B2	50	CB	/*	87	*/
			/*	70	*/	29	01	00	00	00	00	03	B2	50	C3	/*	88.5	*/
			/*	71	*/	29	01	00	00	00	00	03	B2	50	B3	/*	90	*/
			/*	72	*/	29	01	00	00	00	00	03	B2	50	A3	/*	91.5	*/
			/*	73	*/	29	01	00	00	00	00	03	B2	50	93	/*	93	*/
			/*	74	*/	29	01	00	00	00	00	03	B2	50	83	/*	94.66666667	*/
			/*	75	*/	29	01	00	00	00	00	03	B2	50	6B	/*	96.33333333	*/
			/*	76	*/	29	01	00	00	00	00	03	B2	50	53	/*	98	*/
			/*	77	*/	29	01	00	00	00	00	03	B2	50	43	/*	99.75	*/
			/*	78	*/	29	01	00	00	00	00	03	B2	50	33	/*	101.5	*/
			/*	79	*/	29	01	00	00	00	00	03	B2	50	23	/*	103.25	*/
			/*	80	*/	29	01	00	00	00	00	03	B2	50	13	/*	105	*/
			/*	81	*/	29	01	00	00	00	00	03	B2	40	FA	/*	106.5	*/
			/*	82	*/	29	01	00	00	00	00	03	B2	40	E2	/*	108	*/
			/*	83	*/	29	01	00	00	00	00	03	B2	40	CA	/*	109.5	*/
			/*	84	*/	29	01	00	00	00	00	03	B2	40	B2	/*	111	*/
			/*	85	*/	29	01	00	00	00	00	03	B2	40	9A	/*	112.6	*/
			/*	86	*/	29	01	00	00	00	00	03	B2	40	82	/*	114.2	*/
			/*	87	*/	29	01	00	00	00	00	03	B2	40	69	/*	115.8	*/
			/*	88	*/	29	01	00	00	00	00	03	B2	40	51	/*	117.4	*/
			/*	89	*/	29	01	00	00	00	00	03	B2	40	34	/*	119	*/
			/*	90	*/	29	01	00	00	00	00	03	B2	40	17	/*	120.4	*/
			/*	91	*/	29	01	00	00	00	00	03	B2	30	FB	/*	121.8	*/
			/*	92	*/	29	01	00	00	00	00	03	B2	30	E0	/*	123.2	*/
			/*	93	*/	29	01	00	00	00	00	03	B2	30	BA	/*	124.6	*/
			/*	94	*/	29	01	00	00	00	00	03	B2	30	95	/*	126	*/
			/*	95	*/	29	01	00	00	00	00	03	B2	30	74	/*	127.6	*/
			/*	96	*/	29	01	00	00	00	00	03	B2	30	52	/*	129.2	*/
			/*	97	*/	29	01	00	00	00	00	03	B2	30	32	/*	130.8	*/
			/*	98	*/	29	01	00	00	00	00	03	B2	30	11	/*	132.4	*/
			/*	99	*/	29	01	00	00	00	00	03	B2	20	FE	/*	134	*/
			/*	100	*/	29	01	00	00	00	00	03	B2	20	D7	/*	135.8	*/
			/*	101	*/	29	01	00	00	00	00	03	B2	20	FC	/*	137.6	*/
			/*	102	*/	29	01	00	00	00	00	03	B2	20	D7	/*	139.4	*/
			/*	103	*/	29	01	00	00	00	00	03	B2	20	FA	/*	141.2	*/
			/*	104	*/	29	01	00	00	00	00	03	B2	20	D7	/*	143	*/
			/*	105	*/	29	01	00	00	00	00	03	B2	20	FE	/*	144.5	*/
			/*	106	*/	29	01	00	00	00	00	03	B2	20	D7	/*	146	*/
			/*	107	*/	29	01	00	00	00	00	03	B2	20	F6	/*	147.5	*/
			/*	108	*/	29	01	00	00	00	00	03	B2	20	D7	/*	149	*/
			/*	109	*/	29	01	00	00	00	00	03	B2	20	FF	/*	150.5	*/
			/*	110	*/	29	01	00	00	00	00	03	B2	20	D7	/*	152	*/
			/*	111	*/	29	01	00	00	00	00	03	B2	20	F8	/*	153.6666667	*/
			/*	112	*/	29	01	00	00	00	00	03	B2	20	D7	/*	155.3333333	*/
			/*	113	*/	29	01	00	00	00	00	03	B2	30	00	/*	157	*/
			/*	114	*/	29	01	00	00	00	00	03	B2	20	D7	/*	158.6666667	*/
			/*	115	*/	29	01	00	00	00	00	03	B2	20	F9	/*	160.3333333	*/
			/*	116	*/	29	01	00	00	00	00	03	B2	20	D7	/*	162	*/
			/*	117	*/	29	01	00	00	00	00	03	B2	20	FB	/*	164	*/
			/*	118	*/	29	01	00	00	00	00	03	B2	20	D7	/*	166	*/
			/*	119	*/	29	01	00	00	00	00	03	B2	20	FD	/*	168	*/
			/*	120	*/	29	01	00	00	00	00	03	B2	20	D7	/*	170	*/
			/*	121	*/	29	01	00	00	00	00	03	B2	20	FB	/*	172	*/
			/*	122	*/	29	01	00	00	00	00	03	B2	20	D7	/*	173.5714286	*/
			/*	123	*/	29	01	00	00	00	00	03	B2	20	FC	/*	175.1428571	*/
			/*	124	*/	29	01	00	00	00	00	03	B2	20	D7	/*	176.7142857	*/
			/*	125	*/	29	01	00	00	00	00	03	B2	20	FA	/*	178.2857143	*/
			/*	126	*/	29	01	00	00	00	00	03	B2	20	D7	/*	179.8571429	*/
			/*	127	*/	29	01	00	00	00	00	03	B2	20	FB	/*	181.4285714	*/
			/*	128	*/	29	01	00	00	00	00	03	B2	20	D7	/*	183	*/
			/*	129	*/	29	01	00	00	00	00	03	B2	20	C7	/*	184.7142857	*/
			/*	130	*/	29	01	00	00	00	00	03	B2	20	B7	/*	186.4285714	*/
			/*	131	*/	29	01	00	00	00	00	03	B2	20	A7	/*	188.1428571	*/
			/*	132	*/	29	01	00	00	00	00	03	B2	20	97	/*	189.8571429	*/
			/*	133	*/	29	01	00	00	00	00	03	B2	20	87	/*	191.5714286	*/
			/*	134	*/	29	01	00	00	00	00	03	B2	20	77	/*	193.2857143	*/
			/*	135	*/	29	01	00	00	00	00	03	B2	20	67	/*	195	*/
			/*	136	*/	29	01	00	00	00	00	03	B2	20	59	/*	196.7142857	*/
			/*	137	*/	29	01	00	00	00	00	03	B2	20	4B	/*	198.4285714	*/
			/*	138	*/	29	01	00	00	00	00	03	B2	20	3D	/*	200.1428571	*/
			/*	139	*/	29	01	00	00	00	00	03	B2	20	2F	/*	201.8571429	*/
			/*	140	*/	29	01	00	00	00	00	03	B2	20	21	/*	203.5714286	*/
			/*	141	*/	29	01	00	00	00	00	03	B2	20	13	/*	205.2857143	*/
			/*	142	*/	29	01	00	00	00	00	03	B2	20	05	/*	207	*/
			/*	143	*/	29	01	00	00	00	00	03	B2	10	F5	/*	208.8571429	*/
			/*	144	*/	29	01	00	00	00	00	03	B2	10	E6	/*	210.7142857	*/
			/*	145	*/	29	01	00	00	00	00	03	B2	10	D6	/*	212.5714286	*/
			/*	146	*/	29	01	00	00	00	00	03	B2	10	C6	/*	214.4285714	*/
			/*	147	*/	29	01	00	00	00	00	03	B2	10	B7	/*	216.2857143	*/
			/*	148	*/	29	01	00	00	00	00	03	B2	10	A7	/*	218.1428571	*/
			/*	149	*/	29	01	00	00	00	00	03	B2	10	97	/*	220	*/
			/*	150	*/	29	01	00	00	00	00	03	B2	10	89	/*	221.75	*/
			/*	151	*/	29	01	00	00	00	00	03	B2	10	7A	/*	223.5	*/
			/*	152	*/	29	01	00	00	00	00	03	B2	10	6C	/*	225.25	*/
			/*	153	*/	29	01	00	00	00	00	03	B2	10	5E	/*	227	*/
			/*	154	*/	29	01	00	00	00	00	03	B2	10	50	/*	228.75	*/
			/*	155	*/	29	01	00	00	00	00	03	B2	10	42	/*	230.5	*/
			/*	156	*/	29	01	00	00	00	00	03	B2	10	33	/*	232.25	*/
			/*	157	*/	29	01	00	00	00	00	03	B2	10	25	/*	234	*/
			/*	158	*/	29	01	00	00	00	00	03	B2	10	33	/*	235.875	*/
			/*	159	*/	29	01	00	00	00	00	03	B2	10	26	/*	237.75	*/
			/*	160	*/	29	01	00	00	00	00	03	B2	10	19	/*	239.625	*/
			/*	161	*/	29	01	00	00	00	00	03	B2	10	0C	/*	241.5	*/
			/*	162	*/	29	01	00	00	00	00	03	B2	00	FF	/*	243.375	*/
			/*	163	*/	29	01	00	00	00	00	03	B2	00	F2	/*	245.25	*/
			/*	164	*/	29	01	00	00	00	00	03	B2	00	E5	/*	247.125	*/
			/*	165	*/	29	01	00	00	00	00	03	B2	00	D8	/*	249	*/
			/*	166	*/	29	01	00	00	00	00	03	B2	10	34	/*	250.7777778	*/
			/*	167	*/	29	01	00	00	00	00	03	B2	10	29	/*	252.5555556	*/
			/*	168	*/	29	01	00	00	00	00	03	B2	10	1D	/*	254.3333333	*/
			/*	169	*/	29	01	00	00	00	00	03	B2	10	12	/*	256.1111111	*/
			/*	170	*/	29	01	00	00	00	00	03	B2	10	06	/*	257.8888889	*/
			/*	171	*/	29	01	00	00	00	00	03	B2	00	FB	/*	259.6666667	*/
			/*	172	*/	29	01	00	00	00	00	03	B2	00	EF	/*	261.4444444	*/
			/*	173	*/	29	01	00	00	00	00	03	B2	00	E4	/*	263.2222222	*/
			/*	174	*/	29	01	00	00	00	00	03	B2	00	D8	/*	265	*/
			/*	175	*/	29	01	00	00	00	00	03	B2	10	34	/*	266.8888889	*/
			/*	176	*/	29	01	00	00	00	00	03	B2	10	29	/*	268.7777778	*/
			/*	177	*/	29	01	00	00	00	00	03	B2	10	1D	/*	270.6666667	*/
			/*	178	*/	29	01	00	00	00	00	03	B2	10	12	/*	272.5555556	*/
			/*	179	*/	29	01	00	00	00	00	03	B2	10	06	/*	274.4444444	*/
			/*	180	*/	29	01	00	00	00	00	03	B2	00	FB	/*	276.3333333	*/
			/*	181	*/	29	01	00	00	00	00	03	B2	00	EF	/*	278.2222222	*/
			/*	182	*/	29	01	00	00	00	00	03	B2	00	E4	/*	280.1111111	*/
			/*	183	*/	29	01	00	00	00	00	03	B2	00	D8	/*	282	*/
			/*	184	*/	29	01	00	00	00	00	03	B2	10	35	/*	283.8	*/
			/*	185	*/	29	01	00	00	00	00	03	B2	10	2B	/*	285.6	*/
			/*	186	*/	29	01	00	00	00	00	03	B2	10	20	/*	287.4	*/
			/*	187	*/	29	01	00	00	00	00	03	B2	10	16	/*	289.2	*/
			/*	188	*/	29	01	00	00	00	00	03	B2	10	0C	/*	291	*/
			/*	189	*/	29	01	00	00	00	00	03	B2	10	01	/*	292.8	*/
			/*	190	*/	29	01	00	00	00	00	03	B2	00	F7	/*	294.6	*/
			/*	191	*/	29	01	00	00	00	00	03	B2	00	ED	/*	296.4	*/
			/*	192	*/	29	01	00	00	00	00	03	B2	00	E2	/*	298.2	*/
			/*	193	*/	29	01	00	00	00	00	03	B2	00	D8	/*	300	*/
			/*	194	*/	29	01	00	00	00	00	03	B2	10	24	/*	302	*/
			/*	195	*/	29	01	00	00	00	00	03	B2	10	19	/*	304	*/
			/*	196	*/	29	01	00	00	00	00	03	B2	10	0E	/*	306	*/
			/*	197	*/	29	01	00	00	00	00	03	B2	10	04	/*	308	*/
			/*	198	*/	29	01	00	00	00	00	03	B2	00	F9	/*	310	*/
			/*	199	*/	29	01	00	00	00	00	03	B2	00	EE	/*	312	*/
			/*	200	*/	29	01	00	00	00	00	03	B2	00	E3	/*	314	*/
			/*	201	*/	29	01	00	00	00	00	03	B2	00	D8	/*	316	*/
			/*	202	*/	29	01	00	00	00	00	03	B2	10	26	/*	317.8888889	*/
			/*	203	*/	29	01	00	00	00	00	03	B2	10	1C	/*	319.7777778	*/
			/*	204	*/	29	01	00	00	00	00	03	B2	10	13	/*	321.6666667	*/
			/*	205	*/	29	01	00	00	00	00	03	B2	10	09	/*	323.5555556	*/
			/*	206	*/	29	01	00	00	00	00	03	B2	00	FF	/*	325.4444444	*/
			/*	207	*/	29	01	00	00	00	00	03	B2	00	F5	/*	327.3333333	*/
			/*	208	*/	29	01	00	00	00	00	03	B2	00	EC	/*	329.2222222	*/
			/*	209	*/	29	01	00	00	00	00	03	B2	00	E2	/*	331.1111111	*/
			/*	210	*/	29	01	00	00	00	00	03	B2	00	D8	/*	333	*/
			/*	211	*/	29	01	00	00	00	00	03	B2	10	22	/*	334.8888889	*/
			/*	212	*/	29	01	00	00	00	00	03	B2	10	19	/*	336.7777778	*/
			/*	213	*/	29	01	00	00	00	00	03	B2	10	10	/*	338.6666667	*/
			/*	214	*/	29	01	00	00	00	00	03	B2	10	06	/*	340.5555556	*/
			/*	215	*/	29	01	00	00	00	00	03	B2	00	FD	/*	342.4444444	*/
			/*	216	*/	29	01	00	00	00	00	03	B2	00	F4	/*	344.3333333	*/
			/*	217	*/	29	01	00	00	00	00	03	B2	00	EB	/*	346.2222222	*/
			/*	218	*/	29	01	00	00	00	00	03	B2	00	E1	/*	348.1111111	*/
			/*	219	*/	29	01	00	00	00	00	03	B2	00	D8	/*	350	*/
			/*	220	*/	29	01	00	00	00	00	03	B2	00	F1	/*	351.75	*/
			/*	221	*/	29	01	00	00	00	00	03	B2	00	E9	/*	353.5	*/
			/*	222	*/	29	01	00	00	00	00	03	B2	00	E0	/*	355.25	*/
			/*	223	*/	29	01	00	00	00	00	03	B2	00	D8	/*	357	*/
			/*	224	*/	29	01	00	00	00	00	03	B2	00	F4	/*	359	*/
			/*	225	*/	29	01	00	00	00	00	03	B2	00	EB	/*	361	*/
			/*	226	*/	29	01	00	00	00	00	03	B2	00	E1	/*	363	*/
			/*	227	*/	29	01	00	00	00	00	03	B2	00	D8	/*	365	*/
			/*	228	*/	29	01	00	00	00	00	03	B2	00	CC	/*	367.3333333	*/
			/*	229	*/	29	01	00	00	00	00	03	B2	00	BF	/*	369.6666667	*/
			/*	230	*/	29	01	00	00	00	00	03	B2	00	B3	/*	372	*/
			/*	231	*/	29	01	00	00	00	00	03	B2	00	A7	/*	374	*/
			/*	232	*/	29	01	00	00	00	00	03	B2	00	9B	/*	376	*/
			/*	233	*/	29	01	00	00	00	00	03	B2	00	90	/*	378	*/
			/*	234	*/	29	01	00	00	00	00	03	B2	00	84	/*	380	*/
			/*	235	*/	29	01	00	00	00	00	03	B2	00	79	/*	381.75	*/
			/*	236	*/	29	01	00	00	00	00	03	B2	00	6E	/*	383.5	*/
			/*	237	*/	29	01	00	00	00	00	03	B2	00	63	/*	385.25	*/
			/*	238	*/	29	01	00	00	00	00	03	B2	00	58	/*	387	*/
			/*	239	*/	29	01	00	00	00	00	03	B2	00	4E	/*	389	*/
			/*	240	*/	29	01	00	00	00	00	03	B2	00	44	/*	391	*/
			/*	241	*/	29	01	00	00	00	00	03	B2	00	3A	/*	393	*/
			/*	242	*/	29	01	00	00	00	00	03	B2	00	30	/*	395	*/
			/*	243	*/	29	01	00	00	00	00	03	B2	00	2D	/*	397	*/
			/*	244	*/	29	01	00	00	00	00	03	B2	00	23	/*	399	*/
			/*	245	*/	29	01	00	00	00	00	03	B2	00	1A	/*	401	*/
			/*	246	*/	29	01	00	00	00	00	03	B2	00	10	/*	403	*/
			/*	247	*/	29	01	00	00	00	00	03	B2	00	2F	/*	405.25	*/
			/*	248	*/	29	01	00	00	00	00	03	B2	00	25	/*	407.5	*/
			/*	249	*/	29	01	00	00	00	00	03	B2	00	1A	/*	409.75	*/
			/*	250	*/	29	01	00	00	00	00	03	B2	00	10	/*	412	*/
			/*	251	*/	29	01	00	00	00	00	03	B2	00	2B	/*	414	*/
			/*	252	*/	29	01	00	00	00	00	03	B2	00	22	/*	416	*/
			/*	253	*/	29	01	00	00	00	00	03	B2	00	19	/*	418	*/
			/*	254	*/	29	01	00	00	00	00	03	B2	00	10	/*	420	*/
			/*	255	*/	29	01	00	00	00	00	03	B2	00	10	/*	420	*/
		];

		samsung,aid_subdivision_tx_cmds_revB = [
			/*	0	*/	29	01	00	00	00	00	03	B2	70	73	/*	2	*/
			/*	1	*/	29	01	00	00	00	00	03	B2	70	71	/*	3	*/
			/*	2	*/	29	01	00	00	00	00	03	B2	70	6C	/*	3.5	*/
			/*	3	*/	29	01	00	00	00	00	03	B2	70	67	/*	4	*/
			/*	4	*/	29	01	00	00	00	00	03	B2	70	65	/*	5	*/
			/*	5	*/	29	01	00	00	00	00	03	B2	70	63	/*	6	*/
			/*	6	*/	29	01	00	00	00	00	03	B2	70	61	/*	7	*/
			/*	7	*/	29	01	00	00	00	00	03	B2	70	57	/*	8	*/
			/*	8	*/	29	01	00	00	00	00	03	B2	70	55	/*	9	*/
			/*	9	*/	29	01	00	00	00	00	03	B2	70	53	/*	10	*/
			/*	10	*/	29	01	00	00	00	00	03	B2	70	51	/*	11	*/
			/*	11	*/	29	01	00	00	00	00	03	B2	70	47	/*	12	*/
			/*	12	*/	29	01	00	00	00	00	03	B2	70	46	/*	13	*/
			/*	13	*/	29	01	00	00	00	00	03	B2	70	45	/*	14	*/
			/*	14	*/	29	01	00	00	00	00	03	B2	70	42	/*	15	*/
			/*	15	*/	29	01	00	00	00	00	03	B2	70	41	/*	16	*/
			/*	16	*/	29	01	00	00	00	00	03	B2	70	37	/*	17	*/
			/*	17	*/	29	01	00	00	00	00	03	B2	70	35	/*	18	*/
			/*	18	*/	29	01	00	00	00	00	03	B2	70	33	/*	19	*/
			/*	19	*/	29	01	00	00	00	00	03	B2	70	31	/*	20	*/
			/*	20	*/	29	01	00	00	00	00	03	B2	70	27	/*	21	*/
			/*	21	*/	29	01	00	00	00	00	03	B2	70	25	/*	22	*/
			/*	22	*/	29	01	00	00	00	00	03	B2	70	22	/*	24	*/
			/*	23	*/	29	01	00	00	00	00	03	B2	70	21	/*	25	*/
			/*	24	*/	29	01	00	00	00	00	03	B2	70	17	/*	26	*/
			/*	25	*/	29	01	00	00	00	00	03	B2	70	15	/*	27	*/
			/*	26	*/	29	01	00	00	00	00	03	B2	70	13	/*	29	*/
			/*	27	*/	29	01	00	00	00	00	03	B2	70	11	/*	30	*/
			/*	28	*/	29	01	00	00	00	00	03	B2	70	07	/*	31	*/
			/*	29	*/	29	01	00	00	00	00	03	B2	70	05	/*	32	*/
			/*	30	*/	29	01	00	00	00	00	03	B2	70	03	/*	33	*/
			/*	31	*/	29	01	00	00	00	00	03	B2	70	01	/*	34	*/
			/*	32	*/	29	01	00	00	00	00	03	B2	60	F7	/*	35.5	*/
			/*	33	*/	29	01	00	00	00	00	03	B2	60	F5	/*	37	*/
			/*	34	*/	29	01	00	00	00	00	03	B2	60	F3	/*	39	*/
			/*	35	*/	29	01	00	00	00	00	03	B2	60	F1	/*	40	*/
			/*	36	*/	29	01	00	00	00	00	03	B2	60	E7	/*	41	*/
			/*	37	*/	29	01	00	00	00	00	03	B2	60	E5	/*	42.5	*/
			/*	38	*/	29	01	00	00	00	00	03	B2	60	E3	/*	44	*/
			/*	39	*/	29	01	00	00	00	00	03	B2	60	E1	/*	45	*/
			/*	40	*/	29	01	00	00	00	00	03	B2	60	D7	/*	46	*/
			/*	41	*/	29	01	00	00	00	00	03	B2	60	D5	/*	47	*/
			/*	42	*/	29	01	00	00	00	00	03	B2	60	D3	/*	48.5	*/
			/*	43	*/	29	01	00	00	00	00	03	B2	60	D1	/*	50	*/
			/*	44	*/	29	01	00	00	00	00	03	B2	60	C7	/*	51.5	*/
			/*	45	*/	29	01	00	00	00	00	03	B2	60	C1	/*	53	*/
			/*	46	*/	29	01	00	00	00	00	03	B2	60	B7	/*	54.5	*/
			/*	47	*/	29	01	00	00	00	00	03	B2	60	B4	/*	56	*/
			/*	48	*/	29	01	00	00	00	00	03	B2	60	B1	/*	57.33333333	*/
			/*	49	*/	29	01	00	00	00	00	03	B2	60	A9	/*	58.66666667	*/
			/*	50	*/	29	01	00	00	00	00	03	B2	60	A1	/*	60	*/
			/*	51	*/	29	01	00	00	00	00	03	B2	60	99	/*	61.33333333	*/
			/*	52	*/	29	01	00	00	00	00	03	B2	60	91	/*	62.66666667	*/
			/*	53	*/	29	01	00	00	00	00	03	B2	60	81	/*	64	*/
			/*	54	*/	29	01	00	00	00	00	03	B2	60	71	/*	65.33333333	*/
			/*	55	*/	29	01	00	00	00	00	03	B2	60	69	/*	66.66666667	*/
			/*	56	*/	29	01	00	00	00	00	03	B2	60	61	/*	68	*/
			/*	57	*/	29	01	00	00	00	00	03	B2	60	59	/*	70	*/
			/*	58	*/	29	01	00	00	00	00	03	B2	60	51	/*	72	*/
			/*	59	*/	29	01	00	00	00	00	03	B2	60	4A	/*	73.25	*/
			/*	60	*/	29	01	00	00	00	00	03	B2	60	42	/*	74.5	*/
			/*	61	*/	29	01	00	00	00	00	03	B2	60	32	/*	75.75	*/
			/*	62	*/	29	01	00	00	00	00	03	B2	60	22	/*	77	*/
			/*	63	*/	29	01	00	00	00	00	03	B2	60	1A	/*	78.66666667	*/
			/*	64	*/	29	01	00	00	00	00	03	B2	60	12	/*	80.33333333	*/
			/*	65	*/	29	01	00	00	00	00	03	B2	60	03	/*	82	*/
			/*	66	*/	29	01	00	00	00	00	03	B2	50	F3	/*	83.25	*/
			/*	67	*/	29	01	00	00	00	00	03	B2	50	E3	/*	84.5	*/
			/*	68	*/	29	01	00	00	00	00	03	B2	50	D3	/*	85.75	*/
			/*	69	*/	29	01	00	00	00	00	03	B2	50	CB	/*	87	*/
			/*	70	*/	29	01	00	00	00	00	03	B2	50	C3	/*	88.5	*/
			/*	71	*/	29	01	00	00	00	00	03	B2	50	B3	/*	90	*/
			/*	72	*/	29	01	00	00	00	00	03	B2	50	A3	/*	91.5	*/
			/*	73	*/	29	01	00	00	00	00	03	B2	50	93	/*	93	*/
			/*	74	*/	29	01	00	00	00	00	03	B2	50	83	/*	94.66666667	*/
			/*	75	*/	29	01	00	00	00	00	03	B2	50	6B	/*	96.33333333	*/
			/*	76	*/	29	01	00	00	00	00	03	B2	50	53	/*	98	*/
			/*	77	*/	29	01	00	00	00	00	03	B2	50	43	/*	99.75	*/
			/*	78	*/	29	01	00	00	00	00	03	B2	50	33	/*	101.5	*/
			/*	79	*/	29	01	00	00	00	00	03	B2	50	23	/*	103.25	*/
			/*	80	*/	29	01	00	00	00	00	03	B2	50	13	/*	105	*/
			/*	81	*/	29	01	00	00	00	00	03	B2	40	FA	/*	106.5	*/
			/*	82	*/	29	01	00	00	00	00	03	B2	40	E2	/*	108	*/
			/*	83	*/	29	01	00	00	00	00	03	B2	40	CA	/*	109.5	*/
			/*	84	*/	29	01	00	00	00	00	03	B2	40	B2	/*	111	*/
			/*	85	*/	29	01	00	00	00	00	03	B2	40	9A	/*	112.6	*/
			/*	86	*/	29	01	00	00	00	00	03	B2	40	82	/*	114.2	*/
			/*	87	*/	29	01	00	00	00	00	03	B2	40	69	/*	115.8	*/
			/*	88	*/	29	01	00	00	00	00	03	B2	40	51	/*	117.4	*/
			/*	89	*/	29	01	00	00	00	00	03	B2	40	34	/*	119	*/
			/*	90	*/	29	01	00	00	00	00	03	B2	40	17	/*	120.4	*/
			/*	91	*/	29	01	00	00	00	00	03	B2	30	FB	/*	121.8	*/
			/*	92	*/	29	01	00	00	00	00	03	B2	30	E0	/*	123.2	*/
			/*	93	*/	29	01	00	00	00	00	03	B2	30	BA	/*	124.6	*/
			/*	94	*/	29	01	00	00	00	00	03	B2	30	95	/*	126	*/
			/*	95	*/	29	01	00	00	00	00	03	B2	30	74	/*	127.6	*/
			/*	96	*/	29	01	00	00	00	00	03	B2	30	52	/*	129.2	*/
			/*	97	*/	29	01	00	00	00	00	03	B2	30	32	/*	130.8	*/
			/*	98	*/	29	01	00	00	00	00	03	B2	30	11	/*	132.4	*/
			/*	99	*/	29	01	00	00	00	00	03	B2	20	FE	/*	134	*/
			/*	100	*/	29	01	00	00	00	00	03	B2	20	D7	/*	135.8	*/
			/*	101	*/	29	01	00	00	00	00	03	B2	20	FC	/*	137.6	*/
			/*	102	*/	29	01	00	00	00	00	03	B2	20	D7	/*	139.4	*/
			/*	103	*/	29	01	00	00	00	00	03	B2	20	FA	/*	141.2	*/
			/*	104	*/	29	01	00	00	00	00	03	B2	20	D7	/*	143	*/
			/*	105	*/	29	01	00	00	00	00	03	B2	20	FE	/*	144.5	*/
			/*	106	*/	29	01	00	00	00	00	03	B2	20	D7	/*	146	*/
			/*	107	*/	29	01	00	00	00	00	03	B2	20	F6	/*	147.5	*/
			/*	108	*/	29	01	00	00	00	00	03	B2	20	D7	/*	149	*/
			/*	109	*/	29	01	00	00	00	00	03	B2	20	FF	/*	150.5	*/
			/*	110	*/	29	01	00	00	00	00	03	B2	20	D7	/*	152	*/
			/*	111	*/	29	01	00	00	00	00	03	B2	20	F8	/*	153.6666667	*/
			/*	112	*/	29	01	00	00	00	00	03	B2	20	D7	/*	155.3333333	*/
			/*	113	*/	29	01	00	00	00	00	03	B2	30	00	/*	157	*/
			/*	114	*/	29	01	00	00	00	00	03	B2	20	D7	/*	158.6666667	*/
			/*	115	*/	29	01	00	00	00	00	03	B2	20	F9	/*	160.3333333	*/
			/*	116	*/	29	01	00	00	00	00	03	B2	20	D7	/*	162	*/
			/*	117	*/	29	01	00	00	00	00	03	B2	20	FB	/*	164	*/
			/*	118	*/	29	01	00	00	00	00	03	B2	20	D7	/*	166	*/
			/*	119	*/	29	01	00	00	00	00	03	B2	20	FD	/*	168	*/
			/*	120	*/	29	01	00	00	00	00	03	B2	20	D7	/*	170	*/
			/*	121	*/	29	01	00	00	00	00	03	B2	20	FB	/*	172	*/
			/*	122	*/	29	01	00	00	00	00	03	B2	20	D7	/*	173.5714286	*/
			/*	123	*/	29	01	00	00	00	00	03	B2	20	FC	/*	175.1428571	*/
			/*	124	*/	29	01	00	00	00	00	03	B2	20	D7	/*	176.7142857	*/
			/*	125	*/	29	01	00	00	00	00	03	B2	20	FA	/*	178.2857143	*/
			/*	126	*/	29	01	00	00	00	00	03	B2	20	D7	/*	179.8571429	*/
			/*	127	*/	29	01	00	00	00	00	03	B2	20	FB	/*	181.4285714	*/
			/*	128	*/	29	01	00	00	00	00	03	B2	20	D7	/*	183	*/
			/*	129	*/	29	01	00	00	00	00	03	B2	20	C7	/*	184.7142857	*/
			/*	130	*/	29	01	00	00	00	00	03	B2	20	B7	/*	186.4285714	*/
			/*	131	*/	29	01	00	00	00	00	03	B2	20	A7	/*	188.1428571	*/
			/*	132	*/	29	01	00	00	00	00	03	B2	20	97	/*	189.8571429	*/
			/*	133	*/	29	01	00	00	00	00	03	B2	20	87	/*	191.5714286	*/
			/*	134	*/	29	01	00	00	00	00	03	B2	20	77	/*	193.2857143	*/
			/*	135	*/	29	01	00	00	00	00	03	B2	20	67	/*	195	*/
			/*	136	*/	29	01	00	00	00	00	03	B2	20	59	/*	196.7142857	*/
			/*	137	*/	29	01	00	00	00	00	03	B2	20	4B	/*	198.4285714	*/
			/*	138	*/	29	01	00	00	00	00	03	B2	20	3D	/*	200.1428571	*/
			/*	139	*/	29	01	00	00	00	00	03	B2	20	2F	/*	201.8571429	*/
			/*	140	*/	29	01	00	00	00	00	03	B2	20	21	/*	203.5714286	*/
			/*	141	*/	29	01	00	00	00	00	03	B2	20	13	/*	205.2857143	*/
			/*	142	*/	29	01	00	00	00	00	03	B2	20	05	/*	207	*/
			/*	143	*/	29	01	00	00	00	00	03	B2	10	F5	/*	208.8571429	*/
			/*	144	*/	29	01	00	00	00	00	03	B2	10	E6	/*	210.7142857	*/
			/*	145	*/	29	01	00	00	00	00	03	B2	10	D6	/*	212.5714286	*/
			/*	146	*/	29	01	00	00	00	00	03	B2	10	C6	/*	214.4285714	*/
			/*	147	*/	29	01	00	00	00	00	03	B2	10	B7	/*	216.2857143	*/
			/*	148	*/	29	01	00	00	00	00	03	B2	10	A7	/*	218.1428571	*/
			/*	149	*/	29	01	00	00	00	00	03	B2	10	97	/*	220	*/
			/*	150	*/	29	01	00	00	00	00	03	B2	10	89	/*	221.75	*/
			/*	151	*/	29	01	00	00	00	00	03	B2	10	7A	/*	223.5	*/
			/*	152	*/	29	01	00	00	00	00	03	B2	10	6C	/*	225.25	*/
			/*	153	*/	29	01	00	00	00	00	03	B2	10	5E	/*	227	*/
			/*	154	*/	29	01	00	00	00	00	03	B2	10	50	/*	228.75	*/
			/*	155	*/	29	01	00	00	00	00	03	B2	10	42	/*	230.5	*/
			/*	156	*/	29	01	00	00	00	00	03	B2	10	33	/*	232.25	*/
			/*	157	*/	29	01	00	00	00	00	03	B2	10	25	/*	234	*/
			/*	158	*/	29	01	00	00	00	00	03	B2	10	33	/*	235.875	*/
			/*	159	*/	29	01	00	00	00	00	03	B2	10	26	/*	237.75	*/
			/*	160	*/	29	01	00	00	00	00	03	B2	10	19	/*	239.625	*/
			/*	161	*/	29	01	00	00	00	00	03	B2	10	0C	/*	241.5	*/
			/*	162	*/	29	01	00	00	00	00	03	B2	00	FF	/*	243.375	*/
			/*	163	*/	29	01	00	00	00	00	03	B2	00	F2	/*	245.25	*/
			/*	164	*/	29	01	00	00	00	00	03	B2	00	E5	/*	247.125	*/
			/*	165	*/	29	01	00	00	00	00	03	B2	00	D8	/*	249	*/
			/*	166	*/	29	01	00	00	00	00	03	B2	10	34	/*	250.7777778	*/
			/*	167	*/	29	01	00	00	00	00	03	B2	10	29	/*	252.5555556	*/
			/*	168	*/	29	01	00	00	00	00	03	B2	10	1D	/*	254.3333333	*/
			/*	169	*/	29	01	00	00	00	00	03	B2	10	12	/*	256.1111111	*/
			/*	170	*/	29	01	00	00	00	00	03	B2	10	06	/*	257.8888889	*/
			/*	171	*/	29	01	00	00	00	00	03	B2	00	FB	/*	259.6666667	*/
			/*	172	*/	29	01	00	00	00	00	03	B2	00	EF	/*	261.4444444	*/
			/*	173	*/	29	01	00	00	00	00	03	B2	00	E4	/*	263.2222222	*/
			/*	174	*/	29	01	00	00	00	00	03	B2	00	D8	/*	265	*/
			/*	175	*/	29	01	00	00	00	00	03	B2	10	34	/*	266.8888889	*/
			/*	176	*/	29	01	00	00	00	00	03	B2	10	29	/*	268.7777778	*/
			/*	177	*/	29	01	00	00	00	00	03	B2	10	1D	/*	270.6666667	*/
			/*	178	*/	29	01	00	00	00	00	03	B2	10	12	/*	272.5555556	*/
			/*	179	*/	29	01	00	00	00	00	03	B2	10	06	/*	274.4444444	*/
			/*	180	*/	29	01	00	00	00	00	03	B2	00	FB	/*	276.3333333	*/
			/*	181	*/	29	01	00	00	00	00	03	B2	00	EF	/*	278.2222222	*/
			/*	182	*/	29	01	00	00	00	00	03	B2	00	E4	/*	280.1111111	*/
			/*	183	*/	29	01	00	00	00	00	03	B2	00	D8	/*	282	*/
			/*	184	*/	29	01	00	00	00	00	03	B2	10	35	/*	283.8	*/
			/*	185	*/	29	01	00	00	00	00	03	B2	10	2B	/*	285.6	*/
			/*	186	*/	29	01	00	00	00	00	03	B2	10	20	/*	287.4	*/
			/*	187	*/	29	01	00	00	00	00	03	B2	10	16	/*	289.2	*/
			/*	188	*/	29	01	00	00	00	00	03	B2	10	0C	/*	291	*/
			/*	189	*/	29	01	00	00	00	00	03	B2	10	01	/*	292.8	*/
			/*	190	*/	29	01	00	00	00	00	03	B2	00	F7	/*	294.6	*/
			/*	191	*/	29	01	00	00	00	00	03	B2	00	ED	/*	296.4	*/
			/*	192	*/	29	01	00	00	00	00	03	B2	00	E2	/*	298.2	*/
			/*	193	*/	29	01	00	00	00	00	03	B2	00	D8	/*	300	*/
			/*	194	*/	29	01	00	00	00	00	03	B2	10	24	/*	302	*/
			/*	195	*/	29	01	00	00	00	00	03	B2	10	19	/*	304	*/
			/*	196	*/	29	01	00	00	00	00	03	B2	10	0E	/*	306	*/
			/*	197	*/	29	01	00	00	00	00	03	B2	10	04	/*	308	*/
			/*	198	*/	29	01	00	00	00	00	03	B2	00	F9	/*	310	*/
			/*	199	*/	29	01	00	00	00	00	03	B2	00	EE	/*	312	*/
			/*	200	*/	29	01	00	00	00	00	03	B2	00	E3	/*	314	*/
			/*	201	*/	29	01	00	00	00	00	03	B2	00	D8	/*	316	*/
			/*	202	*/	29	01	00	00	00	00	03	B2	10	26	/*	317.8888889	*/
			/*	203	*/	29	01	00	00	00	00	03	B2	10	1C	/*	319.7777778	*/
			/*	204	*/	29	01	00	00	00	00	03	B2	10	13	/*	321.6666667	*/
			/*	205	*/	29	01	00	00	00	00	03	B2	10	09	/*	323.5555556	*/
			/*	206	*/	29	01	00	00	00	00	03	B2	00	FF	/*	325.4444444	*/
			/*	207	*/	29	01	00	00	00	00	03	B2	00	F5	/*	327.3333333	*/
			/*	208	*/	29	01	00	00	00	00	03	B2	00	EC	/*	329.2222222	*/
			/*	209	*/	29	01	00	00	00	00	03	B2	00	E2	/*	331.1111111	*/
			/*	210	*/	29	01	00	00	00	00	03	B2	00	D8	/*	333	*/
			/*	211	*/	29	01	00	00	00	00	03	B2	10	22	/*	334.8888889	*/
			/*	212	*/	29	01	00	00	00	00	03	B2	10	19	/*	336.7777778	*/
			/*	213	*/	29	01	00	00	00	00	03	B2	10	10	/*	338.6666667	*/
			/*	214	*/	29	01	00	00	00	00	03	B2	10	06	/*	340.5555556	*/
			/*	215	*/	29	01	00	00	00	00	03	B2	00	FD	/*	342.4444444	*/
			/*	216	*/	29	01	00	00	00	00	03	B2	00	F4	/*	344.3333333	*/
			/*	217	*/	29	01	00	00	00	00	03	B2	00	EB	/*	346.2222222	*/
			/*	218	*/	29	01	00	00	00	00	03	B2	00	E1	/*	348.1111111	*/
			/*	219	*/	29	01	00	00	00	00	03	B2	00	D8	/*	350	*/
			/*	220	*/	29	01	00	00	00	00	03	B2	00	F1	/*	351.75	*/
			/*	221	*/	29	01	00	00	00	00	03	B2	00	E9	/*	353.5	*/
			/*	222	*/	29	01	00	00	00	00	03	B2	00	E0	/*	355.25	*/
			/*	223	*/	29	01	00	00	00	00	03	B2	00	D8	/*	357	*/
			/*	224	*/	29	01	00	00	00	00	03	B2	00	F4	/*	359	*/
			/*	225	*/	29	01	00	00	00	00	03	B2	00	EB	/*	361	*/
			/*	226	*/	29	01	00	00	00	00	03	B2	00	E1	/*	363	*/
			/*	227	*/	29	01	00	00	00	00	03	B2	00	D8	/*	365	*/
			/*	228	*/	29	01	00	00	00	00	03	B2	00	CC	/*	367.3333333	*/
			/*	229	*/	29	01	00	00	00	00	03	B2	00	BF	/*	369.6666667	*/
			/*	230	*/	29	01	00	00	00	00	03	B2	00	B3	/*	372	*/
			/*	231	*/	29	01	00	00	00	00	03	B2	00	A7	/*	374	*/
			/*	232	*/	29	01	00	00	00	00	03	B2	00	9B	/*	376	*/
			/*	233	*/	29	01	00	00	00	00	03	B2	00	90	/*	378	*/
			/*	234	*/	29	01	00	00	00	00	03	B2	00	84	/*	380	*/
			/*	235	*/	29	01	00	00	00	00	03	B2	00	79	/*	381.75	*/
			/*	236	*/	29	01	00	00	00	00	03	B2	00	6E	/*	383.5	*/
			/*	237	*/	29	01	00	00	00	00	03	B2	00	63	/*	385.25	*/
			/*	238	*/	29	01	00	00	00	00	03	B2	00	58	/*	387	*/
			/*	239	*/	29	01	00	00	00	00	03	B2	00	4E	/*	389	*/
			/*	240	*/	29	01	00	00	00	00	03	B2	00	44	/*	391	*/
			/*	241	*/	29	01	00	00	00	00	03	B2	00	3A	/*	393	*/
			/*	242	*/	29	01	00	00	00	00	03	B2	00	30	/*	395	*/
			/*	243	*/	29	01	00	00	00	00	03	B2	00	2D	/*	397	*/
			/*	244	*/	29	01	00	00	00	00	03	B2	00	23	/*	399	*/
			/*	245	*/	29	01	00	00	00	00	03	B2	00	1A	/*	401	*/
			/*	246	*/	29	01	00	00	00	00	03	B2	00	10	/*	403	*/
			/*	247	*/	29	01	00	00	00	00	03	B2	00	2F	/*	405.25	*/
			/*	248	*/	29	01	00	00	00	00	03	B2	00	25	/*	407.5	*/
			/*	249	*/	29	01	00	00	00	00	03	B2	00	1A	/*	409.75	*/
			/*	250	*/	29	01	00	00	00	00	03	B2	00	10	/*	412	*/
			/*	251	*/	29	01	00	00	00	00	03	B2	00	2B	/*	414	*/
			/*	252	*/	29	01	00	00	00	00	03	B2	00	22	/*	416	*/
			/*	253	*/	29	01	00	00	00	00	03	B2	00	19	/*	418	*/
			/*	254	*/	29	01	00	00	00	00	03	B2	00	10	/*	420	*/
			/*	255	*/	29	01	00	00	00	00	03	B2	00	10	/*	420	*/
		];

		/*
		 * ************************************************************************************************************************
		 * ACL command list and mappings
		 * ************************************************************************************************************************
		 */

		samsung,acl_on_tx_cmds_revA = [
			29 01 00 00 00 00 05 B5 50 7F 14 14  /* 1th : 0x50 32frame avg, 2th : 0x7F start point 50%, 4th: 0x12 ACL 15% */
			29 01 00 00 00 00 02 55 02	/* ACL ON */	
		];

		samsung,acl_percent_tx_cmds_revA = [
			29 01 00 00 00 00 05 B5 50 7F 14 0A  /* 1th : 0x50 32frame avg, 2th : 0x7F start point 50%, 4th: 0x0A ACL 8% */
			29 01 00 00 00 00 05 B5 50 7F 14 14  /* 1th : 0x50 32frame avg, 2th : 0x7F start point 50%, 4th: 0x14 ACL 15% */
		];

		samsung,acl_off_tx_cmds_revA = [
			29 01 00 00 00 00 05 B5 40 7F 14 00  /* 1th : 0x50 32frame avg, 2th : 0x7F start point 50%, 4th: don't care */
			29 01 00 00 00 00 02 55 00	 /* ACL OFF */
		];

		/* bl_level , Index in acl command list */
		samsung,acl_map_table_revA =  <
			2	1		3	1		4	1		5	1		6	1
			7	1		8	1		9	1		10	1		11	1
			12	1		13	1		14	1		15	1		16	1
			17	1		19	1		20	1		21	1		22	1
			24	1		25	1		27	1		29	1		30	1
			32	1		34	1		37	1		39	1		41	1
			44	1		47	1		50	1		53	1		56	1
			60	1		64	1		68	1		72	1		77	1
			82	1		87	1		93	1		98	1		105	1
			111	1		119	1		126	1		134	1		143	1
			152	1		162	1		172	1		183	1		195	1
			207	1		220	1		234	1		249	1		265	1
			282	1		300	1		316	1		333	1		350	1
			357	1		365	1		372	1		380	1		387	1
			395	1		403	1		412	1		420	1
		>;

		/*
		 * ************************************************************************************************************************
		 * ELVSS(ACL Off) command list and mappings
		 * ************************************************************************************************************************
		 */
		samsung,elvss_tx_cmds_revA = [
			29 01 00 00 00 00 03 b6 AC 0A /* 0 */
			29 01 00 00 00 00 03 b6 AC 0B /* 1 */
			29 01 00 00 00 00 03 b6 AC 0D /* 2 */
			29 01 00 00 00 00 03 b6 AC 0E /* 3 */
			29 01 00 00 00 00 03 b6 AC 0F /* 4 */
			29 01 00 00 00 00 03 b6 AC 10 /* 5 */
			29 01 00 00 00 00 03 b6 AC 11 /* 6 */
			29 01 00 00 00 00 03 b6 AC 12 /* 7 */
			29 01 00 00 00 00 03 b6 AC 13 /* 8 */
			29 01 00 00 00 00 03 b6 AC 14 /* 9 */
			29 01 00 00 00 00 03 b6 BC 14 /* 10 */
			29 01 00 00 00 00 03 b6 BC 13 /* 11 */
			29 01 00 00 00 00 03 b6 BC 12 /* 12 */
			29 01 00 00 00 00 03 b6 BC 11 /* 13 */
			29 01 00 00 00 00 03 b6 BC 10 /* 14 */
			29 01 00 00 00 00 03 b6 BC 0F /* 15 */
			29 01 00 00 00 00 03 b6 BC 0E /* 16 */
			29 01 00 00 00 00 03 b6 BC 0D /* 17 */
			29 01 00 00 00 00 03 b6 BC 0C /* 18 */
			29 01 00 00 00 00 03 b6 BC 0B /* 19 */
			29 01 00 00 00 00 03 b6 BC 0A /* 20 */
			29 01 00 00 00 00 03 b6 BC 09 /* 21 */
			29 01 00 00 00 00 03 b6 BC 08 /* 22 */
			29 01 00 00 00 00 03 b6 BC 07 /* 23 */
			29 01 00 00 00 00 03 b6 BC 06 /* 24 */
			29 01 00 00 00 00 03 b6 BC 05 /* 25 */
			29 01 00 00 00 00 03 b6 BC 04 /* 26 */
		];

		/*
		 * ************************************************************************************************************************
		 * SMART ACL(ACL On) ELVSS command list and mappings
		 * ************************************************************************************************************************
		 */
		samsung,smart_acl_elvss_tx_cmds_revA = [
			29 01 00 00 00 00 03 b6 AC 0A /* 0 */
			29 01 00 00 00 00 03 b6 AC 0B /* 1 */
			29 01 00 00 00 00 03 b6 AC 0D /* 2 */
			29 01 00 00 00 00 03 b6 AC 0E /* 3 */
			29 01 00 00 00 00 03 b6 AC 0F /* 4 */
			29 01 00 00 00 00 03 b6 AC 10 /* 5 */
			29 01 00 00 00 00 03 b6 AC 11 /* 6 */
			29 01 00 00 00 00 03 b6 AC 12 /* 7 */
			29 01 00 00 00 00 03 b6 AC 13 /* 8 */
			29 01 00 00 00 00 03 b6 AC 14 /* 9 */
			29 01 00 00 00 00 03 b6 BC 14 /* 10 */
			29 01 00 00 00 00 03 b6 BC 13 /* 11 */
			29 01 00 00 00 00 03 b6 BC 12 /* 12 */
			29 01 00 00 00 00 03 b6 BC 11 /* 13 */
			29 01 00 00 00 00 03 b6 BC 10 /* 14 */
			29 01 00 00 00 00 03 b6 BC 0F /* 15 */
			29 01 00 00 00 00 03 b6 BC 0E /* 16 */
			29 01 00 00 00 00 03 b6 BC 0D /* 17 */
			29 01 00 00 00 00 03 b6 BC 0C /* 18 */
			29 01 00 00 00 00 03 b6 BC 0B /* 19 */
			29 01 00 00 00 00 03 b6 BC 0A /* 20 */
			29 01 00 00 00 00 03 b6 BC 09 /* 21 */
			29 01 00 00 00 00 03 b6 BC 08 /* 22 */
			29 01 00 00 00 00 03 b6 BC 07 /* 23 */
			29 01 00 00 00 00 03 b6 BC 06 /* 24 */
			29 01 00 00 00 00 03 b6 BC 05 /* 25 */
			29 01 00 00 00 00 03 b6 BC 04 /* 26 */
		];

		/* bl_level, Index in elvss command list */
		samsung,smart_acl_elvss_map_table_revA = <
			2	0		3	1		4	2		5	2		6	3
			7	4		8	5		9	6		10	6		11	7
			12	7		13	8		14	8		15	9		16	9
			17	9		19	9		20	9		21	9		22	9
			24	9		25	9		27	9		29	9		30	9
			32	9		34	9		37	9		39	9		41	10
			44	10		47	10		50	10		53	10		56	10
			60	10		64	10		68	10		72	10		77	10
			82	10		87	11		93	11		98	11		105	12
			111	12		119	13		126	13		134	14		143	14
			152	15		162	15		172	16		183	16		195	17
			207	17		220	17		234	17		249	17		265	18
			282	19		300	20		316	21		333	22		350	23
			357	23		365	24		372	24		380	24		387	25
			395	25		403	25		412	26		420	26
		>;

		/*
		 * ************************************************************************************************************************
		 * candela to index mappings
		 * ************************************************************************************************************************
		 */
		samsung,candela_map_table_revA = <
		/*<idx><PMSL range> <candella> *//*linear map*/
			0	0	0	2
			1	1	4	3
			2	5	8	4
			3	9	12	5
			4	13	16	6
			5	17	20	7
			6	21	24	8
			7	25	28	9
			8	29	32	10
			9	33	36	11
			10	37	40	12
			11	41	43	13
			12	44	46	14
			13	47	48	15
			14	49	50	16
			15	51	52	17
			16	53	54	19
			17	55	56	20 /* dimming*/
			18	57	58	21
			19	59	60	22
			20	61	62	24
			21	63	64	25
			22	65	66	27
			23	67	68	29
			24	69	70	30
			25	71	72	32
			26	73	74	34
			27	75	76	37
			28	77	78	39
			29	79	80	41
			30	81	82	44
			31	83	84	47
			32	85	86	50
			33	87	88	53
			34	89	90	56
			35	91	92	60
			36	93	94	64
			37	95	96	68
			38	97	98	72
			39	99	100	77
			40	101	102	82
			41	103	104	87
			42	105	106	93
			43	107	108	98
			44	109	110	105
			45	111	112	111
			46	113	114	119
			47	115	116	126
			48	117	118	134
			49	119	120	143
			50	121	122	152
			51	123	124	162
			52	125	126	172
			53	127	128	183 /* default */
			54	129	135	195
			55	136	142	207
			56	143	149	220
			57	150	157	234
			58	158	165	249
			59	166	174	265
			60	175	183	282
			61	184	193	300
			62	194	201	316
			63	202	210	333
			64	211	219	350
			65	220	223	357
			66	224	227	365
			67	228	230	372
			68	231	234	380
			69	235	238	387
			70	239	242	395
			71	243	246	403
			72	247	250	412
			73	251	255	420
		>;

		samsung,hbm_candela_map_table_revA = <
			0	282	295	465	6
			1	296	309	488	7
			2	310	323	510	8
			3	324	336	533	9
			4	337	350	555	10
			5	351	364	578	11
			6	365	365	600	12
		>;


/*
	///////////////////////////////////////////////////////////////////
	//   C9 CHN ALPM/HLPM
	///////////////////////////////////////////////////////////////////
*/
		/*
		 * The command set of R53h will be replaced with
		 * lpm 2nit or 60nit tx commnad for
		 * changing brightness level
		 */
			
		samsung,alpm_on_tx_cmds_revA = [
			29 01 00 00 00 00 03 F0 5A 5A						/* TEST KEY Enable */
			29 01 00 00 00 00 03 FC 5A 5A						/* TEST KEY Enable */			
			29 01 00 00 00 00 02 BB C4          				/* HLPM(0x54)/ALPM(0xC4)  ALPM Mode On*/			
			29 01 00 00 00 00 02 53 03							/* alpm on wait 20ms */ /* ALPM/HLPM 2nit On*/

			29 01 00 00 00 00 08 FD A1 20 08 04 44 00 0C
			//29 01 00 00 00 00 20 FD A1 20 08 04 44 00 0C 07 00 00 FF 00 0A AA 0A AA 0A AA 00 00 00 00 00 00 00 00 5A 80 57 65 94        /*SRC_LOAD_EN setting*/
			29 01 00 00 01 00 02 F7 03						     /* Gamma, LTPS(AID) update */
			
			29 01 00 00 00 00 03 F0 A5 A5
			29 01 00 00 00 00 03 FC A5 A5
		];

		samsung,alpm_off_tx_cmds_revA = [
			29 01 00 00 00 00 03 F0 5A 5A		/* TEST KEY Disable */
			05 01 00 00 00 00 02 28 00			/* display off wait 20ms */

			/* image write for normal mode */

			29 01 00 00 00 00 02 53 00			/* alpm off */
			29 01 00 00 00 00 02 F7 03		/* Gamma, LTPS(AID) update */
			29 01 00 00 00 00 02 F7 00
			29 01 00 00 00 00 03 F0 A5 A5
		];	
		
		samsung,lpm_2nit_tx_cmds_revA = [29 01 00 00 14 00 02 53 03];       /* HLPM/ALPM 2nit On*/
		samsung,lpm_40nit_tx_cmds_revA = [29 01 00 00 14 00 02 53 02];		/* HLPM/ALPM 60nit On*/

		samsung,lpm_ctrl_alpm_2nit_tx_cmds_revA = [29 01 00 00 00 00 02 BB C4];
		
		samsung,lpm_ctrl_alpm_40nit_tx_cmds_revA = [29 01 00 00 00 00 02 BB 84];		
		
		samsung,lpm_ctrl_hlpm_2nit_tx_cmds_revA = [29 01 00 00 00 00 02 BB 54];	
		
		samsung,lpm_ctrl_hlpm_40nit_tx_cmds_revA = [29 01 00 00 00 00 02 BB 14];	

		samsung,lpm_ctrl_alpm_aod_off_tx_cmds_revA = [
			29 01 00 00 00 00 03 F0 5A 5A	/* TEST KEY Enable */
			29 01 00 00 00 00 02 BB 00		/* AOD off */
			29 01 00 00 00 00 03 F0 A5 A5	/* TEST KEY Disable */
		];

		samsung,lpm_ctrl_alpm_aod_on_tx_cmds_revA = [
			29 01 00 00 00 00 03 F0 5A 5A	/* TEST KEY Enable */
			29 01 00 00 00 00 02 BB 01		/* AOD on */
			29 01 00 00 00 00 03 F0 A5 A5	/* TEST KEY Disable */
		];

		samsung,lpm_1hz_tx_cmds_revA = [29 01 00 00 00 00 02 00 00];
		/* 1Hz added on REV B or later version for 40nit */

		samsung,lpm_2hz_tx_cmds_revA = [29 01 00 00 00 00 02 00 00];
		/* 1Hz added on REV B or later version for 40nit */


		samsung,lpm_hz_none_tx_cmds_revA = [29 01 00 00 00 00 02 00 00];

	};
};
