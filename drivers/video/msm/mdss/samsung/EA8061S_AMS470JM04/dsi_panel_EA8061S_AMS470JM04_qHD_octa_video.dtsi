/* Copyright (c) 2013-2014, The Linux Foundation. All rights reserved.
 *
 * This program is free software; you can redistribute it and/or modify
 * it under the terms of the GNU General Public License version 2 and
 * only version 2 as published by the Free Software Foundation.
 *
 * This program is distributed in the hope that it will be useful,
 * but WITHOUT ANY WARRANTY; without even the implied warranty of
 * MERCHANTABILITY or FITNESS FOR A PARTICULAR PURPOSE.  See the
 * GNU General Public License for more details.
 */

/*---------------------------------------------------------------------------
 * This file is autogenerated file using gcdb parser. Please do not edit it.
 * Update input XML file to add a new entry or update variable in this file
 * VERSION = "1.0"
 *--------------------------------------------------------------------------- */
&mdss_mdp {
	ss_dsi_panel_EA8061S_AMS470JM04_QHD: ss_dsi_panel_EA8061S_AMS470JM04_QHD {
		qcom,mdss-dsi-panel-name = "ss_dsi_panel_EA8061S_AMS470JM04_QHD";
		qcom,mdss-dsi-panel-controller = <&mdss_dsi0>;
		qcom,mdss-dsi-panel-width = <540>;
		qcom,mdss-dsi-panel-height = <960>;
		qcom,mdss-dsi-bpp = <24>;
		qcom,mdss-dsi-panel-destination = "display_1";
		qcom,mdss-dsi-panel-timings = [8B 1E 14 00 44 48 18 22 19 03 04 00]; // 490 Mbps

		qcom,mdss-dsi-on-command = [
			/* Common Setting */
			39 01 00 00 00 00 03 F0 5A 5A 				/* TEST KEY Enable */
			39 01 00 00 00 00 02 BA 74					/* Source Slew */
			39 01 00 00 00 00 05 B2 00 00 00 0A			/* AID Setting */
			39 01 00 00 00 00 02 F7 03					/* Gamma, AID Update */
			39 01 00 00 00 00 03 B8 19 00 				/* A-swire Setting */
			
			/* Sleep Out and wait minimum 20ms*/
			05 01 00 00 14 00 02 11 00

			39 01 00 00 78 00 03 F0 A5 A5				/* TEST KEY Disable and wait 120ms */
			
			05 01 00 00 14 00 02 29 00					/* Display On and wait 20ms */
		];

		qcom,mdss-dsi-off-command = [
			05 01 00 00 14 00 02 28 00					/* Display Off and wait 20ms */
			05 01 00 00 64 00 02 10 00					/* Sleep In and wait 100ms */
		];

		/* Values currently picked from J200G */
		qcom,mdss-dsi-h-back-porch = <36>;
		qcom,mdss-dsi-h-front-porch = <55>;
		qcom,mdss-dsi-h-pulse-width = <4>;
		qcom,mdss-dsi-v-back-porch = <9>;
		qcom,mdss-dsi-v-front-porch = <14>;
		qcom,mdss-dsi-v-pulse-width = <1>;

		qcom,mdss-dsi-h-sync-skew = <0>;		
		qcom,mdss-dsi-h-left-border = <0>;
		qcom,mdss-dsi-h-right-border = <0>;
		qcom,mdss-dsi-v-top-border = <0>;
		qcom,mdss-dsi-v-bottom-border = <0>;

		qcom,mdss-dsi-underflow-color = <0xff>;
		qcom,mdss-dsi-border-color = <0>;

		qcom,mdss-dsi-bl-pmic-control-type = "bl_ctrl_dcs";
		qcom,mdss-dsi-bl-min-level = <1>;
		qcom,mdss-dsi-bl-max-level = <256>;
		qcom,mdss-brightness-max-level = <256>;
		qcom,mdss-dsi-panel-type = "dsi_video_mode";
		qcom,mdss-dsi-h-sync-pulse = <0>;
		//qcom,mdss-dsi-hfp-power-mode;
		qcom,mdss-dsi-bllp-eof-power-mode;
		qcom,mdss-dsi-bllp-power-mode;
		qcom,mdss-dsi-traffic-mode = "burst_mode";
		qcom,mdss-dsi-pixel-packing = "loose";
		qcom,mdss-dsi-virtual-channel-id = <0>;
		qcom,mdss-dsi-color-order = <0>;
		qcom,mdss-dsi-lane-0-state;
		qcom,mdss-dsi-lane-1-state;
		qcom,mdss-dsi-t-clk-post = <0x04>;
		qcom,mdss-dsi-t-clk-pre = <0x1C>;
		qcom,mdss-dsi-stream = <0>;
		qcom,mdss-dsi-mdp-trigger = "none";
		qcom,mdss-dsi-dma-trigger = "trigger_sw";
		qcom,mdss-dsi-panel-framerate = <60>;
		qcom,mdss-dsi-panel-clockrate = <490000000>;
		qcom,mdss-dsi-on-command-state = "dsi_hs_mode";
		qcom,mdss-dsi-off-command-state = "dsi_hs_mode";
		qcom,mdss-pan-physical-width-dimension = <64>;
		qcom,mdss-pan-physical-height-dimension = <110>;
		qcom,mdss-dsi-lp11-init;
		qcom,mdss-dsi-init-delay-us = <100>;
		qcom,mdss-dsi-rx-eot-ignore;
		qcom,mdss-dsi-tx-eot-append;
		qcom,mdss-dsi-gamma-update = [39 01 00 00 00 00 02 F7 03];

/*
 * ************************************************************************************************************************************
 *
 *
 *			Below  parameters are samsung dependent thigs
 *
 *
 * ************************************************************************************************************************************
 */
 		samsung,panel-vendor = "SDC";

		/* To use device_resume & device_suspend for optimizing display on time */
		samsung,reduce_display_on_time;
		samsung,dsi_force_clock_lane_hs;
		samsung,wait_after_reset_delay = <80>; /* Flash loading time */
		samsung,wait_after_sleep_out_delay = <107>; /* More than 6frame 16.6 * 6 = 99.6ms+7ms*/
		
		samsung,display_off_tx_cmds_revA = [05 01 00 00 32 00 02 28 00];
		samsung,display_on_tx_cmds_revA  = [05 01 00 00 00 00 02 29 00];

		samsung,level1_key_enable_tx_cmds_revA = [
			39 01 00 00 00 00 03 F0 5A 5A
		];
		samsung,level1_key_disable_tx_cmds_revA = [
			39 01 00 00 00 00 03 F0 A5 A5
		];
		samsung,reg_read_pos_tx_cmds_revA = [15 01 00 00 00 00 02 B0 00];

		/*
		 * ************************************************************************************************************************
		 *	 06 01 00 00 00 00 01 c8 07 21
		 *	READ 0xC8 SIZE 0x07 OFFSET 0x21
		 * ************************************************************************************************************************
		 *        SAMPLE :  samsung,hbm2_rx_cmds_revE = [ 06 01 00 00 00 00 01 DB 01 21];	 // read DB 34th , 33=0x21
		 * ************************************************************************************************************************
		 */

		//=================================
		// REV. A
		//=================================
		samsung,smart_dimming_mtp_rx_cmds_revA = [ 06 01 00 00 00 00 01 C8 21 00];
		samsung,manufacture_id0_rx_cmds_revA   = [ 06 01 00 00 00 00 01 DA 01 00];
		samsung,manufacture_id1_rx_cmds_revA   = [ 06 01 00 00 00 00 01 DB 01 00];
		samsung,manufacture_id2_rx_cmds_revA   = [ 06 01 00 00 00 00 01 DC 01 00];
		samsung,manufacture_date_rx_cmds_revA  = [ 06 01 00 00 00 00 01 A1 02 04];	// read A1 5~6th para
		samsung,cell_id_rx_cmds_revA           = [ 06 01 00 00 00 00 01 A1 04 00];	// read A1 1~4th para
		samsung,mtp_read_sysfs_rx_cmds_revA    = [ 06 01 00 00 00 00 01 01 01 01];
		samsung,ldi_debug0_rx_cmds_revA        = [ 06 01 00 00 00 00 01 0A 01 00];
		samsung,ldi_debug1_rx_cmds_revA        = [ 06 01 00 00 00 00 01 0E 01 00];
		samsung,ldi_debug2_rx_cmds_revA        = [ 06 01 00 00 00 00 01 EA 08 00];

		/*
		 * ************************************************************************************************************************
		 *	 COMMON CMD LIST
		 * ************************************************************************************************************************
		 */
		samsung,elvss_lowtemp_tx_cmds_revA  = [39 01 00 00 00 00 02 B8 19 ];		/* Low Temperature Command */

		//========================================
		// Gamma and HBM (REV. A)
		//========================================
		
		samsung,gamma_tx_cmds_revA = [
			39 01 00 00 01 00 22 CA	01 00 01 00 01 00	/* 350 nit 2.2 Gamma */
									80 80 80 80 80 80
									80 80 80 80 80 80
									80 80 80 80 80 80
									80 80 80 80 80 80
									00 00 00

			39 01 00 00 00 00 02 F7 03			// Gamma, AID Update
		];

		samsung,hbm_etc_tx_cmds_revA = [
			39 01 00 00 00 00 05 B2 00 00 00 0A
			39 00 00 00 00 00 03 B6 CC 8B
			39 01 00 00 00 00 02 53 C0	/* HBM On */
			39 01 00 00 00 00 02 F7 03
		];

		samsung,hbm_off_tx_cmds_revA = [
			39 01 00 00 00 00 05 B2 00 00 00 0A
			39 00 00 00 00 00 03 B6 CC 8B
			39 01 00 00 00 00 02 53 00	/* HBM Off */
			39 01 00 00 00 00 02 F7 03
		];

		/*
		* ************************************************************************************************************************
		* AID command list and mappings
		* ************************************************************************************************************************
		*/
		samsung,aid_tx_cmds_revA = [
			39 01 00 00 00 00 05 B2 00 00 03 B7 /*  0 samsung_brightness_aor_96.65 5  */
			39 01 00 00 00 00 05 B2 00 00 03 B0 /*  1 samsung_brightness_aor_95.93 6  */
			39 01 00 00 00 00 05 B2 00 00 03 A8 /*  2 samsung_brightness_aor_95.12 7  */
			39 01 00 00 00 00 05 B2 00 00 03 A1 /*  3 samsung_brightness_aor_94.41 8  */
			39 01 00 00 00 00 05 B2 00 00 03 9A /*  4 samsung_brightness_aor_93.70 9  */
			39 01 00 00 00 00 05 B2 00 00 03 93 /*  5 samsung_brightness_aor_92.99 10 */
			39 01 00 00 00 00 05 B2 00 00 03 8B /*  6 samsung_brightness_aor_92.17 11 */
			39 01 00 00 00 00 05 B2 00 00 03 84 /*  7 samsung_brightness_aor_91.46 12 */
			39 01 00 00 00 00 05 B2 00 00 03 7D /*  8 samsung_brightness_aor_90.75 13 */
			39 01 00 00 00 00 05 B2 00 00 03 75 /*  9 samsung_brightness_aor_89.94 14 */
			39 01 00 00 00 00 05 B2 00 00 03 6E /* 10 samsung_brightness_aor_89.23 15 */
			39 01 00 00 00 00 05 B2 00 00 03 67 /* 11 samsung_brightness_aor_88.52 16 */
			39 01 00 00 00 00 05 B2 00 00 03 5F /* 12 samsung_brightness_aor_87.70 17 */
			39 01 00 00 00 00 05 B2 00 00 03 50 /* 13 samsung_brightness_aor_86.18 19 */
			39 01 00 00 00 00 05 B2 00 00 03 48 /* 14 samsung_brightness_aor_85.37 20 */
			39 01 00 00 00 00 05 B2 00 00 03 3F /* 15 samsung_brightness_aor_84.45 21 */
			39 01 00 00 00 00 05 B2 00 00 03 36 /* 16 samsung_brightness_aor_83.54 22 */
			39 01 00 00 00 00 05 B2 00 00 03 24 /* 17 samsung_brightness_aor_81.71 24 */
			39 01 00 00 00 00 05 B2 00 00 03 1A /* 18 samsung_brightness_aor_80.69 25 */
			39 01 00 00 00 00 05 B2 00 00 03 06 /* 19 samsung_brightness_aor_78.66 27 */
			39 01 00 00 00 00 05 B2 00 00 02 F4 /* 20 samsung_brightness_aor_76.83 29 */
			39 01 00 00 00 00 05 B2 00 00 02 EA /* 21 samsung_brightness_aor_75.81 30 */
			39 01 00 00 00 00 05 B2 00 00 02 D9 /* 22 samsung_brightness_aor_74.09 32 */
			39 01 00 00 00 00 05 B2 00 00 02 C8 /* 23 samsung_brightness_aor_72.36 34 */
			39 01 00 00 00 00 05 B2 00 00 02 B0 /* 24 samsung_brightness_aor_69.92 37 */
			39 01 00 00 00 00 05 B2 00 00 02 9F /* 25 samsung_brightness_aor_68.19 39 */
			39 01 00 00 00 00 05 B2 00 00 02 8F /* 26 samsung_brightness_aor_66.57 41 */
			39 01 00 00 00 00 05 B2 00 00 02 76 /* 27 samsung_brightness_aor_64.02 44 */
			39 01 00 00 00 00 05 B2 00 00 02 5D /* 28 samsung_brightness_aor_61.48 47 */
			39 01 00 00 00 00 05 B2 00 00 02 45 /* 29 samsung_brightness_aor_59.04 50 */
			39 01 00 00 00 00 05 B2 00 00 02 2B /* 30 samsung_brightness_aor_56.40 53 */
			39 01 00 00 00 00 05 B2 00 00 02 12 /* 31 samsung_brightness_aor_53.86 56 */
			39 01 00 00 00 00 05 B2 00 00 01 F0 /* 32 samsung_brightness_aor_50.41 60 */
			39 01 00 00 00 00 05 B2 00 00 01 CE /* 33 samsung_brightness_aor_46.95 64 */
			39 01 00 00 00 00 05 B2 00 00 01 AF /* 34 samsung_brightness_aor_43.80 68 */
			39 01 00 00 00 00 05 B2 00 00 01 92 /* 35 samsung_brightness_aor_40.85 72~111 */
			39 01 00 00 00 00 05 B2 00 00 01 66 /* 36 samsung_brightness_aor_36.38 119 */
			39 01 00 00 00 00 05 B2 00 00 01 3E /* 37 samsung_brightness_aor_32.32 126 */
			39 01 00 00 00 00 05 B2 00 00 01 16 /* 38 samsung_brightness_aor_28.25 134 */
			39 01 00 00 00 00 05 B2 00 00 00 E3 /* 39 samsung_brightness_aor_23.07 143 */
			39 01 00 00 00 00 05 B2 00 00 00 B5 /* 40 samsung_brightness_aor_18.39 152 */
			39 01 00 00 00 00 05 B2 00 00 00 7B /* 41 samsung_brightness_aor_12.50 162 */
			39 01 00 00 00 00 05 B2 00 00 00 47 /* 42 samsung_brightness_aor_7.22  172 */
			39 01 00 00 00 00 05 B2 00 00 00 0A /* 43 samsung_brightness_aor_1.02  183~350 */
		];

		samsung,aid_map_table_revA = <
			5	0		6	1		7	2		8	3		9	4
			10	5		11	6		12	7		13	8		14	9
			15	10		16	11		17	12		19	13		20	14
			21	15		22	16		24	17		25	18		27	19
			29	20		30	21		32	22		34	23		37	24
			39	25		41	26		44	27		47	28		50	29
			53	30		56	31		60	32		64	33		68	34
			72	35		77	35		82	35		87	35		93	35
			98	35		105	35		111	35		119	36		126	37
			134	38		143	39		152	40		162	41		172	42
			183	43		195	43		207	43		220	43		234	43
			249	43		265	43		282	43		300	43		316	43
			333	43		350	43
		>;

		//========================================
		// ACL command list and mappings (REV. A)
		//========================================
		samsung,acl_on_tx_cmds_revA  = [
			39 01 00 00 00 00 02 55 02	// ACL ON : 15 %
			39 01 00 00 00 00 02 F7 03
		];
		samsung,acl_off_tx_cmds_revA = [
			39 01 00 00 00 00 02 55 00	// ACL OFF
			39 01 00 00 00 00 02 F7 03
		];

		/*
		 * ************************************************************************************************************************
		 * SMART ACL(ACL On) ELVSS command list and mappings
		 * ************************************************************************************************************************
		 */
		samsung,smart_acl_elvss_tx_cmds_revA = [
			39 01 00 00 00 00 03 B6 CC 8B /* 0    5~20 nit */
			39 01 00 00 00 00 03 B6 CC 8D /* 1    21 nit */
			39 01 00 00 00 00 03 B6 CC 8F /* 2    22 nit */
			39 01 00 00 00 00 03 B6 CC 91 /* 3    24 nit */
			39 01 00 00 00 00 03 B6 CC 93 /* 4    25 nit */
			39 01 00 00 00 00 03 B6 CC 95 /* 5    27 nit */
			39 01 00 00 00 00 03 B6 CC 97 /* 6    29 nit */
			39 01 00 00 00 00 03 B6 CC 98 /* 7    30~105 nit */
			39 01 00 00 00 00 03 B6 CC 98 /* 8    111 nit */
			39 01 00 00 00 00 03 B6 CC 98 /* 9    119 nit */
			39 01 00 00 00 00 03 B6 CC 98 /* 10   126 nit */
			39 01 00 00 00 00 03 B6 CC 97 /* 11   134 nit */
			39 01 00 00 00 00 03 B6 CC 97 /* 12   143 nit */
			39 01 00 00 00 00 03 B6 CC 96 /* 13   152 nit */
			39 01 00 00 00 00 03 B6 CC 96 /* 14   162 nit */
			39 01 00 00 00 00 03 B6 CC 95 /* 15   172 nit */
			39 01 00 00 00 00 03 B6 CC 95 /* 16   183 nit */
			39 01 00 00 00 00 03 B6 CC 94 /* 17   195 nit */
			39 01 00 00 00 00 03 B6 CC 93 /* 18   207 nit */
			39 01 00 00 00 00 03 B6 CC 92 /* 19   220 nit */
			39 01 00 00 00 00 03 B6 CC 92 /* 20   234 nit */
			39 01 00 00 00 00 03 B6 CC 91 /* 21   249 nit */
			39 01 00 00 00 00 03 B6 CC 90 /* 22   265 nit */
			39 01 00 00 00 00 03 B6 CC 8F /* 23   282 nit */
			39 01 00 00 00 00 03 B6 CC 8E /* 24   300 nit */
			39 01 00 00 00 00 03 B6 CC 8D /* 25   316 nit */
			39 01 00 00 00 00 03 B6 CC 8C /* 26   333 nit */
			39 01 00 00 00 00 03 B6 CC 8B /* 27   350 nit */
		];

		/* bl_level, Index in elvss command list */
		samsung,smart_acl_elvss_map_table_revA = <
					5	0		6	0		7	0		8	0		9	0
					10	0		11	0		12	0		13	0		14	0
					15	0		16	0		17	0		19	0		20	0
					21	1		22	2		24	3		25	4		27	5
					29	6		30	7		32	7		34	7		37	7
					39	7		41	7		44	7		47	7		50	7
					53	7		56	7		60	7		64	7		68	7
					72	7		77	7		82	7		87	7		93	7
					98	7		105	7		111	8		119	9		126	10
					134	11		143	12		152	13		162	14		172	15
					183	16		195	17		207	18		220	19		234	20
					249	21		265	22		282	23		300	24		316	25
					333	26		350	27
		>;

		/*
		* ************************************************************************************************************************
		* candela to index mappings
		* ************************************************************************************************************************
		*/
		samsung,candela_map_table_revA = <
		/*<idx>	  <from>  <till> <candella> */
				0		0		5		5
				1		6		6		6
				2		7		7		7
				3		8		8		8
				4		9		9		9
				5		10		10		10
				6		11		11		11
				7		12		12		12
				8		13		13		13
				9		14		14		14
				10		15		15		15
				11		16		16		16
				12		17		17		17
				13		18		18		19
				14		19		19		20
				15		20		20		21
				16		21		21		22
				17		22		22		24
				18		23		23		25
				19		24		24		27
				20		25		25		29
				21		26		26		30
				22		27		27		32
				23		28		28		34
				24		29		29		37
				25		30		30		39
				26		31		32		41
				27		33		34		44
				28		35		36		47
				29		37		38		50
				30		39		40		53
				31		41		43		56
				32		44		45		60
				33		46		48		64
				34		49		51		68
				35		52		55		72
				36		56		59		77
				37		60		63		82
				38		64		67		87
				39		68		71		93
				40		71		74		98
				41		75		79		105
				42		80		85		111
				43		86		91		119
				44		92		97		126
				45		97		103		134
				46		104		110		143
				47		111		117		152
				48		118		125		162
				49		126		133		172
				50		134		142		183
				51		143		151		195
				52		152		161		207
				53		162		171		220
				54		172		182		234
				55		183		194		249
				56		195		206		265
				57		207		218		282
				58		219		230		300
				59		231		242		316
				60		243		253		333
				61		254		255		350
		>;
		
		samsung,hbm_candela_map_table_revA = <
				/* <idx> <from> <till> <candela> <auto_brightness> */
				0		256		256		500		6
		>;
	};
};