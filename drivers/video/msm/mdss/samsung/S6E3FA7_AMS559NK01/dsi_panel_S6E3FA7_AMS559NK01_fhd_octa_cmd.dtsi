/* Copyright (c) 2013-2014, The Linux Foundation. All rights reserved.
 *
 * This program is free software; you can redistribute it and/or modify
 * it under the terms of the GNU General Public License version 2 and
 * only version 2 as published by the Free Software Foundation.
 *
 * This program is distributed in the hope that it will be useful,
 * but WITHOUT ANY WARRANTY; without even the implied warranty of
 * MERCHANTABILITY or FITNESS FOR A PARTICULAR PURPOSE.  See the
 * GNU General Public License for more details.
 */

/*---------------------------------------------------------------------------
 * This file is autogenerated file using gcdb parser. Please do not edit it.
 * Update input XML file to add a new entry or update variable in this file
 * VERSION = "1.0"
 *---------------------------------------------------------------------------*/
&mdss_mdp {
	ss_dsi_panel_S6E3FA7_AMS559NK01_FHD: ss_dsi_panel_S6E3FA7_AMS559NK01_FHD {
		qcom,mdss-dsi-panel-name = "ss_dsi_panel_S6E3FA7_AMS559NK01_FHD";
		label = "ss_dsi_panel_S6E3FA7_AMS559NK01_FHD";
		/*qcom,mdss-dsi-panel-controller = <&mdss_dsi0>;*/
		qcom,mdss-dsi-bpp = <24>;
		qcom,mdss-dsi-panel-width = <1080>;
		qcom,mdss-dsi-panel-height = <2220>;
		qcom,mdss-dsi-t-clk-pre = <0x35>; /*53*/
		qcom,mdss-dsi-t-clk-post = <0x0E>; /*14*/
		qcom,mdss-dsi-panel-framerate = <60>;
		qcom,mdss-dsi-panel-clockrate = <999900000>; /*999.9*/
		qcom,mdss-dsi-panel-timings-phy-v2 = [
			25 1f 09 0A 06 03 04 a0
			25 1f 09 0A 06 03 04 a0
			25 1f 09 0A 06 03 04 a0
			25 1f 09 0A 06 03 04 a0
			25 1f 08 0A 06 03 04 a0
		];

		qcom,mdss-dsi-h-pulse-width = <24>;
		qcom,mdss-dsi-h-back-porch = <36>;
		qcom,mdss-dsi-h-front-porch = <100>;
		qcom,mdss-dsi-h-sync-skew = <0>;
		qcom,mdss-dsi-v-pulse-width = <2>;
		qcom,mdss-dsi-v-back-porch = <2>;
		qcom,mdss-dsi-v-front-porch = <16>;

		qcom,mdss-dsi-h-left-border = <0>;
		qcom,mdss-dsi-h-right-border = <0>;
		qcom,mdss-dsi-v-top-border = <0>;
		qcom,mdss-dsi-v-bottom-border = <0>;
		qcom,mdss-dsi-underflow-color = <0xFF>;
		qcom,mdss-dsi-border-color = <0>;
		qcom,mdss-dsi-bl-pmic-control-type = "bl_ctrl_dcs";

		qcom,mdss-dsi-bl-min-level = <1>;
		qcom,mdss-dsi-bl-max-level = <365>;
		qcom,mdss-brightness-max-level = <365>;

		qcom,mdss-dsi-interleave-mode = <0>;
		qcom,mdss-dsi-panel-type = "dsi_cmd_mode";

		qcom,mdss-dsi-te-check-enable;
		qcom,mdss-dsi-te-using-te-pin;
		qcom,mdss-dsi-te-pin-select = <1>;

		qcom,mdss-dsi-te-dcs-command = <1>;
		qcom,mdss-dsi-wr-mem-start = <0x2C>;
		qcom,mdss-dsi-wr-mem-continue = <0x3C>;

		/* CMD mode panel doesn't need below stuff */
		qcom,mdss-dsi-h-sync-pulse= <0>;
		/*qcom,mdss-dsi-hfp-power-mode=*/
		/*qcom,mdss-dsi-hbp-power-mode=*/
		/*qcom,mdss-dsi-hsa-power-mode=*/
		/*qcom,mdss-dsi-last-line-interleave=*/
		qcom,mdss-dsi-bllp-eof-power-mode;
		qcom,mdss-dsi-bllp-power-mode;
		qcom,mdss-dsi-traffic-mode= "burst_mode";

		qcom,mdss-dsi-pixel-packing = "loose";

		qcom,mdss-dsi-virtual-channel-id = <0>;
		qcom,mdss-dsi-color-order = "rgb_swap_rgb";
		qcom,mdss-dsi-lane-0-state;
		qcom,mdss-dsi-lane-1-state;
		qcom,mdss-dsi-lane-2-state;
		qcom,mdss-dsi-lane-3-state;

		qcom,mdss-dsi-stream = <0>;
		qcom,mdss-dsi-mdp-trigger = "none";
		qcom,mdss-dsi-dma-trigger = "trigger_sw";

		qcom,mdss-dsi-off-command-state = "dsi_hs_mode";

		qcom,mdss-pan-physical-width-dimension = <62>;
		qcom,mdss-pan-physical-height-dimension = <128>;

		qcom,mdss-dsi-reset-sequence = <1 10>, <0 5>, <1 10>;

		/* S6E3FA3(LDI) Does not support Partial Update */
		/*qcom,partial-update-enabled;*/
		/*qcom,panel-roi-alignment=<8 8 1 1 1 1>;*/
		/*qcom,mdss-dsi-horizontal-line-idle*/

		qcom,mdss-dsi-lp11-init;
		qcom,mdss-dsi-init-delay-us = <1000>;

		qcom,mdss-dsi-rx-eot-ignore;
		qcom,mdss-dsi-tx-eot-append;
		qcom,ulps-enabled;

		/*qcom,mdss-dsi-panel-status-command=*/
		/*qcom,mdss-dsi-panel-status-command-mode="dsi_lp_mode";*/
		qcom,esd-check-enabled;
		qcom,mdss-dsi-panel-status-check-mode="reg_read_irq";
		/*qcom,mdss-dsi-panel-status-value = <1>;*/
		qcom,mdss-dsi-panel-status-irq-trigger1="rising";
		qcom,mdss-dsi-panel-status-irq-trigger2="falling";

		qcom,dynamic-mode-switch-enabled;
		qcom,dynamic-mode-switch-type = "dynamic-resolution-switch-immediate";
		/*qcom,dynamic-mode-switch-enabled*/
		/*qcom,video-to-cmd-mode-switch-commands=*/
		/*qcom,cmd-to-video-mode-switch-commands=*/

		qcom,mdss-dsi-off-command=[
			05 01 00 00 0A 00 02 28 00	/* wait 10ms(0x0A) */
			05 01 00 00 78 00 02 10 00	/* wait 120ms(0x78) */
		];
		qcom,adjust-timer-wakeup-ms = <1>;

/*
 * ************************************************************************************************************************************
 *
 *
 *			Below  parameters are samsung dependent thigs
 *
 *
 * ************************************************************************************************************************************
 */
		/*samsung,support_multires;*/

		samsung,support_panel_max = <1>;
		samsung,hw-config = "single_dsi";
		samsung,panel-lpm-enable;
		samsung,support_irc;

/*		samsung,support_poc_driver;*/
/*
 * ************************************************************************************************************************************
 *
 *
 *			for log debug
 *
 *
 * ************************************************************************************************************************************
 */
		samsung,ldi_log_disable_tx_cmds_revA = [
			29 01 00 00 00 00 02 F2 00			/* DDI Log Disable */
		];

		samsung,ldi_log_enable_tx_cmds_revA = [
			29 01 00 00 00 00 02 F2 13			/* DDI Log Enable */
		];

		samsung,ldi_log_rx_cmds_revA		= [06 01 00 00 00 00 01 9C 80 00];
/*
* ************************************************************************************************************************
*  POC CONTROL
* ************************************************************************************************************************
*/

		samsung,poc_erase_delay_ms = <18000>;
		samsung,poc_write_delay_us = <4000>;

		samsung,poc_erase_tx_cmds_revA = [
			29 01 00 00 00 00 03 F0 5A 5A
			29 01 00 00 00 00 03 F1 F1 A2
			29 01 00 00 00 00 02 C0 02								/* PGM EN (START) */
			29 01 00 00 00 00 0B C1 00 06 00 00 00 00 00 00 00 01	/* Write Enable & Bit Rate */
			29 01 00 00 01 00 02 C0 03								/* EXE_INST + 1ms */
			29 01 00 00 00 00 06 C1 00 C7 00 10 00					/* INST_ADDR  : Chip Erase */
			29 01 00 00 00 00 02 C0 03								/* EXE_INST + 18s Delay */
		];

		samsung,poc_erase1_tx_cmds_revA = [
			29 01 00 00 00 00 02 C0 00			/* PGM  Disable (END) */
			29 01 00 00 00 00 03 F0 A5 A5
			29 01 00 00 00 00 03 F1 A5 A5
		];

		samsung,poc_pre_write_tx_cmds_revA = [
			29 00 00 00 00 00 03 F0 5A 5A
			29 00 00 00 00 00 03 F1 F1 A2
			29 00 00 00 00 00 02 C0 02								/* PGM EN (START) */
			29 01 00 00 00 00 0B C1 00 06 00 00 00 00 00 00 00 01	/* Write Enable & Bit Rate */
			29 01 00 00 01 00 02 C0 03								/* Exe + 2 us */
			29 00 00 00 00 00 0A C1 00 01 40 00 00 00 00 00 10		/* STATUS_register WEL, QE */
			29 01 00 00 1E 00 02 C0 03								/* Exe + 30 ms */
			29 00 00 00 00 00 0A C1 00 06 00 00 00 00 00 00 00
			29 01 00 00 01 00 02 C0 03								/* Exe + 1 ms */
			29 01 00 00 00 00 0B C1 00 32 00 00 00 00 00 00 40 01	/* Quad_PGM, FLASH_CONT_WRITE, BIT_RATE */
		];

		samsung,poc_write_1byte_tx_cmds_revA = [
			29 00 00 00 00 00 02 C1 77			/* INST_ADDR */
			29 01 00 00 00 00 02 C0 03			/* EXE_INST + 2us */
		];

		samsung,poc_write_continue_tx_cmds_revA = [
			29 01 00 00 00 00 0B C1 00 32 00 00 00 00 00 00 80 01	/* write end code  + 4ms*/
		];

		samsung,poc_write_continue2_tx_cmds_revA = [
			29 00 00 00 00 00 03 C1 00 06
			29 01 00 00 00 00 02 C0 03								/* Exe + 2 us */
		];

		samsung,poc_write_continue3_tx_cmds_revA = [
			29 01 00 00 00 00 0B C1 00 32 00 00 00 00 00 00 40 01	/* Quad_PGM, FLASH_CONT_WRITE, BIT_RATE */
		];

		samsung,poc_post_write_tx_cmds_revA = [
			29 00 00 00 00 00 02 C0 00
			29 00 00 00 00 00 03 F0 A5 A5
			29 01 00 00 00 00 03 F1 A5 A5
		];

		samsung,poc_pre_read_tx_cmds_revA = [
			29 00 00 00 00 00 03 F0 5A 5A
			29 00 00 00 00 00 03 F1 F1 A2
			29 00 00 00 00 00 02 C0 02									/* PGM EN (START) */
			29 01 00 00 00 00 0B C1 00 06 00 00 00 00 00 00 00 01		/* Write Enable & Bit Rate */
			29 01 00 00 01 00 02 C0 03									/* EXE_INST + 2 us Delay */
			29 00 00 00 00 00 0A C1 00 01 40 00 00 00 00 00 10			/* STATUS_register	QE */
			29 01 00 00 1E 00 02 C0 03									/* EXE_INST + 30ms */
		];

		samsung,poc_read_tx_cmds_revA = [
			29 00 00 00 00 00 0C C1 00 6B 00 00 00 00 00 00 00 01 01	/* Read Address Setting */
			29 00 00 00 00 00 02 C0 03							/* Flash Pgm Execution  + 200 us */
			29 01 00 00 00 00 02 B0 12							/* B0 global para set to reduce rx time */
		];

		samsung,poc_post_read_tx_cmds_revA = [
			29 00 00 00 00 00 02 C0 00
			29 00 00 00 00 00 03 F0 A5 A5
			29 01 00 00 00 00 03 F1 A5 A5
		];

		samsung,reg_poc_read_pos_tx_cmds_revA = [
			15 01 00 00 00 00 02 B0 12	/* B0 para is set with poc_read_tx_cmds_revA to reduce rx time */
		];

		samsung,poc_status_rx_cmds_revA		= [06 01 00 00 00 00 01 EB 04 00];	/* EB Check  */
		samsung,poc_read_rx_cmds_revA		= [06 01 00 00 00 00 01 EC 01 12];	/* read flash */
		samsung,poc_checksum_rx_cmds_revA	= [06 01 00 00 00 00 01 EC 05 00];	/* CheckSum */

		/*
		* ************************************************************************************************************************
		*  Tx
		* ************************************************************************************************************************
		*/

		samsung,display_on_tx_cmds_revA = [
			05 01 00 00 0A 00 02 29 00 /* wait 10ms */
			05 01 00 00 00 00 02 13 00];

		samsung,display_off_tx_cmds_revA = [
			05 01 00 00 14 00 02 28 00
		];

		samsung,level1_key_enable_tx_cmds_revA = [
			29 01 00 00 00 00 03 F0 5A 5A
		];
		samsung,level1_key_disable_tx_cmds_revA = [
			29 01 00 00 00 00 03 F0 A5 A5
		];
		samsung,level2_key_enable_tx_cmds_revA = [
			29 00 00 00 00 00 03 F0 5A 5A
			29 01 00 00 00 00 03 FC 5A 5A
		];
		samsung,level2_key_disable_tx_cmds_revA = [
			29 00 00 00 00 00 03 F0 A5 A5
			29 01 00 00 00 00 03 FC A5 A5
		];

		samsung,packet_size_tx_cmds_revA = [
			37 01 00 00 00 00 02 07 00
		];

		/*
		 * First parameters can be changed
		 * by function of samsung_nv_read()
		 * because of that means offset of
		 * read position
		 */
		samsung,reg_read_pos_tx_cmds_revA = [
			15 01 00 00 00 00 02 B0 00
		];

		/*
		 * ************************************************************************************************************************
		 *	 06 01 00 00 00 00 01 c8 07 21
		 *	READ 0xC8 SIZE 0x07 OFFSET 0x21
		 * ************************************************************************************************************************
		 */
		samsung,smart_dimming_mtp_rx_cmds_revA = [ 06 01 00 00 00 00 01 c8 20 00]; /* read C8 32para */
		/* the last byte in all read commands will represent READ LENGH */
		samsung,manufacture_id0_rx_cmds_revA = [ 06 01 00 00 00 00 01 da 01 00];
		samsung,manufacture_id1_rx_cmds_revA = [ 06 01 00 00 00 00 01 db 01 00];
		samsung,manufacture_id2_rx_cmds_revA = [ 06 01 00 00 00 00 01 dc 01 00];

		samsung,manufacture_date_rx_cmds_revA = [ 06 01 00 00 00 00 01 c8 04 28];	/* read C8 41~44th , 40=0x28*/
		samsung,ddi_id_rx_cmds_revA = [ 06 01 00 00 00 00 01 d6 05 00];	/* read D6 1~5th */
		samsung,cell_id_rx_cmds_revA = [ 06 01 00 00 00 00 01 C8 07 28]; /* read C8 41th~47th */
		samsung,octa_id_rx_cmds_revA = [06 01 00 00 00 00 01 C9 14 01];  // read C9 2th~21th
		samsung,mtp_read_sysfs_rx_cmds_revA = [ 06 01 00 00 00 00 01 01 01 01];

		samsung,mdnie_read_rx_cmds_revA	= [ 06 01 00 00 00 00 01 A1 04 00];

		samsung,ldi_debug0_rx_cmds_revA		= [06 01 00 00 00 00 01 0A 01 00];
		samsung,ldi_debug1_rx_cmds_revA		= [06 01 00 00 00 00 01 ED 01 00];
	/*	samsung,ldi_debug2_rx_cmds_revA		= [06 01 00 00 00 00 01 EE 01 00]; */
	/*	samsung,ldi_debug3_rx_cmds_revA		= [06 01 00 00 00 00 01 0E 01 00]; */
	/*	samsung,ldi_debug4_rx_cmds_revA		= [06 01 00 00 00 00 01 05 01 00]; */
	/*	samsung,ldi_debug5_rx_cmds_revA		= [06 01 00 00 00 00 01 0F 01 00]; */

		/*
		 * ************************************************************************************************************************
		 *	 COMMON CMD LIST
		 * ************************************************************************************************************************
		 */

		samsung,gamma_tx_cmds_revA = [
		29 01 00 00 00 00 22 CA				/* 1) Gamma 2.2 Setting */
						07					/* VTR/V255 R[8],G[8],B[8] */
						00					/* VTG/VTB */
						00					/* V255 R[7:0] */
						00					/* V255 G[7:0] */
						00					/* nothing */
						00					/* V255 B[7:0] */
						80 80 80			/* V203 R,G,B */
						80 80 80			/* V151 R,G,B */
						80 80 80			/* V87 R,G,B */
						80 80 80			/* V51 R,G,B */
						80 80 80			/* V35 R,G,B */
						80 80 80			/* V23 R,G,B */
						80 80 80			/* V11 R,G,B */
						80 80 80			/*  V7 R,G,B */
						80 80 80			/*  V1 R,G,B */

			29 01 00 00 00 00 02 F7 03	/* Gamma, LTPS(AID) update */

			29 01 00 00 00 00 3C		/* dummy for single transmission more 100ns delay */
			00 00 00 00 00 00 00 00 00 00
			00 00 00 00 00 00 00 00 00 00
			00 00 00 00 00 00 00 00 00 00
			00 00 00 00 00 00 00 00 00 00
			00 00 00 00 00 00 00 00 00 00
			00 00 00 00 00 00 00 00 00 00
		];

		/*
		* ************************************************************************************************************************
		*  HBM
		* ************************************************************************************************************************
		*/

		samsung,enter_hbm_lux = <10000>;

		samsung,hbm_rx_cmds_revA = [ 06 01 00 00 00 00 01 B3 20 02];	/* read B3 3th~34th / 32=0x20*/

		samsung,hbm_gamma_tx_cmds_revA = [
		29 01 00 00 00 00 22 CA				/* 1) Gamma 2.2 Setting */
						07					/* VTR/V255 R[8],G[8],B[8] */
						00					/* VTG/VTB */
						00					/* V255 R[7:0] */
						00					/* V255 G[7:0] */
						00					/* nothing */
						00					/* V255 B[7:0] */
						80 80 80			/* V203 R,G,B */
						80 80 80			/* V151 R,G,B */
						80 80 80			/* V87 R,G,B */
						80 80 80			/* V51 R,G,B */
						80 80 80			/* V35 R,G,B */
						80 80 80			/* V23 R,G,B */
						80 80 80			/* V11 R,G,B */
						80 80 80			/*  V7 R,G,B */
						80 80 80			/*  V1 R,G,B */
		];

		samsung,hbm_etc_tx_cmds_revA = [
			29 01 00 00 00 00 03 B1 00 10		/* AID set : AOR 0% */
			29 01 00 00 00 00 18 B5 19 DC 04 01 34 67 9A CD 01 22 33 44 C0 00 09 99 33 13 01 11 10 00 00
			29 01 00 00 00 00 0E B4 50 80 64 48 29 9C
									55 55 55 3F B7 12 50 /*  1st, 13th : 0x50 32frame avg, 2,3th: 0x80 0x64 start step 60% 5th: 0x29 ACL 8% */
			29 01 00 00 00 00 02 55 02				/* ACL ON */
			29 01 00 00 00 00 02 F7 03			/* Gamma, LTPS(AID) update */
		];

		/*
		 * ************************************************************************************************************************
		 * AID command list and mappings
		 * ************************************************************************************************************************
		 */
		/* bl_level, Index in acl command list */
		samsung,aid_tx_cmds_revA = [
			/*	0	*/29 01 00 00 00 00 03 B1 08 98	/*   2CD */
			/*	1	*/29 01 00 00 00 00 03 B1 08 87 /*   3CD */
			/*	2	*/29 01 00 00 00 00 03 B1 08 75 /*   4CD */
			/*	3	*/29 01 00 00 00 00 03 B1 08 62 /*   5CD */
			/*	4	*/29 01 00 00 00 00 03 B1 08 51 /*   6CD */
			/*	5	*/29 01 00 00 00 00 03 B1 08 37 /*   7CD */
			/*	6	*/29 01 00 00 00 00 03 B1 08 25 /*   8CD */
			/*	7	*/29 01 00 00 00 00 03 B1 08 11 /*   9CD */
			/*	8	*/29 01 00 00 00 00 03 B1 07 F6 /*  10CD */
			/*	9	*/29 01 00 00 00 00 03 B1 07 E3 /*  11CD */
			/*	10	*/29 01 00 00 00 00 03 B1 07 C8 /*  12CD */
			/*	11	*/29 01 00 00 00 00 03 B1 07 B3 /*  13CD */
			/*	12	*/29 01 00 00 00 00 03 B1 07 96 /*  14CD */
			/*	13	*/29 01 00 00 00 00 03 B1 07 82 /*  15CD */
			/*	14	*/29 01 00 00 00 00 03 B1 07 66 /*  16CD */
			/*	15	*/29 01 00 00 00 00 03 B1 07 53 /*  17CD */
			/*	16	*/29 01 00 00 00 00 03 B1 07 24 /*  19CD */
			/*	17	*/29 01 00 00 00 00 03 B1 07 12 /*  20CD */
			/*	18	*/29 01 00 00 00 00 03 B1 06 F6 /*  21CD */
			/*	19	*/29 01 00 00 00 00 03 B1 06 E4 /*  22CD */
			/*	20	*/29 01 00 00 00 00 03 B1 06 B6 /*  24CD */
			/*	21	*/29 01 00 00 00 00 03 B1 06 A4 /*  25CD */
			/*	22	*/29 01 00 00 00 00 03 B1 06 77 /*  27CD */
			/*	23	*/29 01 00 00 00 00 03 B1 06 52 /*  29CD */
			/*	24	*/29 01 00 00 00 00 03 B1 06 35 /*  30CD */
			/*	25	*/29 01 00 00 00 00 03 B1 06 10 /*  32CD */
			/*	26	*/29 01 00 00 00 00 03 B1 05 E2 /*  34CD */
			/*	27	*/29 01 00 00 00 00 03 B1 05 9F /*  37CD */
			/*	28	*/29 01 00 00 00 00 03 B1 05 73 /*  39CD */
			/*	29	*/29 01 00 00 00 00 03 B1 05 43 /*  41CD */
			/*	30	*/29 01 00 00 00 00 03 B1 04 F8 /*  44CD */
			/*	31	*/29 01 00 00 00 00 03 B1 04 B5 /*  47CD */
			/*	32	*/29 01 00 00 00 00 03 B1 04 6D /*  50CD */
			/*	33	*/29 01 00 00 00 00 03 B1 04 26 /*  53CD */
			/*	34	*/29 01 00 00 00 00 03 B1 03 E7 /*  56CD */
			/*	35	*/29 01 00 00 00 00 03 B1 03 84 /*  60CD */
			/*	36	*/29 01 00 00 00 00 03 B1 03 30 /*  64CD */
			/*	37	*/29 01 00 00 00 00 03 B1 03 18 /*  68CD */
			/*	38	*/29 01 00 00 00 00 03 B1 03 18 /*  72CD */
			/*	39	*/29 01 00 00 00 00 03 B1 03 18 /*  77 ~ 183CD*/
			/*	40	*/29 01 00 00 00 00 03 B1 02 C1 /* 195CD */
			/*	41	*/29 01 00 00 00 00 03 B1 02 56 /* 207CD */
			/*	42	*/29 01 00 00 00 00 03 B1 01 D3 /* 220CD */
			/*	43	*/29 01 00 00 00 00 03 B1 01 59 /* 234CD */
			/*	44	*/29 01 00 00 00 00 03 B1 00 E5 /* 249~365CD */
			/*	45	*/29 01 00 00 00 00 03 B1 00 B5 /* 372 CD */
			/*	46	*/29 01 00 00 00 00 03 B1 00 92 /* 380 CD */
			/*	47	*/29 01 00 00 00 00 03 B1 00 69 /* 387 CD */
			/*	48	*/29 01 00 00 00 00 03 B1 00 38 /* 395 CD */
			/*	49	*/29 01 00 00 00 00 03 B1 00 10 /* 403 CD */
			/*	50	*/29 01 00 00 00 00 03 B1 00 10 /* 412 CD */
			/*	51	*/29 01 00 00 00 00 03 B1 00 10 /* 420 CD */
		];


		/* bl_level, Index in acl command list */
		samsung,aid_map_table_revA = <
			2	0		3	1		4	2		5	3		6	4
			7	5		8	6		9	7		10	8		11	9
			12	10		13	11		14	12		15	13		16	14
			17	15		19	16		20	17		21	18		22	19
			24	20		25	21		27	22		29	23		30	24
			32	25		34	26		37	27		39	28		41	29
			44	30		47	31		50	32		53	33		56	34
			60	35		64	36		68	37		72	38		77	39
			82	39		87	39		93	39		98	39		105	39
			111	39		119	39		126	39		134	39		143	39
			152	39		162	39		172	39		183	39		195	40
			207	41		220	42		234	43		249	44		265	44
			282	44		300	44		316	44		333	44		350	44
			357	44		365	44		372	45		380	46		387	47
			395	48		403	49		412	50		420	51
		>;

		samsung,aid_subdivision_tx_cmds_revA = [
			29 01 00 00 00 00 03 B1 08 98
			29 01 00 00 00 00 03 B1 08 96
			29 01 00 00 00 00 03 B1 08 94
			29 01 00 00 00 00 03 B1 08 92
			29 01 00 00 00 00 03 B1 08 8D
			29 01 00 00 00 00 03 B1 08 8B
			29 01 00 00 00 00 03 B1 08 89
			29 01 00 00 00 00 03 B1 08 87
			29 01 00 00 00 00 03 B1 08 85
			29 01 00 00 00 00 03 B1 08 83
			29 01 00 00 00 00 03 B1 08 81
			29 01 00 00 00 00 03 B1 08 7B
			29 01 00 00 00 00 03 B1 08 79
			29 01 00 00 00 00 03 B1 08 77
			29 01 00 00 00 00 03 B1 08 75
			29 01 00 00 00 00 03 B1 08 73
			29 01 00 00 00 00 03 B1 08 71
			29 01 00 00 00 00 03 B1 08 6F
			29 01 00 00 00 00 03 B1 08 6D
			29 01 00 00 00 00 03 B1 08 66
			29 01 00 00 00 00 03 B1 08 64
			29 01 00 00 00 00 03 B1 08 62
			29 01 00 00 00 00 03 B1 08 60
			29 01 00 00 00 00 03 B1 08 5E
			29 01 00 00 00 00 03 B1 08 5C
			29 01 00 00 00 00 03 B1 08 57
			29 01 00 00 00 00 03 B1 08 55
			29 01 00 00 00 00 03 B1 08 53
			29 01 00 00 00 00 03 B1 08 51
			29 01 00 00 00 00 03 B1 08 4F
			29 01 00 00 00 00 03 B1 08 4D
			29 01 00 00 00 00 03 B1 08 4B
			29 01 00 00 00 00 03 B1 08 3B
			29 01 00 00 00 00 03 B1 08 39
			29 01 00 00 00 00 03 B1 08 37
			29 01 00 00 00 00 03 B1 08 2E
			29 01 00 00 00 00 03 B1 08 25
			29 01 00 00 00 00 03 B1 08 1B
			29 01 00 00 00 00 03 B1 08 11
			29 01 00 00 00 00 03 B1 08 03
			29 01 00 00 00 00 03 B1 07 F6
			29 01 00 00 00 00 03 B1 07 ED
			29 01 00 00 00 00 03 B1 07 E3
			29 01 00 00 00 00 03 B1 07 D5
			29 01 00 00 00 00 03 B1 07 C8
			29 01 00 00 00 00 03 B1 07 BE
			29 01 00 00 00 00 03 B1 07 B3
			29 01 00 00 00 00 03 B1 07 A4
			29 01 00 00 00 00 03 B1 07 96
			29 01 00 00 00 00 03 B1 07 8C
			29 01 00 00 00 00 03 B1 07 82
			29 01 00 00 00 00 03 B1 07 74
			29 01 00 00 00 00 03 B1 07 66
			29 01 00 00 00 00 03 B1 07 5D
			29 01 00 00 00 00 03 B1 07 53
			29 01 00 00 00 00 03 B1 07 3C
			29 01 00 00 00 00 03 B1 07 24
			29 01 00 00 00 00 03 B1 07 12
			29 01 00 00 00 00 03 B1 07 04
			29 01 00 00 00 00 03 B1 06 F6
			29 01 00 00 00 00 03 B1 06 ED
			29 01 00 00 00 00 03 B1 06 E4
			29 01 00 00 00 00 03 B1 06 CD
			29 01 00 00 00 00 03 B1 06 B6
			29 01 00 00 00 00 03 B1 06 AD
			29 01 00 00 00 00 03 B1 06 A4
			29 01 00 00 00 00 03 B1 06 8E
			29 01 00 00 00 00 03 B1 06 77
			29 01 00 00 00 00 03 B1 06 65
			29 01 00 00 00 00 03 B1 06 52
			29 01 00 00 00 00 03 B1 06 35
			29 01 00 00 00 00 03 B1 06 22
			29 01 00 00 00 00 03 B1 06 10
			29 01 00 00 00 00 03 B1 05 F9
			29 01 00 00 00 00 03 B1 05 E2
			29 01 00 00 00 00 03 B1 05 C1
			29 01 00 00 00 00 03 B1 05 9F
			29 01 00 00 00 00 03 B1 05 89
			29 01 00 00 00 00 03 B1 05 73
			29 01 00 00 00 00 03 B1 05 5B
			29 01 00 00 00 00 03 B1 05 43
			29 01 00 00 00 00 03 B1 05 1E
			29 01 00 00 00 00 03 B1 04 F8
			29 01 00 00 00 00 03 B1 04 D6
			29 01 00 00 00 00 03 B1 04 B5
			29 01 00 00 00 00 03 B1 04 91
			29 01 00 00 00 00 03 B1 04 6D
			29 01 00 00 00 00 03 B1 04 4A
			29 01 00 00 00 00 03 B1 04 26
			29 01 00 00 00 00 03 B1 04 06
			29 01 00 00 00 00 03 B1 03 E7
			29 01 00 00 00 00 03 B1 03 B6
			29 01 00 00 00 00 03 B1 03 84
			29 01 00 00 00 00 03 B1 03 5A
			29 01 00 00 00 00 03 B1 03 30
			29 01 00 00 00 00 03 B1 03 43
			29 01 00 00 00 00 03 B1 03 18
			29 01 00 00 00 00 03 B1 03 40
			29 01 00 00 00 00 03 B1 03 18
			29 01 00 00 00 00 03 B1 03 47
			29 01 00 00 00 00 03 B1 03 18
			29 01 00 00 00 00 03 B1 03 44
			29 01 00 00 00 00 03 B1 03 18
			29 01 00 00 00 00 03 B1 03 42
			29 01 00 00 00 00 03 B1 03 18
			29 01 00 00 00 00 03 B1 03 47
			29 01 00 00 00 00 03 B1 03 18
			29 01 00 00 00 00 03 B1 03 3D
			29 01 00 00 00 00 03 B1 03 18
			29 01 00 00 00 00 03 B1 03 48
			29 01 00 00 00 00 03 B1 03 18
			29 01 00 00 00 00 03 B1 03 3F
			29 01 00 00 00 00 03 B1 03 18
			29 01 00 00 00 00 03 B1 03 49
			29 01 00 00 00 00 03 B1 03 18
			29 01 00 00 00 00 03 B1 03 40
			29 01 00 00 00 00 03 B1 03 18
			29 01 00 00 00 00 03 B1 03 43
			29 01 00 00 00 00 03 B1 03 18
			29 01 00 00 00 00 03 B1 03 46
			29 01 00 00 00 00 03 B1 03 18
			29 01 00 00 00 00 03 B1 03 43
			29 01 00 00 00 00 03 B1 03 18
			29 01 00 00 00 00 03 B1 03 45
			29 01 00 00 00 00 03 B1 03 18
			29 01 00 00 00 00 03 B1 03 42
			29 01 00 00 00 00 03 B1 03 18
			29 01 00 00 00 00 03 B1 03 44
			29 01 00 00 00 00 03 B1 03 18
			29 01 00 00 00 00 03 B1 03 0C
			29 01 00 00 00 00 03 B1 02 FF
			29 01 00 00 00 00 03 B1 02 F3
			29 01 00 00 00 00 03 B1 02 E6
			29 01 00 00 00 00 03 B1 02 DA
			29 01 00 00 00 00 03 B1 02 CD
			29 01 00 00 00 00 03 B1 02 C1
			29 01 00 00 00 00 03 B1 02 B2
			29 01 00 00 00 00 03 B1 02 A2
			29 01 00 00 00 00 03 B1 02 93
			29 01 00 00 00 00 03 B1 02 84
			29 01 00 00 00 00 03 B1 02 75
			29 01 00 00 00 00 03 B1 02 65
			29 01 00 00 00 00 03 B1 02 56
			29 01 00 00 00 00 03 B1 02 43
			29 01 00 00 00 00 03 B1 02 31
			29 01 00 00 00 00 03 B1 02 1E
			29 01 00 00 00 00 03 B1 02 0B
			29 01 00 00 00 00 03 B1 01 F8
			29 01 00 00 00 00 03 B1 01 E6
			29 01 00 00 00 00 03 B1 01 D3
			29 01 00 00 00 00 03 B1 01 C4
			29 01 00 00 00 00 03 B1 01 B5
			29 01 00 00 00 00 03 B1 01 A5
			29 01 00 00 00 00 03 B1 01 96
			29 01 00 00 00 00 03 B1 01 87
			29 01 00 00 00 00 03 B1 01 77
			29 01 00 00 00 00 03 B1 01 68
			29 01 00 00 00 00 03 B1 01 59
			29 01 00 00 00 00 03 B1 01 4F
			29 01 00 00 00 00 03 B1 01 40
			29 01 00 00 00 00 03 B1 01 31
			29 01 00 00 00 00 03 B1 01 22
			29 01 00 00 00 00 03 B1 01 12
			29 01 00 00 00 00 03 B1 01 03
			29 01 00 00 00 00 03 B1 00 F4
			29 01 00 00 00 00 03 B1 00 E5
			29 01 00 00 00 00 03 B1 01 51
			29 01 00 00 00 00 03 B1 01 43
			29 01 00 00 00 00 03 B1 01 36
			29 01 00 00 00 00 03 B1 01 28
			29 01 00 00 00 00 03 B1 01 1B
			29 01 00 00 00 00 03 B1 01 0D
			29 01 00 00 00 00 03 B1 01 00
			29 01 00 00 00 00 03 B1 00 F2
			29 01 00 00 00 00 03 B1 00 E5
			29 01 00 00 00 00 03 B1 01 51
			29 01 00 00 00 00 03 B1 01 43
			29 01 00 00 00 00 03 B1 01 36
			29 01 00 00 00 00 03 B1 01 28
			29 01 00 00 00 00 03 B1 01 1B
			29 01 00 00 00 00 03 B1 01 0D
			29 01 00 00 00 00 03 B1 01 00
			29 01 00 00 00 00 03 B1 00 F2
			29 01 00 00 00 00 03 B1 00 E5
			29 01 00 00 00 00 03 B1 01 52
			29 01 00 00 00 00 03 B1 01 46
			29 01 00 00 00 00 03 B1 01 39
			29 01 00 00 00 00 03 B1 01 2D
			29 01 00 00 00 00 03 B1 01 21
			29 01 00 00 00 00 03 B1 01 15
			29 01 00 00 00 00 03 B1 01 09
			29 01 00 00 00 00 03 B1 00 FD
			29 01 00 00 00 00 03 B1 00 F1
			29 01 00 00 00 00 03 B1 00 E5
			29 01 00 00 00 00 03 B1 01 3E
			29 01 00 00 00 00 03 B1 01 31
			29 01 00 00 00 00 03 B1 01 25
			29 01 00 00 00 00 03 B1 01 18
			29 01 00 00 00 00 03 B1 01 0B
			29 01 00 00 00 00 03 B1 00 FE
			29 01 00 00 00 00 03 B1 00 F2
			29 01 00 00 00 00 03 B1 00 E5
			29 01 00 00 00 00 03 B1 01 40
			29 01 00 00 00 00 03 B1 01 35
			29 01 00 00 00 00 03 B1 01 29
			29 01 00 00 00 00 03 B1 01 1E
			29 01 00 00 00 00 03 B1 01 13
			29 01 00 00 00 00 03 B1 01 07
			29 01 00 00 00 00 03 B1 00 FC
			29 01 00 00 00 00 03 B1 00 F0
			29 01 00 00 00 00 03 B1 00 E5
			29 01 00 00 00 00 03 B1 01 3C
			29 01 00 00 00 00 03 B1 01 31
			29 01 00 00 00 00 03 B1 01 26
			29 01 00 00 00 00 03 B1 01 1B
			29 01 00 00 00 00 03 B1 01 10
			29 01 00 00 00 00 03 B1 01 06
			29 01 00 00 00 00 03 B1 00 FB
			29 01 00 00 00 00 03 B1 00 F0
			29 01 00 00 00 00 03 B1 00 E5
			29 01 00 00 00 00 03 B1 01 03
			29 01 00 00 00 00 03 B1 00 F9
			29 01 00 00 00 00 03 B1 00 EF
			29 01 00 00 00 00 03 B1 00 E5
			29 01 00 00 00 00 03 B1 01 06
			29 01 00 00 00 00 03 B1 00 FB
			29 01 00 00 00 00 03 B1 00 F0
			29 01 00 00 00 00 03 B1 00 E5
			29 01 00 00 00 00 03 B1 00 D5
			29 01 00 00 00 00 03 B1 00 C5
			29 01 00 00 00 00 03 B1 00 B5
			29 01 00 00 00 00 03 B1 00 AC
			29 01 00 00 00 00 03 B1 00 A4
			29 01 00 00 00 00 03 B1 00 9B
			29 01 00 00 00 00 03 B1 00 92
			29 01 00 00 00 00 03 B1 00 88
			29 01 00 00 00 00 03 B1 00 7D
			29 01 00 00 00 00 03 B1 00 73
			29 01 00 00 00 00 03 B1 00 69
			29 01 00 00 00 00 03 B1 00 5D
			29 01 00 00 00 00 03 B1 00 50
			29 01 00 00 00 00 03 B1 00 44
			29 01 00 00 00 00 03 B1 00 38
			29 01 00 00 00 00 03 B1 00 31
			29 01 00 00 00 00 03 B1 00 26
			29 01 00 00 00 00 03 B1 00 1B
			29 01 00 00 00 00 03 B1 00 10
			29 01 00 00 00 00 03 B1 00 34
			29 01 00 00 00 00 03 B1 00 28
			29 01 00 00 00 00 03 B1 00 1C
			29 01 00 00 00 00 03 B1 00 10
			29 01 00 00 00 00 03 B1 00 30
			29 01 00 00 00 00 03 B1 00 25
			29 01 00 00 00 00 03 B1 00 1B
			29 01 00 00 00 00 03 B1 00 10
			29 01 00 00 00 00 03 B1 00 10
		];

		/*
		 * ************************************************************************************************************************
		 * ACL command list and mappings
		 * ************************************************************************************************************************
		 */

		samsung,acl_on_tx_cmds_revA = [
			29 01 00 00 00 00 0E B4 50 40 FC 48 4D 9C
									55 55 55 3F B7 12 50 /*  1st, 13th : 0x50 32frame avg,  5th: 0x4D ACL 15% */
			29 01 00 00 00 00 02 55 02	/* ACL ON */
		];

		samsung,acl_percent_tx_cmds_revA = [
			29 01 00 00 00 00 06 B4 50 80 64 48 29  /* 1th : 0x50 32frame avg, 2 3th : 0x80 0x64 start point 60%, 5th: 0x29 ACL 8% */
			29 01 00 00 00 00 06 B4 50 40 FC 48 4D  /* 1th : 0x50 32frame avg, 2 3th : 0x40 0xFC start point 50%, 5th: 0x4D ACL 15% */
		];

		samsung,acl_off_tx_cmds_revA = [
			29 01 00 00 00 00 0E B4 40 40 FC 48 4D 9C
									55 55 55 3F B7 12 40 /*  1st, 13th : 0x40 16frame avg,  5th: 0x4D ACL 15% */
			29 01 00 00 00 00 02 55 00	 /* ACL OFF */
		];

		/* bl_level , Index in acl command list */
		samsung,acl_map_table_revA =  <
			2	1		3	1		4	1		5	1		6	1
			7	1		8	1		9	1		10	1		11	1
			12	1		13	1		14	1		15	1		16	1
			17	1		19	1		20	1		21	1		22	1
			24	1		25	1		27	1		29	1		30	1
			32	1		34	1		37	1		39	1		41	1
			44	1		47	1		50	1		53	1		56	1
			60	1		64	1		68	1		72	1		77	1
			82	1		87	1		93	1		98	1		105	1
			111	1		119	1		126	1		134	1		143	1
			152	1		162	1		172	1		183	1		195	1
			207	1		220	1		234	1		249	1		265	1
			282	1		300	1		316	1		333	1		350	1
			357	1		365	1		372	1		380	1		387	1
			395	1		403	1		412	1		420	1
		>;

		/*
		* ************************************************************************************************************************
		* IRC
		* ************************************************************************************************************************
		*/

		samsung,irc_rx_cmds_revA = [ 06 01 00 00 00 00 01 B8 02 00];	/* read B8 1st, 2nd, 00=0x0*/

		samsung,irc_subdivision_tx_cmds_revA = [
			29 01 00 00 00 00 22 B8 00 00 00 00 00 80 00 00 00 80 61 27 2D 48 BF 33 69 12 7A DA 00 00 00 00 00 00 00 00 00 00 00 00 00 /*0*/
			29 01 00 00 00 00 22 B8 00 00 00 00 00 80 00 00 00 80 61 27 2D 48 BF 33 69 12 7A DA 00 00 00 00 00 00 00 00 00 00 00 00 00 /*1*/
			29 01 00 00 00 00 22 B8 00 00 00 00 00 80 00 00 00 80 61 27 2D 48 BF 33 69 12 7A DA 00 00 00 00 00 00 00 00 00 00 00 00 00 /*2*/
			29 01 00 00 00 00 22 B8 00 00 00 00 00 80 00 00 00 80 61 27 2D 48 BF 33 69 12 7A DA 00 00 00 00 00 00 00 00 00 00 00 00 00 /*3*/
			29 01 00 00 00 00 22 B8 00 00 00 00 00 80 00 00 00 80 61 27 2D 48 BF 33 69 12 7A DA 00 00 00 00 00 00 00 00 00 00 00 00 00 /*4*/
			29 01 00 00 00 00 22 B8 00 00 00 00 00 80 00 00 00 80 61 27 2D 48 BF 33 69 12 7A DA 00 00 00 00 00 00 00 00 00 00 00 00 00 /*5*/
			29 01 00 00 00 00 22 B8 00 00 00 00 00 80 00 00 00 80 61 27 2D 48 BF 33 69 12 7A DA 00 00 00 00 00 00 00 00 00 00 00 00 00 /*6*/
			29 01 00 00 00 00 22 B8 00 00 00 00 00 80 00 00 00 80 61 27 2D 48 BF 33 69 12 7A DA 00 00 00 00 00 00 00 00 00 00 00 00 00 /*7*/
			29 01 00 00 00 00 22 B8 00 00 00 00 00 80 00 00 00 80 61 27 2D 48 BF 33 69 12 7A DA 00 00 00 00 00 00 00 00 00 00 00 00 00 /*8*/
			29 01 00 00 00 00 22 B8 00 00 00 00 00 80 00 00 00 80 61 27 2D 48 BF 33 69 12 7A DA 00 00 00 00 00 00 00 00 00 00 00 00 00 /*9*/
			29 01 00 00 00 00 22 B8 00 00 00 00 00 80 00 00 00 80 61 27 2D 48 BF 33 69 12 7A DA 00 00 00 00 00 00 00 00 00 00 00 00 00 /*10*/
			29 01 00 00 00 00 22 B8 00 00 00 00 00 80 00 00 00 80 61 27 2D 48 BF 33 69 12 7A DA 00 00 00 00 00 00 00 00 00 00 00 00 00 /*11*/
			29 01 00 00 00 00 22 B8 00 00 00 00 00 80 00 00 00 80 61 27 2D 48 BF 33 69 12 7A DA 00 00 00 00 00 00 00 00 00 00 00 00 00 /*12*/
			29 01 00 00 00 00 22 B8 00 00 00 00 00 80 00 00 00 80 61 27 2D 48 BF 33 69 12 7A DA 00 00 00 00 00 00 00 00 00 00 00 00 00 /*13*/
			29 01 00 00 00 00 22 B8 00 00 00 00 00 80 00 00 00 80 61 27 2D 48 BF 33 69 12 7A DA 00 00 00 00 00 00 00 00 00 00 00 00 00 /*14*/
			29 01 00 00 00 00 22 B8 00 00 00 00 00 80 00 00 00 80 61 27 2D 48 BF 33 69 12 7A DA 00 00 00 00 00 00 00 00 00 00 00 00 00 /*15*/
			29 01 00 00 00 00 22 B8 00 00 00 00 00 80 00 00 00 80 61 27 2D 48 BF 33 69 12 7A DA 00 00 00 00 00 00 00 00 00 00 00 00 00 /*16*/
			29 01 00 00 00 00 22 B8 00 00 00 00 00 80 00 00 00 80 61 27 2D 48 BF 33 69 12 7A DA 00 00 00 00 00 00 00 00 00 00 00 00 00 /*17*/
			29 01 00 00 00 00 22 B8 00 00 00 00 00 80 00 00 00 80 61 27 2D 48 BF 33 69 12 7A DA 00 00 00 00 00 00 00 00 00 00 00 00 00 /*18*/
			29 01 00 00 00 00 22 B8 00 00 00 00 00 80 00 00 00 80 61 27 2D 48 BF 33 69 12 7A DA 00 00 00 00 00 00 00 00 00 00 00 00 00 /*19*/
			29 01 00 00 00 00 22 B8 00 00 00 00 00 80 00 00 00 80 61 27 2D 48 BF 33 69 12 7A DA 00 00 00 00 00 00 00 00 00 00 00 00 00 /*20*/
			29 01 00 00 00 00 22 B8 00 00 00 00 00 80 00 00 00 80 61 27 2D 48 BF 33 69 12 7A DA 00 00 00 00 00 00 00 00 00 00 00 00 00 /*21*/
			29 01 00 00 00 00 22 B8 00 00 00 00 00 80 00 00 00 80 61 27 2D 48 BF 33 69 12 7A DA 00 00 00 00 00 00 00 00 00 00 00 00 00 /*22*/
			29 01 00 00 00 00 22 B8 00 00 00 00 00 80 00 00 00 80 61 27 2D 48 BF 33 69 12 7A DA 00 00 00 00 00 00 00 00 00 00 00 00 00 /*23*/
			29 01 00 00 00 00 22 B8 00 00 00 00 00 80 00 00 00 80 61 27 2D 48 BF 33 69 12 7A DA 00 00 00 00 00 00 00 00 00 00 00 00 00 /*24*/
			29 01 00 00 00 00 22 B8 00 00 00 00 00 80 00 00 00 80 61 27 2D 48 BF 33 69 12 7A DA 00 00 00 00 00 00 00 00 00 00 00 00 00 /*25*/
			29 01 00 00 00 00 22 B8 00 00 00 00 00 80 00 00 00 80 61 27 2D 48 BF 33 69 12 7A DA 00 00 00 00 00 00 00 00 00 00 00 00 00 /*26*/
			29 01 00 00 00 00 22 B8 00 00 00 00 00 80 00 00 00 80 61 27 2D 48 BF 33 69 12 7A DA 00 00 00 00 00 00 00 00 00 00 00 00 00 /*27*/
			29 01 00 00 00 00 22 B8 00 00 00 00 00 80 00 00 00 80 61 27 2D 48 BF 33 69 12 7A DA 00 00 00 00 00 00 00 00 00 00 00 00 00 /*28*/
			29 01 00 00 00 00 22 B8 00 00 00 00 00 80 00 00 00 80 61 27 2D 48 BF 33 69 12 7A DA 00 00 00 00 00 00 00 00 00 00 00 00 00 /*29*/
			29 01 00 00 00 00 22 B8 00 00 00 00 00 80 00 00 00 80 61 27 2D 48 BF 33 69 12 7A DA 00 00 00 00 00 00 00 00 00 00 00 00 00 /*30*/
			29 01 00 00 00 00 22 B8 00 00 00 00 00 80 00 00 00 80 61 27 2D 48 BF 33 69 12 7A DA 00 00 00 00 00 00 00 00 00 00 00 00 00 /*31*/
			29 01 00 00 00 00 22 B8 00 00 00 00 00 80 00 00 00 80 61 27 2D 48 BF 33 69 12 7A DA 00 00 00 00 00 00 00 00 00 00 00 00 00 /*32*/
			29 01 00 00 00 00 22 B8 00 00 00 00 00 80 00 00 00 80 61 27 2D 48 BF 33 69 12 7A DA 00 00 00 00 00 00 00 00 00 00 00 00 00 /*33*/
			29 01 00 00 00 00 22 B8 00 00 00 00 00 80 00 00 00 80 61 27 2D 48 BF 33 69 12 7A DA 00 00 00 00 00 00 00 00 00 00 00 00 00 /*34*/
			29 01 00 00 00 00 22 B8 00 00 00 00 00 80 00 00 00 80 61 27 2D 48 BF 33 69 12 7A DA 00 00 00 00 00 00 00 00 00 00 00 00 00 /*35*/
			29 01 00 00 00 00 22 B8 00 00 00 00 00 80 00 00 00 80 61 27 2D 48 BF 33 69 12 7A DA 00 00 00 00 00 00 00 00 00 00 00 00 00 /*36*/
			29 01 00 00 00 00 22 B8 00 00 00 00 00 80 00 00 00 80 61 27 2D 48 BF 33 69 12 7A DA 00 00 00 00 00 00 00 00 00 00 00 00 00 /*37*/
			29 01 00 00 00 00 22 B8 00 00 00 00 00 80 00 00 00 80 61 27 2D 48 BF 33 69 12 7A DA 00 00 00 00 00 00 00 00 00 00 00 00 00 /*38*/
			29 01 00 00 00 00 22 B8 00 00 00 00 00 80 00 00 00 80 61 27 2D 48 BF 33 69 12 7A DA 00 00 00 00 01 01 01 01 01 01 00 00 00 /*39*/
			29 01 00 00 00 00 22 B8 00 00 00 00 00 80 00 00 00 80 61 27 2D 48 BF 33 69 12 7A DA 00 00 00 00 01 01 01 01 01 01 00 00 00 /*40*/
			29 01 00 00 00 00 22 B8 00 00 00 00 00 80 00 00 00 80 61 27 2D 48 BF 33 69 12 7A DA 00 00 00 00 02 02 02 00 00 00 01 01 01 /*41*/
			29 01 00 00 00 00 22 B8 00 00 00 00 00 80 00 00 00 80 61 27 2D 48 BF 33 69 12 7A DA 00 00 00 00 02 02 02 00 00 00 01 01 01 /*42*/
			29 01 00 00 00 00 22 B8 00 00 00 00 00 80 00 00 00 80 61 27 2D 48 BF 33 69 12 7A DA 00 00 00 00 02 02 02 00 00 00 01 01 01 /*43*/
			29 01 00 00 00 00 22 B8 00 00 00 00 00 80 00 00 00 80 61 27 2D 48 BF 33 69 12 7A DA 00 00 00 00 02 02 02 00 00 00 01 01 01 /*44*/
			29 01 00 00 00 00 22 B8 00 00 00 00 00 80 00 00 00 80 61 27 2D 48 BF 33 69 12 7A DA 00 00 00 00 02 02 02 00 00 00 01 01 01 /*45*/
			29 01 00 00 00 00 22 B8 00 00 00 00 00 80 00 00 00 80 61 27 2D 48 BF 33 69 12 7A DA 00 00 00 00 02 02 02 00 00 00 01 01 01 /*46*/
			29 01 00 00 00 00 22 B8 00 00 00 00 00 80 00 00 00 80 61 27 2D 48 BF 33 69 12 7A DA 00 00 00 00 02 02 02 01 01 01 00 00 00 /*47*/
			29 01 00 00 00 00 22 B8 00 00 00 00 00 80 00 00 00 80 61 27 2D 48 BF 33 69 12 7A DA 00 00 00 00 02 02 02 01 01 01 00 00 00 /*48*/
			29 01 00 00 00 00 22 B8 00 00 00 00 00 80 00 00 00 80 61 27 2D 48 BF 33 69 12 7A DA 00 00 00 00 02 02 02 01 01 01 01 01 01 /*49*/
			29 01 00 00 00 00 22 B8 00 00 00 00 00 80 00 00 00 80 61 27 2D 48 BF 33 69 12 7A DA 00 00 00 00 02 02 02 01 01 01 01 01 01 /*50*/
			29 01 00 00 00 00 22 B8 00 00 00 00 00 80 00 00 00 80 61 27 2D 48 BF 33 69 12 7A DA 00 00 00 00 02 02 02 01 01 01 01 01 01 /*51*/
			29 01 00 00 00 00 22 B8 00 00 00 00 00 80 00 00 00 80 61 27 2D 48 BF 33 69 12 7A DA 00 00 00 00 02 02 02 01 01 01 01 01 01 /*52*/
			29 01 00 00 00 00 22 B8 00 00 00 00 00 80 00 00 00 80 61 27 2D 48 BF 33 69 12 7A DA 00 00 00 00 02 02 02 01 01 01 01 01 01 /*53*/
			29 01 00 00 00 00 22 B8 00 00 00 00 00 80 00 00 00 80 61 27 2D 48 BF 33 69 12 7A DA 00 00 00 00 02 02 02 01 01 01 01 01 01 /*54*/
			29 01 00 00 00 00 22 B8 00 00 00 00 00 80 00 00 00 80 61 27 2D 48 BF 33 69 12 7A DA 00 00 00 00 03 03 03 00 00 00 01 01 01 /*55*/
			29 01 00 00 00 00 22 B8 00 00 00 00 00 80 00 00 00 80 61 27 2D 48 BF 33 69 12 7A DA 00 00 00 00 03 03 03 01 01 01 01 01 01 /*56*/
			29 01 00 00 00 00 22 B8 00 00 00 00 00 80 00 00 00 80 61 27 2D 48 BF 33 69 12 7A DA 00 00 00 00 03 03 03 01 01 01 01 01 01 /*57*/
			29 01 00 00 00 00 22 B8 00 00 00 00 00 80 00 00 00 80 61 27 2D 48 BF 33 69 12 7A DA 00 00 00 00 03 03 03 01 01 01 01 01 01 /*58*/
			29 01 00 00 00 00 22 B8 00 00 00 00 00 80 00 00 00 80 61 27 2D 48 BF 33 69 12 7A DA 00 00 00 00 03 03 03 01 01 01 01 01 01 /*59*/
			29 01 00 00 00 00 22 B8 00 00 00 00 00 80 00 00 00 80 61 27 2D 48 BF 33 69 12 7A DA 00 00 00 00 03 03 03 01 01 01 01 01 01 /*60*/
			29 01 00 00 00 00 22 B8 00 00 00 00 00 80 00 00 00 80 61 27 2D 48 BF 33 69 12 7A DA 00 00 00 00 03 03 03 01 01 01 01 01 01 /*61*/
			29 01 00 00 00 00 22 B8 00 00 00 00 00 80 00 00 00 80 61 27 2D 48 BF 33 69 12 7A DA 00 00 00 00 03 03 03 01 01 01 01 01 01 /*62*/
			29 01 00 00 00 00 22 B8 00 00 00 00 00 80 00 00 00 80 61 27 2D 48 BF 33 69 12 7A DA 00 00 00 00 03 03 03 02 02 02 01 01 01 /*63*/
			29 01 00 00 00 00 22 B8 00 00 00 00 00 80 00 00 00 80 61 27 2D 48 BF 33 69 12 7A DA 00 00 00 00 04 04 04 01 01 01 01 01 01 /*64*/
			29 01 00 00 00 00 22 B8 00 00 00 00 00 80 00 00 00 80 61 27 2D 48 BF 33 69 12 7A DA 00 00 00 00 04 04 04 01 01 01 01 01 01 /*65*/
			29 01 00 00 00 00 22 B8 00 00 00 00 00 80 00 00 00 80 61 27 2D 48 BF 33 69 12 7A DA 00 00 00 00 04 04 04 01 01 01 01 01 01 /*66*/
			29 01 00 00 00 00 22 B8 00 00 00 00 00 80 00 00 00 80 61 27 2D 48 BF 33 69 12 7A DA 00 00 00 00 04 04 04 01 01 01 01 01 01 /*67*/
			29 01 00 00 00 00 22 B8 00 00 00 00 00 80 00 00 00 80 61 27 2D 48 BF 33 69 12 7A DA 00 00 00 00 04 04 04 01 01 01 02 02 02 /*68*/
			29 01 00 00 00 00 22 B8 00 00 00 00 00 80 00 00 00 80 61 27 2D 48 BF 33 69 12 7A DA 00 00 00 00 04 04 04 02 02 02 01 01 01 /*69*/
			29 01 00 00 00 00 22 B8 00 00 00 00 00 80 00 00 00 80 61 27 2D 48 BF 33 69 12 7A DA 00 00 00 00 04 04 04 02 02 02 01 01 01 /*70*/
			29 01 00 00 00 00 22 B8 00 00 00 00 00 80 00 00 00 80 61 27 2D 48 BF 33 69 12 7A DA 00 00 00 00 04 04 04 02 02 02 01 01 01 /*71*/
			29 01 00 00 00 00 22 B8 00 00 00 00 00 80 00 00 00 80 61 27 2D 48 BF 33 69 12 7A DA 00 00 00 00 05 05 05 01 01 01 02 02 02 /*72*/
			29 01 00 00 00 00 22 B8 00 00 00 00 00 80 00 00 00 80 61 27 2D 48 BF 33 69 12 7A DA 00 00 00 00 05 05 05 01 01 01 02 02 02 /*73*/
			29 01 00 00 00 00 22 B8 00 00 00 00 00 80 00 00 00 80 61 27 2D 48 BF 33 69 12 7A DA 00 00 00 00 05 05 05 01 01 01 02 02 02 /*74*/
			29 01 00 00 00 00 22 B8 00 00 00 00 00 80 00 00 00 80 61 27 2D 48 BF 33 69 12 7A DA 00 00 00 00 05 05 05 02 02 02 02 02 02 /*75*/
			29 01 00 00 00 00 22 B8 00 00 00 00 00 80 00 00 00 80 61 27 2D 48 BF 33 69 12 7A DA 00 00 00 00 05 05 05 02 02 02 02 02 02 /*76*/
			29 01 00 00 00 00 22 B8 00 00 00 00 00 80 00 00 00 80 61 27 2D 48 BF 33 69 12 7A DA 00 00 00 00 05 05 05 02 02 02 02 02 02 /*77*/
			29 01 00 00 00 00 22 B8 00 00 00 00 00 80 00 00 00 80 61 27 2D 48 BF 33 69 12 7A DA 00 00 00 00 06 06 06 01 01 01 02 02 02 /*78*/
			29 01 00 00 00 00 22 B8 00 00 00 00 00 80 00 00 00 80 61 27 2D 48 BF 33 69 12 7A DA 00 00 00 00 06 06 06 02 02 02 02 02 02 /*79*/
			29 01 00 00 00 00 22 B8 00 00 00 00 00 80 00 00 00 80 61 27 2D 48 BF 33 69 12 7A DA 00 00 00 00 06 06 06 02 02 02 02 02 02 /*80*/
			29 01 00 00 00 00 22 B8 00 00 00 00 00 80 00 00 00 80 61 27 2D 48 BF 33 69 12 7A DA 00 00 00 00 06 06 06 02 02 02 02 02 02 /*81*/
			29 01 00 00 00 00 22 B8 00 00 00 00 00 80 00 00 00 80 61 27 2D 48 BF 33 69 12 7A DA 00 00 00 00 06 06 06 02 02 02 02 02 02 /*82*/
			29 01 00 00 00 00 22 B8 00 00 00 00 00 80 00 00 00 80 61 27 2D 48 BF 33 69 12 7A DA 00 00 00 00 07 07 07 02 02 02 02 02 02 /*83*/
			29 01 00 00 00 00 22 B8 00 00 00 00 00 80 00 00 00 80 61 27 2D 48 BF 33 69 12 7A DA 00 00 00 00 07 07 07 02 02 02 02 02 02 /*84*/
			29 01 00 00 00 00 22 B8 00 00 00 00 00 80 00 00 00 80 61 27 2D 48 BF 33 69 12 7A DA 00 00 00 00 07 07 07 02 02 02 03 03 03 /*85*/
			29 01 00 00 00 00 22 B8 00 00 00 00 00 80 00 00 00 80 61 27 2D 48 BF 33 69 12 7A DA 00 00 00 00 07 07 07 03 03 03 02 02 02 /*86*/
			29 01 00 00 00 00 22 B8 00 00 00 00 00 80 00 00 00 80 61 27 2D 48 BF 33 69 12 7A DA 00 00 00 00 07 07 07 03 03 03 02 02 02 /*87*/
			29 01 00 00 00 00 22 B8 00 00 00 00 00 80 00 00 00 80 61 27 2D 48 BF 33 69 12 7A DA 00 00 00 00 08 08 08 02 02 02 03 03 03 /*88*/
			29 01 00 00 00 00 22 B8 00 00 00 00 00 80 00 00 00 80 61 27 2D 48 BF 33 69 12 7A DA 00 00 00 00 08 08 08 02 02 02 03 03 03 /*89*/
			29 01 00 00 00 00 22 B8 00 00 00 00 00 80 00 00 00 80 61 27 2D 48 BF 33 69 12 7A DA 00 00 00 00 08 08 08 03 03 03 02 02 02 /*90*/
			29 01 00 00 00 00 22 B8 00 00 00 00 00 80 00 00 00 80 61 27 2D 48 BF 33 69 12 7A DA 00 00 00 00 08 08 08 03 03 03 03 03 03 /*91*/
			29 01 00 00 00 00 22 B8 00 00 00 00 00 80 00 00 00 80 61 27 2D 48 BF 33 69 12 7A DA 00 00 00 00 09 09 09 02 02 02 03 03 03 /*92*/
			29 01 00 00 00 00 22 B8 00 00 00 00 00 80 00 00 00 80 61 27 2D 48 BF 33 69 12 7A DA 00 00 00 00 09 09 09 03 03 03 03 03 03 /*93*/
			29 01 00 00 00 00 22 B8 00 00 00 00 00 80 00 00 00 80 61 27 2D 48 BF 33 69 12 7A DA 00 00 00 00 09 09 09 03 03 03 03 03 03 /*94*/
			29 01 00 00 00 00 22 B8 00 00 00 00 00 80 00 00 00 80 61 27 2D 48 BF 33 69 12 7A DA 00 00 00 00 09 09 09 04 04 04 03 03 03 /*95*/
			29 01 00 00 00 00 22 B8 00 00 00 00 00 80 00 00 00 80 61 27 2D 48 BF 33 69 12 7A DA 00 00 00 00 0A 0A 0A 03 03 03 03 03 03 /*96*/
			29 01 00 00 00 00 22 B8 00 00 00 00 00 80 00 00 00 80 61 27 2D 48 BF 33 69 12 7A DA 00 00 00 00 0A 0A 0A 03 03 03 04 04 04 /*97*/
			29 01 00 00 00 00 22 B8 00 00 00 00 00 80 00 00 00 80 61 27 2D 48 BF 33 69 12 7A DA 00 00 00 00 0A 0A 0A 04 04 04 03 03 03 /*98*/
			29 01 00 00 00 00 22 B8 00 00 00 00 00 80 00 00 00 80 61 27 2D 48 BF 33 69 12 7A DA 00 00 00 00 0B 0B 0B 03 03 03 04 04 04 /*99*/
			29 01 00 00 00 00 22 B8 00 00 00 00 00 80 00 00 00 80 61 27 2D 48 BF 33 69 12 7A DA 00 00 00 00 0B 0B 0B 04 04 04 03 03 03 /*100*/
			29 01 00 00 00 00 22 B8 00 00 00 00 00 80 00 00 00 80 61 27 2D 48 BF 33 69 12 7A DA 00 00 00 00 0B 0B 0B 04 04 04 04 04 04 /*101*/
			29 01 00 00 00 00 22 B8 00 00 00 00 00 80 00 00 00 80 61 27 2D 48 BF 33 69 12 7A DA 00 00 00 00 0C 0C 0C 04 04 04 04 04 04 /*102*/
			29 01 00 00 00 00 22 B8 00 00 00 00 00 80 00 00 00 80 61 27 2D 48 BF 33 69 12 7A DA 00 00 00 00 0C 0C 0C 04 04 04 04 04 04 /*103*/
			29 01 00 00 00 00 22 B8 00 00 00 00 00 80 00 00 00 80 61 27 2D 48 BF 33 69 12 7A DA 00 00 00 00 0C 0C 0C 05 05 05 04 04 04 /*104*/
			29 01 00 00 00 00 22 B8 00 00 00 00 00 80 00 00 00 80 61 27 2D 48 BF 33 69 12 7A DA 00 00 00 00 0D 0D 0D 04 04 04 04 04 04 /*105*/
			29 01 00 00 00 00 22 B8 00 00 00 00 00 80 00 00 00 80 61 27 2D 48 BF 33 69 12 7A DA 00 00 00 00 0D 0D 0D 05 05 05 04 04 04 /*106*/
			29 01 00 00 00 00 22 B8 00 00 00 00 00 80 00 00 00 80 61 27 2D 48 BF 33 69 12 7A DA 00 00 00 00 0E 0E 0E 04 04 04 05 05 05 /*107*/
			29 01 00 00 00 00 22 B8 00 00 00 00 00 80 00 00 00 80 61 27 2D 48 BF 33 69 12 7A DA 00 00 00 00 0E 0E 0E 05 05 05 04 04 04 /*108*/
			29 01 00 00 00 00 22 B8 00 00 00 00 00 80 00 00 00 80 61 27 2D 48 BF 33 69 12 7A DA 00 00 00 00 0F 0F 0F 04 04 04 05 05 05 /*109*/
			29 01 00 00 00 00 22 B8 00 00 00 00 00 80 00 00 00 80 61 27 2D 48 BF 33 69 12 7A DA 00 00 00 00 0F 0F 0F 05 05 05 05 05 05 /*110*/
			29 01 00 00 00 00 22 B8 00 00 00 00 00 80 00 00 00 80 61 27 2D 48 BF 33 69 12 7A DA 00 00 00 00 0F 0F 0F 06 06 06 05 05 05 /*111*/
			29 01 00 00 00 00 22 B8 00 00 00 00 00 80 00 00 00 80 61 27 2D 48 BF 33 69 12 7A DA 00 00 00 00 10 10 10 05 05 05 05 05 05 /*112*/
			29 01 00 00 00 00 22 B8 00 00 00 00 00 80 00 00 00 80 61 27 2D 48 BF 33 69 12 7A DA 00 00 00 00 10 10 10 06 06 06 05 05 05 /*113*/
			29 01 00 00 00 00 22 B8 00 00 00 00 00 80 00 00 00 80 61 27 2D 48 BF 33 69 12 7A DA 00 00 00 00 11 11 11 06 06 06 05 05 05 /*114*/
			29 01 00 00 00 00 22 B8 00 00 00 00 00 80 00 00 00 80 61 27 2D 48 BF 33 69 12 7A DA 00 00 00 00 12 12 12 05 05 05 06 06 06 /*115*/
			29 01 00 00 00 00 22 B8 00 00 00 00 00 80 00 00 00 80 61 27 2D 48 BF 33 69 12 7A DA 00 00 00 00 12 12 12 06 06 06 06 06 06 /*116*/
			29 01 00 00 00 00 22 B8 00 00 00 00 00 80 00 00 00 80 61 27 2D 48 BF 33 69 12 7A DA 00 00 00 00 13 13 13 06 06 06 06 06 06 /*117*/
			29 01 00 00 00 00 22 B8 00 00 00 00 00 80 00 00 00 80 61 27 2D 48 BF 33 69 12 7A DA 00 00 00 00 13 13 13 07 07 07 06 06 06 /*118*/
			29 01 00 00 00 00 22 B8 00 00 00 00 00 80 00 00 00 80 61 27 2D 48 BF 33 69 12 7A DA 00 00 00 00 14 14 14 06 06 06 07 07 07 /*119*/
			29 01 00 00 00 00 22 B8 00 00 00 00 00 80 00 00 00 80 61 27 2D 48 BF 33 69 12 7A DA 00 00 00 00 14 14 14 07 07 07 07 07 07 /*120*/
			29 01 00 00 00 00 22 B8 00 00 00 00 00 80 00 00 00 80 61 27 2D 48 BF 33 69 12 7A DA 00 00 00 00 15 15 15 07 07 07 07 07 07 /*121*/
			29 01 00 00 00 00 22 B8 00 00 00 00 00 80 00 00 00 80 61 27 2D 48 BF 33 69 12 7A DA 00 00 00 00 16 16 16 07 07 07 07 07 07 /*122*/
			29 01 00 00 00 00 22 B8 00 00 00 00 00 80 00 00 00 80 61 27 2D 48 BF 33 69 12 7A DA 00 00 00 00 16 16 16 08 08 08 07 07 07 /*123*/
			29 01 00 00 00 00 22 B8 00 00 00 00 00 80 00 00 00 80 61 27 2D 48 BF 33 69 12 7A DA 00 00 00 00 17 17 17 08 08 08 08 08 08 /*124*/
			29 01 00 00 00 00 22 B8 00 00 00 00 00 80 00 00 00 80 61 27 2D 48 BF 33 69 12 7A DA 00 00 00 00 18 18 18 08 08 08 08 08 08 /*125*/
			29 01 00 00 00 00 22 B8 00 00 00 00 00 80 00 00 00 80 61 27 2D 48 BF 33 69 12 7A DA 00 00 00 00 19 19 19 08 08 08 08 08 08 /*126*/
			29 01 00 00 00 00 22 B8 00 00 00 00 00 80 00 00 00 80 61 27 2D 48 BF 33 69 12 7A DA 00 00 00 00 19 19 19 09 09 09 08 08 08 /*127*/
			29 01 00 00 00 00 22 B8 00 00 00 00 00 80 00 00 00 80 61 27 2D 48 BF 33 69 12 7A DA 00 00 00 00 1A 1A 1A 09 09 09 09 09 09 /*128*/
			29 01 00 00 00 00 22 B8 00 00 00 00 00 80 00 00 00 80 61 27 2D 48 BF 33 69 12 7A DA 00 00 00 00 1A 1A 1A 09 09 09 09 09 09 /*129*/
			29 01 00 00 00 00 22 B8 00 00 00 00 00 80 00 00 00 80 61 27 2D 48 BF 33 69 12 7A DA 00 00 00 00 1B 1B 1B 08 08 08 09 09 09 /*130*/
			29 01 00 00 00 00 22 B8 00 00 00 00 00 80 00 00 00 80 61 27 2D 48 BF 33 69 12 7A DA 00 00 00 00 1B 1B 1B 09 09 09 09 09 09 /*131*/
			29 01 00 00 00 00 22 B8 00 00 00 00 00 80 00 00 00 80 61 27 2D 48 BF 33 69 12 7A DA 00 00 00 00 1B 1B 1B 09 09 09 09 09 09 /*132*/
			29 01 00 00 00 00 22 B8 00 00 00 00 00 80 00 00 00 80 61 27 2D 48 BF 33 69 12 7A DA 00 00 00 00 1B 1B 1B 0A 0A 0A 09 09 09 /*133*/
			29 01 00 00 00 00 22 B8 00 00 00 00 00 80 00 00 00 80 61 27 2D 48 BF 33 69 12 7A DA 00 00 00 00 1C 1C 1C 09 09 09 09 09 09 /*134*/
			29 01 00 00 00 00 22 B8 00 00 00 00 00 80 00 00 00 80 61 27 2D 48 BF 33 69 12 7A DA 00 00 00 00 1C 1C 1C 09 09 09 09 09 09 /*135*/
			29 01 00 00 00 00 22 B8 00 00 00 00 00 80 00 00 00 80 61 27 2D 48 BF 33 69 12 7A DA 00 00 00 00 1C 1C 1C 0A 0A 0A 09 09 09 /*136*/
			29 01 00 00 00 00 22 B8 00 00 00 00 00 80 00 00 00 80 61 27 2D 48 BF 33 69 12 7A DA 00 00 00 00 1C 1C 1C 0A 0A 0A 09 09 09 /*137*/
			29 01 00 00 00 00 22 B8 00 00 00 00 00 80 00 00 00 80 61 27 2D 48 BF 33 69 12 7A DA 00 00 00 00 1D 1D 1D 09 09 09 0A 0A 0A /*138*/
			29 01 00 00 00 00 22 B8 00 00 00 00 00 80 00 00 00 80 61 27 2D 48 BF 33 69 12 7A DA 00 00 00 00 1D 1D 1D 09 09 09 0A 0A 0A /*139*/
			29 01 00 00 00 00 22 B8 00 00 00 00 00 80 00 00 00 80 61 27 2D 48 BF 33 69 12 7A DA 00 00 00 00 1D 1D 1D 0A 0A 0A 0A 0A 0A /*140*/
			29 01 00 00 00 00 22 B8 00 00 00 00 00 80 00 00 00 80 61 27 2D 48 BF 33 69 12 7A DA 00 00 00 00 1D 1D 1D 0A 0A 0A 0A 0A 0A /*141*/
			29 01 00 00 00 00 22 B8 00 00 00 00 00 80 00 00 00 80 61 27 2D 48 BF 33 69 12 7A DA 00 00 00 00 1E 1E 1E 09 09 09 0A 0A 0A /*142*/
			29 01 00 00 00 00 22 B8 00 00 00 00 00 80 00 00 00 80 61 27 2D 48 BF 33 69 12 7A DA 00 00 00 00 1E 1E 1E 0A 0A 0A 0A 0A 0A /*143*/
			29 01 00 00 00 00 22 B8 00 00 00 00 00 80 00 00 00 80 61 27 2D 48 BF 33 69 12 7A DA 00 00 00 00 1E 1E 1E 0A 0A 0A 0A 0A 0A /*144*/
			29 01 00 00 00 00 22 B8 00 00 00 00 00 80 00 00 00 80 61 27 2D 48 BF 33 69 12 7A DA 00 00 00 00 1E 1E 1E 0B 0B 0B 0A 0A 0A /*145*/
			29 01 00 00 00 00 22 B8 00 00 00 00 00 80 00 00 00 80 61 27 2D 48 BF 33 69 12 7A DA 00 00 00 00 1F 1F 1F 0A 0A 0A 0A 0A 0A /*146*/
			29 01 00 00 00 00 22 B8 00 00 00 00 00 80 00 00 00 80 61 27 2D 48 BF 33 69 12 7A DA 00 00 00 00 1F 1F 1F 0A 0A 0A 0A 0A 0A /*147*/
			29 01 00 00 00 00 22 B8 00 00 00 00 00 80 00 00 00 80 61 27 2D 48 BF 33 69 12 7A DA 00 00 00 00 1F 1F 1F 0B 0B 0B 0A 0A 0A /*148*/
			29 01 00 00 00 00 22 B8 00 00 00 00 00 80 00 00 00 80 61 27 2D 48 BF 33 69 12 7A DA 00 00 00 00 1F 1F 1F 0B 0B 0B 0A 0A 0A /*149*/
			29 01 00 00 00 00 22 B8 00 00 00 00 00 80 00 00 00 80 61 27 2D 48 BF 33 69 12 7A DA 00 00 00 00 20 20 20 0A 0A 0A 0B 0B 0B /*150*/
			29 01 00 00 00 00 22 B8 00 00 00 00 00 80 00 00 00 80 61 27 2D 48 BF 33 69 12 7A DA 00 00 00 00 20 20 20 0B 0B 0B 0A 0A 0A /*151*/
			29 01 00 00 00 00 22 B8 00 00 00 00 00 80 00 00 00 80 61 27 2D 48 BF 33 69 12 7A DA 00 00 00 00 20 20 20 0B 0B 0B 0B 0B 0B /*152*/
			29 01 00 00 00 00 22 B8 00 00 00 00 00 80 00 00 00 80 61 27 2D 48 BF 33 69 12 7A DA 00 00 00 00 20 20 20 0B 0B 0B 0B 0B 0B /*153*/
			29 01 00 00 00 00 22 B8 00 00 00 00 00 80 00 00 00 80 61 27 2D 48 BF 33 69 12 7A DA 00 00 00 00 21 21 21 0B 0B 0B 0B 0B 0B /*154*/
			29 01 00 00 00 00 22 B8 00 00 00 00 00 80 00 00 00 80 61 27 2D 48 BF 33 69 12 7A DA 00 00 00 00 21 21 21 0B 0B 0B 0B 0B 0B /*155*/
			29 01 00 00 00 00 22 B8 00 00 00 00 00 80 00 00 00 80 61 27 2D 48 BF 33 69 12 7A DA 00 00 00 00 21 21 21 0B 0B 0B 0B 0B 0B /*156*/
			29 01 00 00 00 00 22 B8 00 00 00 00 00 80 00 00 00 80 61 27 2D 48 BF 33 69 12 7A DA 00 00 00 00 21 21 21 0C 0C 0C 0B 0B 0B /*157*/
			29 01 00 00 00 00 22 B8 00 00 00 00 00 80 00 00 00 80 61 27 2D 48 BF 33 69 12 7A DA 00 00 00 00 22 22 22 0B 0B 0B 0B 0B 0B /*158*/
			29 01 00 00 00 00 22 B8 00 00 00 00 00 80 00 00 00 80 61 27 2D 48 BF 33 69 12 7A DA 00 00 00 00 22 22 22 0B 0B 0B 0C 0C 0C /*159*/
			29 01 00 00 00 00 22 B8 00 00 00 00 00 80 00 00 00 80 61 27 2D 48 BF 33 69 12 7A DA 00 00 00 00 22 22 22 0C 0C 0C 0B 0B 0B /*160*/
			29 01 00 00 00 00 22 B8 00 00 00 00 00 80 00 00 00 80 61 27 2D 48 BF 33 69 12 7A DA 00 00 00 00 23 23 23 0B 0B 0B 0C 0C 0C /*161*/
			29 01 00 00 00 00 22 B8 00 00 00 00 00 80 00 00 00 80 61 27 2D 48 BF 33 69 12 7A DA 00 00 00 00 23 23 23 0B 0B 0B 0C 0C 0C /*162*/
			29 01 00 00 00 00 22 B8 00 00 00 00 00 80 00 00 00 80 61 27 2D 48 BF 33 69 12 7A DA 00 00 00 00 23 23 23 0C 0C 0C 0B 0B 0B /*163*/
			29 01 00 00 00 00 22 B8 00 00 00 00 00 80 00 00 00 80 61 27 2D 48 BF 33 69 12 7A DA 00 00 00 00 23 23 23 0C 0C 0C 0C 0C 0C /*164*/
			29 01 00 00 00 00 22 B8 00 00 00 00 00 80 00 00 00 80 61 27 2D 48 BF 33 69 12 7A DA 00 00 00 00 24 24 24 0B 0B 0B 0C 0C 0C /*165*/
			29 01 00 00 00 00 22 B8 00 00 00 00 00 80 00 00 00 80 61 27 2D 48 BF 33 69 12 7A DA 00 00 00 00 24 24 24 0C 0C 0C 0C 0C 0C /*166*/
			29 01 00 00 00 00 22 B8 00 00 00 00 00 80 00 00 00 80 61 27 2D 48 BF 33 69 12 7A DA 00 00 00 00 24 24 24 0C 0C 0C 0C 0C 0C /*167*/
			29 01 00 00 00 00 22 B8 00 00 00 00 00 80 00 00 00 80 61 27 2D 48 BF 33 69 12 7A DA 00 00 00 00 24 24 24 0C 0C 0C 0C 0C 0C /*168*/
			29 01 00 00 00 00 22 B8 00 00 00 00 00 80 00 00 00 80 61 27 2D 48 BF 33 69 12 7A DA 00 00 00 00 25 25 25 0C 0C 0C 0C 0C 0C /*169*/
			29 01 00 00 00 00 22 B8 00 00 00 00 00 80 00 00 00 80 61 27 2D 48 BF 33 69 12 7A DA 00 00 00 00 25 25 25 0C 0C 0C 0C 0C 0C /*170*/
			29 01 00 00 00 00 22 B8 00 00 00 00 00 80 00 00 00 80 61 27 2D 48 BF 33 69 12 7A DA 00 00 00 00 25 25 25 0D 0D 0D 0C 0C 0C /*171*/
			29 01 00 00 00 00 22 B8 00 00 00 00 00 80 00 00 00 80 61 27 2D 48 BF 33 69 12 7A DA 00 00 00 00 25 25 25 0D 0D 0D 0C 0C 0C /*172*/
			29 01 00 00 00 00 22 B8 00 00 00 00 00 80 00 00 00 80 61 27 2D 48 BF 33 69 12 7A DA 00 00 00 00 26 26 26 0C 0C 0C 0D 0D 0D /*173*/
			29 01 00 00 00 00 22 B8 00 00 00 00 00 80 00 00 00 80 61 27 2D 48 BF 33 69 12 7A DA 00 00 00 00 26 26 26 0C 0C 0C 0D 0D 0D /*174*/
			29 01 00 00 00 00 22 B8 00 00 00 00 00 80 00 00 00 80 61 27 2D 48 BF 33 69 12 7A DA 00 00 00 00 26 26 26 0D 0D 0D 0D 0D 0D /*175*/
			29 01 00 00 00 00 22 B8 00 00 00 00 00 80 00 00 00 80 61 27 2D 48 BF 33 69 12 7A DA 00 00 00 00 26 26 26 0D 0D 0D 0D 0D 0D /*176*/
			29 01 00 00 00 00 22 B8 00 00 00 00 00 80 00 00 00 80 61 27 2D 48 BF 33 69 12 7A DA 00 00 00 00 27 27 27 0D 0D 0D 0D 0D 0D /*177*/
			29 01 00 00 00 00 22 B8 00 00 00 00 00 80 00 00 00 80 61 27 2D 48 BF 33 69 12 7A DA 00 00 00 00 27 27 27 0D 0D 0D 0D 0D 0D /*178*/
			29 01 00 00 00 00 22 B8 00 00 00 00 00 80 00 00 00 80 61 27 2D 48 BF 33 69 12 7A DA 00 00 00 00 27 27 27 0D 0D 0D 0D 0D 0D /*179*/
			29 01 00 00 00 00 22 B8 00 00 00 00 00 80 00 00 00 80 61 27 2D 48 BF 33 69 12 7A DA 00 00 00 00 27 27 27 0E 0E 0E 0D 0D 0D /*180*/
			29 01 00 00 00 00 22 B8 00 00 00 00 00 80 00 00 00 80 61 27 2D 48 BF 33 69 12 7A DA 00 00 00 00 28 28 28 0D 0D 0D 0D 0D 0D /*181*/
			29 01 00 00 00 00 22 B8 00 00 00 00 00 80 00 00 00 80 61 27 2D 48 BF 33 69 12 7A DA 00 00 00 00 28 28 28 0D 0D 0D 0E 0E 0E /*182*/
			29 01 00 00 00 00 22 B8 00 00 00 00 00 80 00 00 00 80 61 27 2D 48 BF 33 69 12 7A DA 00 00 00 00 28 28 28 0E 0E 0E 0D 0D 0D /*183*/
			29 01 00 00 00 00 22 B8 00 00 00 00 00 80 00 00 00 80 61 27 2D 48 BF 33 69 12 7A DA 00 00 00 00 29 29 29 0D 0D 0D 0E 0E 0E /*184*/
			29 01 00 00 00 00 22 B8 00 00 00 00 00 80 00 00 00 80 61 27 2D 48 BF 33 69 12 7A DA 00 00 00 00 29 29 29 0D 0D 0D 0E 0E 0E /*185*/
			29 01 00 00 00 00 22 B8 00 00 00 00 00 80 00 00 00 80 61 27 2D 48 BF 33 69 12 7A DA 00 00 00 00 29 29 29 0E 0E 0E 0D 0D 0D /*186*/
			29 01 00 00 00 00 22 B8 00 00 00 00 00 80 00 00 00 80 61 27 2D 48 BF 33 69 12 7A DA 00 00 00 00 29 29 29 0E 0E 0E 0E 0E 0E /*187*/
			29 01 00 00 00 00 22 B8 00 00 00 00 00 80 00 00 00 80 61 27 2D 48 BF 33 69 12 7A DA 00 00 00 00 2A 2A 2A 0D 0D 0D 0E 0E 0E /*188*/
			29 01 00 00 00 00 22 B8 00 00 00 00 00 80 00 00 00 80 61 27 2D 48 BF 33 69 12 7A DA 00 00 00 00 2A 2A 2A 0E 0E 0E 0E 0E 0E /*189*/
			29 01 00 00 00 00 22 B8 00 00 00 00 00 80 00 00 00 80 61 27 2D 48 BF 33 69 12 7A DA 00 00 00 00 2A 2A 2A 0E 0E 0E 0E 0E 0E /*190*/
			29 01 00 00 00 00 22 B8 00 00 00 00 00 80 00 00 00 80 61 27 2D 48 BF 33 69 12 7A DA 00 00 00 00 2A 2A 2A 0E 0E 0E 0E 0E 0E /*191*/
			29 01 00 00 00 00 22 B8 00 00 00 00 00 80 00 00 00 80 61 27 2D 48 BF 33 69 12 7A DA 00 00 00 00 2B 2B 2B 0E 0E 0E 0E 0E 0E /*192*/
			29 01 00 00 00 00 22 B8 00 00 00 00 00 80 00 00 00 80 61 27 2D 48 BF 33 69 12 7A DA 00 00 00 00 2B 2B 2B 0E 0E 0E 0E 0E 0E /*193*/
			29 01 00 00 00 00 22 B8 00 00 00 00 00 80 00 00 00 80 61 27 2D 48 BF 33 69 12 7A DA 00 00 00 00 2B 2B 2B 0F 0F 0F 0E 0E 0E /*194*/
			29 01 00 00 00 00 22 B8 00 00 00 00 00 80 00 00 00 80 61 27 2D 48 BF 33 69 12 7A DA 00 00 00 00 2B 2B 2B 0F 0F 0F 0E 0E 0E /*195*/
			29 01 00 00 00 00 22 B8 00 00 00 00 00 80 00 00 00 80 61 27 2D 48 BF 33 69 12 7A DA 00 00 00 00 2C 2C 2C 0E 0E 0E 0F 0F 0F /*196*/
			29 01 00 00 00 00 22 B8 00 00 00 00 00 80 00 00 00 80 61 27 2D 48 BF 33 69 12 7A DA 00 00 00 00 2C 2C 2C 0F 0F 0F 0E 0E 0E /*197*/
			29 01 00 00 00 00 22 B8 00 00 00 00 00 80 00 00 00 80 61 27 2D 48 BF 33 69 12 7A DA 00 00 00 00 2C 2C 2C 0F 0F 0F 0F 0F 0F /*198*/
			29 01 00 00 00 00 22 B8 00 00 00 00 00 80 00 00 00 80 61 27 2D 48 BF 33 69 12 7A DA 00 00 00 00 2D 2D 2D 0E 0E 0E 0F 0F 0F /*199*/
			29 01 00 00 00 00 22 B8 00 00 00 00 00 80 00 00 00 80 61 27 2D 48 BF 33 69 12 7A DA 00 00 00 00 2D 2D 2D 0F 0F 0F 0F 0F 0F /*200*/
			29 01 00 00 00 00 22 B8 00 00 00 00 00 80 00 00 00 80 61 27 2D 48 BF 33 69 12 7A DA 00 00 00 00 2D 2D 2D 0F 0F 0F 0F 0F 0F /*201*/
			29 01 00 00 00 00 22 B8 00 00 00 00 00 80 00 00 00 80 61 27 2D 48 BF 33 69 12 7A DA 00 00 00 00 2D 2D 2D 10 10 10 0F 0F 0F /*202*/
			29 01 00 00 00 00 22 B8 00 00 00 00 00 80 00 00 00 80 61 27 2D 48 BF 33 69 12 7A DA 00 00 00 00 2E 2E 2E 0F 0F 0F 0F 0F 0F /*203*/
			29 01 00 00 00 00 22 B8 00 00 00 00 00 80 00 00 00 80 61 27 2D 48 BF 33 69 12 7A DA 00 00 00 00 2E 2E 2E 0F 0F 0F 10 10 10 /*204*/
			29 01 00 00 00 00 22 B8 00 00 00 00 00 80 00 00 00 80 61 27 2D 48 BF 33 69 12 7A DA 00 00 00 00 2E 2E 2E 10 10 10 0F 0F 0F /*205*/
			29 01 00 00 00 00 22 B8 00 00 00 00 00 80 00 00 00 80 61 27 2D 48 BF 33 69 12 7A DA 00 00 00 00 2E 2E 2E 10 10 10 0F 0F 0F /*206*/
			29 01 00 00 00 00 22 B8 00 00 00 00 00 80 00 00 00 80 61 27 2D 48 BF 33 69 12 7A DA 00 00 00 00 2F 2F 2F 0F 0F 0F 10 10 10 /*207*/
			29 01 00 00 00 00 22 B8 00 00 00 00 00 80 00 00 00 80 61 27 2D 48 BF 33 69 12 7A DA 00 00 00 00 2F 2F 2F 10 10 10 0F 0F 0F /*208*/
			29 01 00 00 00 00 22 B8 00 00 00 00 00 80 00 00 00 80 61 27 2D 48 BF 33 69 12 7A DA 00 00 00 00 2F 2F 2F 10 10 10 10 10 10 /*209*/
			29 01 00 00 00 00 22 B8 00 00 00 00 00 80 00 00 00 80 61 27 2D 48 BF 33 69 12 7A DA 00 00 00 00 30 30 30 0F 0F 0F 10 10 10 /*210*/
			29 01 00 00 00 00 22 B8 00 00 00 00 00 80 00 00 00 80 61 27 2D 48 BF 33 69 12 7A DA 00 00 00 00 30 30 30 10 10 10 10 10 10 /*211*/
			29 01 00 00 00 00 22 B8 00 00 00 00 00 80 00 00 00 80 61 27 2D 48 BF 33 69 12 7A DA 00 00 00 00 30 30 30 10 10 10 10 10 10 /*212*/
			29 01 00 00 00 00 22 B8 00 00 00 00 00 80 00 00 00 80 61 27 2D 48 BF 33 69 12 7A DA 00 00 00 00 30 30 30 11 11 11 10 10 10 /*213*/
			29 01 00 00 00 00 22 B8 00 00 00 00 00 80 00 00 00 80 61 27 2D 48 BF 33 69 12 7A DA 00 00 00 00 31 31 31 10 10 10 10 10 10 /*214*/
			29 01 00 00 00 00 22 B8 00 00 00 00 00 80 00 00 00 80 61 27 2D 48 BF 33 69 12 7A DA 00 00 00 00 31 31 31 10 10 10 10 10 10 /*215*/
			29 01 00 00 00 00 22 B8 00 00 00 00 00 80 00 00 00 80 61 27 2D 48 BF 33 69 12 7A DA 00 00 00 00 31 31 31 11 11 11 10 10 10 /*216*/
			29 01 00 00 00 00 22 B8 00 00 00 00 00 80 00 00 00 80 61 27 2D 48 BF 33 69 12 7A DA 00 00 00 00 31 31 31 11 11 11 10 10 10 /*217*/
			29 01 00 00 00 00 22 B8 00 00 00 00 00 80 00 00 00 80 61 27 2D 48 BF 33 69 12 7A DA 00 00 00 00 32 32 32 10 10 10 11 11 11 /*218*/
			29 01 00 00 00 00 22 B8 00 00 00 00 00 80 00 00 00 80 61 27 2D 48 BF 33 69 12 7A DA 00 00 00 00 32 32 32 11 11 11 10 10 10 /*219*/
			29 01 00 00 00 00 22 B8 00 00 00 00 00 80 00 00 00 80 61 27 2D 48 BF 33 69 12 7A DA 00 00 00 00 32 32 32 11 11 11 11 11 11 /*220*/
			29 01 00 00 00 00 22 B8 00 00 00 00 00 80 00 00 00 80 61 27 2D 48 BF 33 69 12 7A DA 00 00 00 00 33 33 33 10 10 10 11 11 11 /*221*/
			29 01 00 00 00 00 22 B8 00 00 00 00 00 80 00 00 00 80 61 27 2D 48 BF 33 69 12 7A DA 00 00 00 00 33 33 33 11 11 11 11 11 11 /*222*/
			29 01 00 00 00 00 22 B8 00 00 00 00 00 80 00 00 00 80 61 27 2D 48 BF 33 69 12 7A DA 00 00 00 00 33 33 33 11 11 11 11 11 11 /*223*/
			29 01 00 00 00 00 22 B8 00 00 00 00 00 80 00 00 00 80 61 27 2D 48 BF 33 69 12 7A DA 00 00 00 00 33 33 33 11 11 11 11 11 11 /*224*/
			29 01 00 00 00 00 22 B8 00 00 00 00 00 80 00 00 00 80 61 27 2D 48 BF 33 69 12 7A DA 00 00 00 00 34 34 34 11 11 11 11 11 11 /*225*/
			29 01 00 00 00 00 22 B8 00 00 00 00 00 80 00 00 00 80 61 27 2D 48 BF 33 69 12 7A DA 00 00 00 00 34 34 34 11 11 11 11 11 11 /*226*/
			29 01 00 00 00 00 22 B8 00 00 00 00 00 80 00 00 00 80 61 27 2D 48 BF 33 69 12 7A DA 00 00 00 00 34 34 34 12 12 12 11 11 11 /*227*/
			29 01 00 00 00 00 22 B8 00 00 00 00 00 80 00 00 00 80 61 27 2D 48 BF 33 69 12 7A DA 00 00 00 00 34 34 34 12 12 12 11 11 11 /*228*/
			29 01 00 00 00 00 22 B8 00 00 00 00 00 80 00 00 00 80 61 27 2D 48 BF 33 69 12 7A DA 00 00 00 00 35 35 35 11 11 11 12 12 12 /*229*/
			29 01 00 00 00 00 22 B8 00 00 00 00 00 80 00 00 00 80 61 27 2D 48 BF 33 69 12 7A DA 00 00 00 00 35 35 35 12 12 12 12 12 12 /*230*/
			29 01 00 00 00 00 22 B8 00 00 00 00 00 80 00 00 00 80 61 27 2D 48 BF 33 69 12 7A DA 00 00 00 00 35 35 35 12 12 12 12 12 12 /*231*/
			29 01 00 00 00 00 22 B8 00 00 00 00 00 80 00 00 00 80 61 27 2D 48 BF 33 69 12 7A DA 00 00 00 00 36 36 36 12 12 12 12 12 12 /*232*/
			29 01 00 00 00 00 22 B8 00 00 00 00 00 80 00 00 00 80 61 27 2D 48 BF 33 69 12 7A DA 00 00 00 00 36 36 36 12 12 12 12 12 12 /*233*/
			29 01 00 00 00 00 22 B8 00 00 00 00 00 80 00 00 00 80 61 27 2D 48 BF 33 69 12 7A DA 00 00 00 00 36 36 36 12 12 12 12 12 12 /*234*/
			29 01 00 00 00 00 22 B8 00 00 00 00 00 80 00 00 00 80 61 27 2D 48 BF 33 69 12 7A DA 00 00 00 00 37 37 37 12 12 12 12 12 12 /*235*/
			29 01 00 00 00 00 22 B8 00 00 00 00 00 80 00 00 00 80 61 27 2D 48 BF 33 69 12 7A DA 00 00 00 00 37 37 37 12 12 12 12 12 12 /*236*/
			29 01 00 00 00 00 22 B8 00 00 00 00 00 80 00 00 00 80 61 27 2D 48 BF 33 69 12 7A DA 00 00 00 00 37 37 37 12 12 12 13 13 13 /*237*/
			29 01 00 00 00 00 22 B8 00 00 00 00 00 80 00 00 00 80 61 27 2D 48 BF 33 69 12 7A DA 00 00 00 00 37 37 37 13 13 13 12 12 12 /*238*/
			29 01 00 00 00 00 22 B8 00 00 00 00 00 80 00 00 00 80 61 27 2D 48 BF 33 69 12 7A DA 00 00 00 00 38 38 38 12 12 12 13 13 13 /*239*/
			29 01 00 00 00 00 22 B8 00 00 00 00 00 80 00 00 00 80 61 27 2D 48 BF 33 69 12 7A DA 00 00 00 00 38 38 38 12 12 12 13 13 13 /*240*/
			29 01 00 00 00 00 22 B8 00 00 00 00 00 80 00 00 00 80 61 27 2D 48 BF 33 69 12 7A DA 00 00 00 00 38 38 38 13 13 13 13 13 13 /*241*/
			29 01 00 00 00 00 22 B8 00 00 00 00 00 80 00 00 00 80 61 27 2D 48 BF 33 69 12 7A DA 00 00 00 00 38 38 38 13 13 13 13 13 13 /*242*/
			29 01 00 00 00 00 22 B8 00 00 00 00 00 80 00 00 00 80 61 27 2D 48 BF 33 69 12 7A DA 00 00 00 00 39 39 39 13 13 13 13 13 13 /*243*/
			29 01 00 00 00 00 22 B8 00 00 00 00 00 80 00 00 00 80 61 27 2D 48 BF 33 69 12 7A DA 00 00 00 00 39 39 39 13 13 13 13 13 13 /*244*/
			29 01 00 00 00 00 22 B8 00 00 00 00 00 80 00 00 00 80 61 27 2D 48 BF 33 69 12 7A DA 00 00 00 00 39 39 39 13 13 13 13 13 13 /*245*/
			29 01 00 00 00 00 22 B8 00 00 00 00 00 80 00 00 00 80 61 27 2D 48 BF 33 69 12 7A DA 00 00 00 00 3A 3A 3A 13 13 13 13 13 13 /*246*/
			29 01 00 00 00 00 22 B8 00 00 00 00 00 80 00 00 00 80 61 27 2D 48 BF 33 69 12 7A DA 00 00 00 00 3A 3A 3A 13 13 13 13 13 13 /*247*/
			29 01 00 00 00 00 22 B8 00 00 00 00 00 80 00 00 00 80 61 27 2D 48 BF 33 69 12 7A DA 00 00 00 00 3A 3A 3A 14 14 14 13 13 13 /*248*/
			29 01 00 00 00 00 22 B8 00 00 00 00 00 80 00 00 00 80 61 27 2D 48 BF 33 69 12 7A DA 00 00 00 00 3B 3B 3B 13 13 13 14 14 14 /*249*/
			29 01 00 00 00 00 22 B8 00 00 00 00 00 80 00 00 00 80 61 27 2D 48 BF 33 69 12 7A DA 00 00 00 00 3B 3B 3B 13 13 13 14 14 14 /*250*/
			29 01 00 00 00 00 22 B8 00 00 00 00 00 80 00 00 00 80 61 27 2D 48 BF 33 69 12 7A DA 00 00 00 00 3B 3B 3B 14 14 14 14 14 14 /*251*/
			29 01 00 00 00 00 22 B8 00 00 00 00 00 80 00 00 00 80 61 27 2D 48 BF 33 69 12 7A DA 00 00 00 00 3B 3B 3B 14 14 14 14 14 14 /*252*/
			29 01 00 00 00 00 22 B8 00 00 00 00 00 80 00 00 00 80 61 27 2D 48 BF 33 69 12 7A DA 00 00 00 00 3C 3C 3C 13 13 13 14 14 14 /*253*/
			29 01 00 00 00 00 22 B8 00 00 00 00 00 80 00 00 00 80 61 27 2D 48 BF 33 69 12 7A DA 00 00 00 00 3C 3C 3C 14 14 14 14 14 14 /*254*/
			29 01 00 00 00 00 22 B8 00 00 00 00 00 80 00 00 00 80 61 27 2D 48 BF 33 69 12 7A DA 00 00 00 00 3C 3C 3C 14 14 14 14 14 14 /*255*/
		];

		samsung,hbm_irc_tx_cmds_revA = [
			29 01 00 00 00 00 22 B8 00 00 00 00 00 80 00 00 00 80 61 27 2D 48 BF 33 69 12 7A DA 00 00 00 00 56 56 56 1C 1C 1C 1D 1D 1D /*600*/
			29 01 00 00 00 00 22 B8 00 00 00 00 00 80 00 00 00 80 61 27 2D 48 BF 33 69 12 7A DA 00 00 00 00 53 53 53 1B 1B 1B 1C 1C 1C /*578*/
			29 01 00 00 00 00 22 B8 00 00 00 00 00 80 00 00 00 80 61 27 2D 48 BF 33 69 12 7A DA 00 00 00 00 4F 4F 4F 1B 1B 1B 1A 1A 1A /*555*/
			29 01 00 00 00 00 22 B8 00 00 00 00 00 80 00 00 00 80 61 27 2D 48 BF 33 69 12 7A DA 00 00 00 00 4C 4C 4C 1A 1A 1A 19 19 19 /*533*/
			29 01 00 00 00 00 22 B8 00 00 00 00 00 80 00 00 00 80 61 27 2D 48 BF 33 69 12 7A DA 00 00 00 00 49 49 49 18 18 18 18 18 18 /*510*/
			29 01 00 00 00 00 22 B8 00 00 00 00 00 80 00 00 00 80 61 27 2D 48 BF 33 69 12 7A DA 00 00 00 00 46 46 46 17 17 17 17 17 17 /*488*/
			29 01 00 00 00 00 22 B8 00 00 00 00 00 80 00 00 00 80 61 27 2D 48 BF 33 69 12 7A DA 00 00 00 00 42 42 42 17 17 17 16 16 16 /*465*/
			29 01 00 00 00 00 22 B8 00 00 00 00 00 80 00 00 00 80 61 27 2D 48 BF 33 69 12 7A DA 00 00 00 00 3F 3F 3F 15 15 15 15 15 15 /*443*/
		];

		/*
		* ************************************************************************************************************************
		* ELVSS command list and mappings
		* ************************************************************************************************************************
		*/

		samsung,elvss_rx_cmds_revA = [ 06 01 00 00 00 00 01 B5 02 16];	/* read B5 23, 24th, 22=0x16*/

		samsung,elvss_lowtemp_tx_cmds_revA = [
			29 01 00 00 00 00 02 B5 19 /* TEST */
		];	/* Low Temperature Command: default */

		samsung,elvss_high_tx_cmds_revA = [
			29 01 00 00 00 00 18 B5 19 DC 04 01 34 67 9A CD 01 22 33 44 C0 00 09 99 33 13 01 11 10 00 00 /* 0  420CD ~ 412CD */
			29 01 00 00 00 00 18 B5 19 DC 05 01 34 67 9A CD 01 22 33 44 C0 00 09 99 33 13 01 11 10 00 00 /* 1  403CD ~ 380CD */
			29 01 00 00 00 00 18 B5 19 DC 06 01 34 67 9A CD 01 22 33 44 C0 00 09 99 33 13 01 11 10 00 00 /* 2  372CD ~ 357CD */
			29 01 00 00 00 00 18 B5 19 DC 07 01 34 67 9A CD 01 22 33 44 C0 00 09 99 33 13 01 11 10 00 00 /* 3  350CD */
			29 01 00 00 00 00 18 B5 19 DC 08 01 34 67 9A CD 01 22 33 44 C0 00 09 99 33 13 01 11 10 00 00 /* 4  333CD */
			29 01 00 00 00 00 18 B5 19 DC 09 01 34 67 9A CD 01 22 33 44 C0 00 09 99 33 13 01 11 10 00 00 /* 5  316CD ~ 300CD */
			29 01 00 00 00 00 18 B5 19 DC 0A 01 34 67 9A CD 01 22 33 44 C0 00 09 99 33 13 01 11 10 00 00 /* 6  282CD */
			29 01 00 00 00 00 18 B5 19 DC 0B 01 34 67 9A CD 01 22 33 44 C0 00 09 99 33 13 01 11 10 00 00 /* 7  265CD */
			29 01 00 00 00 00 18 B5 19 DC 0C 01 34 67 9A CD 01 22 33 44 C0 00 09 99 33 13 01 11 10 00 00 /* 8  249CD ~ 234CD */
			29 01 00 00 00 00 18 B5 19 DC 0D 01 34 67 9A CD 01 22 33 44 C0 00 09 99 33 13 01 11 10 00 00 /* 9  220CD ~ 172CD */
			29 01 00 00 00 00 18 B5 19 DC 0E 01 34 67 9A CD 01 22 33 44 C0 00 09 99 33 13 01 11 10 00 00 /* 10 162CD ~ 152CD */
			29 01 00 00 00 00 18 B5 19 DC 0F 01 34 67 9A CD 01 22 33 44 C0 00 09 99 33 13 01 11 10 00 00 /* 11 143CD ~ 126CD */
			29 01 00 00 00 00 18 B5 19 DC 10 01 34 67 9A CD 01 22 33 44 C0 00 09 99 33 13 01 11 10 00 00 /* 12 119CD ~ 105CD */
			29 01 00 00 00 00 18 B5 19 DC 11 01 34 67 9A CD 01 22 33 44 C0 00 09 99 33 13 01 11 10 00 00 /* 13 98CD ~ 87CD */
			29 01 00 00 00 00 18 B5 19 DC 12 01 34 67 9A CD 01 22 33 44 C0 00 09 99 33 13 01 11 10 00 00 /* 14 82CD ~ 41CD */
			29 01 00 00 00 00 18 B5 19 CC 12 01 34 67 9A CD 01 22 33 44 C0 00 09 99 33 13 01 11 10 00 00 /* 15 39CD ~ 16CD */
			29 01 00 00 00 00 18 B5 19 CC 11 01 34 67 9A CD 01 22 33 44 C0 00 09 99 33 13 01 11 10 00 00 /* 16 15CD */
			29 01 00 00 00 00 18 B5 19 CC 10 01 34 67 9A CD 01 22 33 44 C0 00 09 99 33 13 01 11 10 00 00 /* 17 14CD */
			29 01 00 00 00 00 18 B5 19 CC 0F 01 34 67 9A CD 01 22 33 44 C0 00 09 99 33 13 01 11 10 00 00 /* 18 13CD */
			29 01 00 00 00 00 18 B5 19 CC 0E 01 34 67 9A CD 01 22 33 44 C0 00 09 99 33 13 01 11 10 00 00 /* 19 12CD */
			29 01 00 00 00 00 18 B5 19 CC 0D 01 34 67 9A CD 01 22 33 44 C0 00 09 99 33 13 01 11 10 00 00 /* 20 11CD */
			29 01 00 00 00 00 18 B5 19 CC 0C 01 34 67 9A CD 01 22 33 44 C0 00 09 99 33 13 01 11 10 00 00 /* 21 10CD */
			29 01 00 00 00 00 18 B5 19 CC 0B 01 34 67 9A CD 01 22 33 44 C0 00 09 99 33 13 01 11 10 00 00 /* 22 9CD */
			29 01 00 00 00 00 18 B5 19 CC 0A 01 34 67 9A CD 01 22 33 44 C0 00 09 99 33 13 01 11 10 00 00 /* 23 8CD */
			29 01 00 00 00 00 18 B5 19 CC 09 01 34 67 9A CD 01 22 33 44 C0 00 09 99 33 13 01 11 10 00 00 /* 24 7CD */
			29 01 00 00 00 00 18 B5 19 CC 08 01 34 67 9A CD 01 22 33 44 C0 00 09 99 33 13 01 11 10 00 00 /* 25 6D */
			29 01 00 00 00 00 18 B5 19 CC 07 01 34 67 9A CD 01 22 33 44 C0 00 09 99 33 13 01 11 10 00 00 /* 26 5D */
			29 01 00 00 00 00 18 B5 19 CC 06 01 34 67 9A CD 01 22 33 44 C0 00 09 99 33 13 01 11 10 00 00 /* 27 4D */
			29 01 00 00 00 00 18 B5 19 CC 05 01 34 67 9A CD 01 22 33 44 C0 00 09 99 33 13 01 11 10 00 00 /* 28 3D */
			29 01 00 00 00 00 18 B5 19 CC 04 01 34 67 9A CD 01 22 33 44 C0 00 09 99 33 13 01 11 10 00 00 /* 29 2D */
		];

		samsung,elvss_mid_tx_cmds_revA = [
			29 01 00 00 00 00 18 B5 19 DC 04 01 34 67 9A CD 01 22 33 44 C0 00 09 99 33 13 01 11 10 00 00 /* 0  420CD ~ 412CD */
			29 01 00 00 00 00 18 B5 19 DC 05 01 34 67 9A CD 01 22 33 44 C0 00 09 99 33 13 01 11 10 00 00 /* 1  403CD ~ 380CD */
			29 01 00 00 00 00 18 B5 19 DC 06 01 34 67 9A CD 01 22 33 44 C0 00 09 99 33 13 01 11 10 00 00 /* 2  372CD ~ 357CD */
			29 01 00 00 00 00 18 B5 19 DC 07 01 34 67 9A CD 01 22 33 44 C0 00 09 99 33 13 01 11 10 00 00 /* 3  350CD */
			29 01 00 00 00 00 18 B5 19 DC 08 01 34 67 9A CD 01 22 33 44 C0 00 09 99 33 13 01 11 10 00 00 /* 4  333CD */
			29 01 00 00 00 00 18 B5 19 DC 09 01 34 67 9A CD 01 22 33 44 C0 00 09 99 33 13 01 11 10 00 00 /* 5  316CD ~ 300CD */
			29 01 00 00 00 00 18 B5 19 DC 0A 01 34 67 9A CD 01 22 33 44 C0 00 09 99 33 13 01 11 10 00 00 /* 6  282CD */
			29 01 00 00 00 00 18 B5 19 DC 0B 01 34 67 9A CD 01 22 33 44 C0 00 09 99 33 13 01 11 10 00 00 /* 7  265CD */
			29 01 00 00 00 00 18 B5 19 DC 0C 01 34 67 9A CD 01 22 33 44 C0 00 09 99 33 13 01 11 10 00 00 /* 8  249CD ~ 234CD */
			29 01 00 00 00 00 18 B5 19 DC 0D 01 34 67 9A CD 01 22 33 44 C0 00 09 99 33 13 01 11 10 00 00 /* 9  220CD ~ 172CD */
			29 01 00 00 00 00 18 B5 19 DC 0E 01 34 67 9A CD 01 22 33 44 C0 00 09 99 33 13 01 11 10 00 00 /* 10 162CD ~ 152CD */
			29 01 00 00 00 00 18 B5 19 DC 0F 01 34 67 9A CD 01 22 33 44 C0 00 09 99 33 13 01 11 10 00 00 /* 11 143CD ~ 126CD */
			29 01 00 00 00 00 18 B5 19 DC 10 01 34 67 9A CD 01 22 33 44 C0 00 09 99 33 13 01 11 10 00 00 /* 12 119CD ~ 105CD */
			29 01 00 00 00 00 18 B5 19 DC 11 01 34 67 9A CD 01 22 33 44 C0 00 09 99 33 13 01 11 10 00 00 /* 13 98CD ~ 87CD */
			29 01 00 00 00 00 18 B5 19 DC 12 01 34 67 9A CD 01 22 33 44 C0 00 09 99 33 13 01 11 10 00 00 /* 14 82CD ~ 41CD */
			29 01 00 00 00 00 18 B5 19 CC 12 01 34 67 9A CD 01 22 33 44 C0 00 09 99 33 13 01 11 10 00 00 /* 15 39CD ~ 16CD */
			29 01 00 00 00 00 18 B5 19 CC 11 01 34 67 9A CD 01 22 33 44 C0 00 09 99 33 13 01 11 10 00 00 /* 16 15CD */
			29 01 00 00 00 00 18 B5 19 CC 10 01 34 67 9A CD 01 22 33 44 C0 00 09 99 33 13 01 11 10 00 00 /* 17 14CD */
			29 01 00 00 00 00 18 B5 19 CC 0F 01 34 67 9A CD 01 22 33 44 C0 00 09 99 33 13 01 11 10 00 00 /* 18 13CD */
			29 01 00 00 00 00 18 B5 19 CC 0E 01 34 67 9A CD 01 22 33 44 C0 00 09 99 33 13 01 11 10 00 00 /* 19 12CD */
			29 01 00 00 00 00 18 B5 19 CC 0D 01 34 67 9A CD 01 22 33 44 C0 00 09 99 33 13 01 11 10 00 00 /* 20 11CD */
			29 01 00 00 00 00 18 B5 19 CC 0C 01 34 67 9A CD 01 22 33 44 C0 00 09 99 33 13 01 11 10 00 00 /* 21 10CD */
			29 01 00 00 00 00 18 B5 19 CC 0B 01 34 67 9A CD 01 22 33 44 C0 00 09 99 33 13 01 11 10 00 00 /* 22 9CD */
			29 01 00 00 00 00 18 B5 19 CC 0A 01 34 67 9A CD 01 22 33 44 C0 00 09 99 33 13 01 11 10 00 00 /* 23 8CD */
			29 01 00 00 00 00 18 B5 19 CC 09 01 34 67 9A CD 01 22 33 44 C0 00 09 99 33 13 01 11 10 00 00 /* 24 7CD */
			29 01 00 00 00 00 18 B5 19 CC 08 01 34 67 9A CD 01 22 33 44 C0 00 09 99 33 13 01 11 10 00 00 /* 25 6D */
			29 01 00 00 00 00 18 B5 19 CC 07 01 34 67 9A CD 01 22 33 44 C0 00 09 99 33 13 01 11 10 00 00 /* 26 5D */
			29 01 00 00 00 00 18 B5 19 CC 06 01 34 67 9A CD 01 22 33 44 C0 00 09 99 33 13 01 11 10 00 00 /* 27 4D */
			29 01 00 00 00 00 18 B5 19 CC 05 01 34 67 9A CD 01 22 33 44 C0 00 09 99 33 13 01 11 10 00 00 /* 28 3D */
			29 01 00 00 00 00 18 B5 19 CC 04 01 34 67 9A CD 01 22 33 44 C0 00 09 99 33 13 01 11 10 00 00 /* 29 2D */
		];

		samsung,elvss_low_tx_cmds_revA = [
			29 01 00 00 00 00 18 B5 19 DC 04 01 34 67 9A CD 01 22 33 44 C0 00 09 99 33 13 01 11 10 00 00 /* 0  420CD ~ 412CD */
			29 01 00 00 00 00 18 B5 19 DC 05 01 34 67 9A CD 01 22 33 44 C0 00 09 99 33 13 01 11 10 00 00 /* 1  403CD ~ 380CD */
			29 01 00 00 00 00 18 B5 19 DC 06 01 34 67 9A CD 01 22 33 44 C0 00 09 99 33 13 01 11 10 00 00 /* 2  372CD ~ 357CD */
			29 01 00 00 00 00 18 B5 19 DC 07 01 34 67 9A CD 01 22 33 44 C0 00 09 99 33 13 01 11 10 00 00 /* 3  350CD */
			29 01 00 00 00 00 18 B5 19 DC 08 01 34 67 9A CD 01 22 33 44 C0 00 09 99 33 13 01 11 10 00 00 /* 4  333CD */
			29 01 00 00 00 00 18 B5 19 DC 09 01 34 67 9A CD 01 22 33 44 C0 00 09 99 33 13 01 11 10 00 00 /* 5  316CD ~ 300CD */
			29 01 00 00 00 00 18 B5 19 DC 0A 01 34 67 9A CD 01 22 33 44 C0 00 09 99 33 13 01 11 10 00 00 /* 6  282CD */
			29 01 00 00 00 00 18 B5 19 DC 0B 01 34 67 9A CD 01 22 33 44 C0 00 09 99 33 13 01 11 10 00 00 /* 7  265CD */
			29 01 00 00 00 00 18 B5 19 DC 0C 01 34 67 9A CD 01 22 33 44 C0 00 09 99 33 13 01 11 10 00 00 /* 8  249CD ~ 234CD */
			29 01 00 00 00 00 18 B5 19 DC 0D 01 34 67 9A CD 01 22 33 44 C0 00 09 99 33 13 01 11 10 00 00 /* 9  220CD ~ 172CD */
			29 01 00 00 00 00 18 B5 19 DC 0E 01 34 67 9A CD 01 22 33 44 C0 00 09 99 33 13 01 11 10 00 00 /* 10 162CD ~ 152CD */
			29 01 00 00 00 00 18 B5 19 DC 0F 01 34 67 9A CD 01 22 33 44 C0 00 09 99 33 13 01 11 10 00 00 /* 11 143CD ~ 126CD */
			29 01 00 00 00 00 18 B5 19 DC 10 01 34 67 9A CD 01 22 33 44 C0 00 09 99 33 13 01 11 10 00 00 /* 12 119CD ~ 105CD */
			29 01 00 00 00 00 18 B5 19 DC 11 01 34 67 9A CD 01 22 33 44 C0 00 09 99 33 13 01 11 10 00 00 /* 13 98CD ~ 87CD */
			29 01 00 00 00 00 18 B5 19 DC 12 01 34 67 9A CD 01 22 33 44 C0 00 09 99 33 13 01 11 10 00 00 /* 14 82CD ~ 41CD */
			29 01 00 00 00 00 18 B5 19 CC 12 01 34 67 9A CD 01 22 33 44 C0 00 09 99 33 13 01 11 10 00 00 /* 15 39CD ~ 16CD */
			29 01 00 00 00 00 18 B5 19 CC 11 01 34 67 9A CD 01 22 33 44 C0 00 09 99 33 13 01 11 10 00 00 /* 16 15CD */
			29 01 00 00 00 00 18 B5 19 CC 10 01 34 67 9A CD 01 22 33 44 C0 00 09 99 33 13 01 11 10 00 00 /* 17 14CD */
			29 01 00 00 00 00 18 B5 19 CC 0F 01 34 67 9A CD 01 22 33 44 C0 00 09 99 33 13 01 11 10 00 00 /* 18 13CD */
			29 01 00 00 00 00 18 B5 19 CC 0E 01 34 67 9A CD 01 22 33 44 C0 00 09 99 33 13 01 11 10 00 00 /* 19 12CD */
			29 01 00 00 00 00 18 B5 19 CC 0E 01 34 67 9A CD 01 22 33 44 C0 00 09 99 33 13 01 11 10 00 00 /* 20 11CD */
			29 01 00 00 00 00 18 B5 19 CC 0E 01 34 67 9A CD 01 22 33 44 C0 00 09 99 33 13 01 11 10 00 00 /* 21 10CD */
			29 01 00 00 00 00 18 B5 19 CC 0E 01 34 67 9A CD 01 22 33 44 C0 00 09 99 33 13 01 11 10 00 00 /* 22 9CD */
			29 01 00 00 00 00 18 B5 19 CC 0E 01 34 67 9A CD 01 22 33 44 C0 00 09 99 33 13 01 11 10 00 00 /* 23 8CD */
			29 01 00 00 00 00 18 B5 19 CC 0E 01 34 67 9A CD 01 22 33 44 C0 00 09 99 33 13 01 11 10 00 00 /* 24 7CD */
			29 01 00 00 00 00 18 B5 19 CC 0E 01 34 67 9A CD 01 22 33 44 C0 00 09 99 33 13 01 11 10 00 00 /* 25 6D */
			29 01 00 00 00 00 18 B5 19 CC 0E 01 34 67 9A CD 01 22 33 44 C0 00 09 99 33 13 01 11 10 00 00 /* 26 5D */
			29 01 00 00 00 00 18 B5 19 CC 0E 01 34 67 9A CD 01 22 33 44 C0 00 09 99 33 13 01 11 10 00 00 /* 27 4D */
			29 01 00 00 00 00 18 B5 19 CC 0E 01 34 67 9A CD 01 22 33 44 C0 00 09 99 33 13 01 11 10 00 00 /* 28 3D */
			29 01 00 00 00 00 18 B5 19 CC 0E 01 34 67 9A CD 01 22 33 44 C0 00 09 99 33 13 01 11 10 00 00 /* 29 2D */
		];

		/* bl_level, Index in elvss command list */
		samsung,smart_acl_elvss_map_table_revA = <
			2	29		3	28		4	27		5	26		6	25
			7	24		8	23		9	22		10	21		11	20
			12	19		13	18		14	17		15	16		16	15
			17	15		19	15		20	15		21	15		22	15
			24	15		25	15		27	15		29	15		30	15
			32	15		34	15		37	15		39	15		41	14
			44	14		47	14		50	14		53	14		56	14
			60	14		64	14		68	14		72	14		77	14
			82	14		87	13		93	13		98	13		105	12
			111	12		119	12		126	11		134	11		143	11
			152	10		162	10		172	9		183	9		195	9
			207	9		220	9		234	8		249	8		265	7
			282	6		300	5		316	5		333	4		350	3
			357	2		365	2		372	2		380	1		387	1
			395	1		403	1		412	0		420	0
		>;

		/*
		 * ************************************************************************************************************************
		 * candela to index mappings
		 * ************************************************************************************************************************
		 */
		samsung,candela_map_table_revA = <
			/*<idx>   <from>  <till> <candella> */
			0	0	0	2
			1	1	7	3
			2	8	14	4
			3	15	21	5
			4	22	28	6
			5	29	34	7
			6	35	36	8
			7	37	38	9
			8	39	40	10
			9	41	42	11
			10	43	44	12
			11	45	46	13
			12	47	48	14
			13	49	50	15
			14	51	52	16
			15	53	54	17
			16	55	56	19
			17	57	57	20
			18	58	59	21
			19	60	61	22
			20	62	63	24
			21	64	65	25
			22	66	67	27
			23	68	69	29
			24	70	70	30
			25	71	72	32
			26	73	74	34
			27	75	76	37
			28	77	78	39
			29	79	80	41
			30	81	82	44
			31	83	84	47
			32	85	86	50
			33	87	88	53
			34	89	90	56
			35	91	92	60
			36	93	94	64
			37	95	96	68
			38	97	98	72
			39	99	100	77
			40	101	102	82
			41	103	104	87
			42	105	106	93
			43	107	108	98
			44	109	110	105
			45	111	112	111
			46	113	114	119
			47	115	116	126
			48	117	118	134
			49	119	120	143
			50	121	122	152
			51	123	124	162
			52	125	126	172
			53	127	128	183 /* default */
			54	129	135	195
			55	136	142	207
			56	143	149	220
			57	150	157	234
			58	158	165	249
			59	166	174	265
			60	175	183	282
			61	184	193	300
			62	194	201	316
			63	202	210	333
			64	211	219	350
			65	220	223	357
			66	224	227	365
			67	228	230	372
			68	231	234	380
			69	235	238	387
			70	239	242	395
			71	243	246	403
			72	247	250	412
			73	251	268	420
		>;

		samsung,hbm_candela_map_table_revA = <
			0	269	281	443	6
			1	282	295	465	7
			2	296	309	488	8
			3	310	323	510	9
			4	324	336	533	10
			5	337	350	555	11
			6	351	364	578	12
			7	365	365	600	13
		>;

		/*
		 * ************************************************************************************************************************
		 *  ALPM/HLPM
		 * ************************************************************************************************************************
		 */

		samsung,alpm_on_tx_cmds_revA = [
			29 01 00 00 00 00 03 F0 5A 5A		/* TEST KEY Enable */

			29 01 00 00 00 00 03 B1 08 98		/* AOR Control 98.7% */
			29 01 00 00 11 00 02 F7 03			/* Gamma, LTPS(AID) update, 16.7ms delay */

			29 01 00 00 00 00 06 BB 15 8C 08 10 7D		/* HLPM Mode (60cd:0x0C / 2cd:0x8C) */
			29 01 00 00 00 00 02 53 03			/* HLPM On (60cd:0x02 / 2cd:0x03) */
			29 01 00 00 01 00 02 F7 03			/* Gamma, LTPS(AID) update */

			29 01 00 00 00 00 03 F0 A5 A5
		];

		samsung,alpm_off_tx_cmds_revA = [
			29 01 00 00 00 00 03 F0 5A 5A		/* TEST KEY Enable */

			29 01 00 00 00 00 05 BB 15 8C 88 7D /* AOR Control */
			29 01 00 00 22 00 02 F7 03			/* Gamma update, 33.4ms delay */
												/* image write for normal mode */
			29 01 00 00 00 00 02 53 00			/* HLPM off */

			29 01 00 00 00 00 03 F0 A5 A5
		];

		samsung,lpm_2nit_tx_cmds_revA =  [29 01 00 00 14 00 02 53 03];       /* HLPM/ALPM 2nit On*/
		samsung,lpm_60nit_tx_cmds_revA = [29 01 00 00 14 00 02 53 02];		 /* HLPM/ALPM 60nit On*/

		samsung,lpm_ctrl_alpm_2nit_tx_cmds_revA =  [29 01 00 00 00 00 05 BB C4 00 07 30];
		samsung,lpm_ctrl_alpm_60nit_tx_cmds_revA = [29 01 00 00 00 00 05 BB 84 00 07 30];

		samsung,lpm_ctrl_hlpm_2nit_tx_cmds_revA =  [29 01 00 00 00 00 05 BB 54 00 07 60];
		samsung,lpm_ctrl_hlpm_60nit_tx_cmds_revA = [29 01 00 00 00 00 05 BB 14 00 07 60];

		samsung,lpm_ctrl_alpm_aod_off_tx_cmds_revA = [
			29 01 00 00 00 00 03 F0 5A 5A	/* TEST KEY Enable */
			29 01 00 00 00 00 02 BB 00		/* AOD off */
			29 01 00 00 00 00 03 F0 A5 A5	/* TEST KEY Disable */
		];

		samsung,lpm_ctrl_alpm_aod_on_tx_cmds_revA = [
			29 01 00 00 00 00 03 F0 5A 5A	/* TEST KEY Enable */
			29 01 00 00 00 00 02 BB 01		/* AOD on */
			29 01 00 00 00 00 03 F0 A5 A5	/* TEST KEY Disable */
		];

		/*
		* ************************************************************************************************************************
		*  HMT
		* ************************************************************************************************************************
		*/
		samsung,hmt_enabled;
		samsung,hmt_aid_tx_cmds_revA = [
			29 01 00 00 00 00 05 B1 01 C2 10 00   /*10cd */
			29 01 00 00 00 00 05 B1 01 C2 10 00   /*11cd */
			29 01 00 00 00 00 05 B1 01 C2 10 00   /*12cd */
			29 01 00 00 00 00 05 B1 01 C2 10 00   /*13cd */
			29 01 00 00 00 00 05 B1 01 C2 10 00   /*14cd */
			29 01 00 00 00 00 05 B1 01 C2 10 00   /*15cd */
			29 01 00 00 00 00 05 B1 01 C2 10 00   /*16cd */
			29 01 00 00 00 00 05 B1 01 C2 10 00   /*17cd */
			29 01 00 00 00 00 05 B1 01 C2 10 00   /*19cd */
			29 01 00 00 00 00 05 B1 01 C2 10 00   /*20cd */
			29 01 00 00 00 00 05 B1 01 C2 10 00   /*21cd */
			29 01 00 00 00 00 05 B1 01 C2 10 00   /*22cd */
			29 01 00 00 00 00 05 B1 01 C2 10 00   /*23cd */
			29 01 00 00 00 00 05 B1 01 C2 10 00   /*25cd */
			29 01 00 00 00 00 05 B1 01 C2 10 00   /*27cd */
			29 01 00 00 00 00 05 B1 01 C2 10 00   /*29cd */
			29 01 00 00 00 00 05 B1 01 C2 10 00   /*31cd */
			29 01 00 00 00 00 05 B1 01 C2 10 00   /*33cd */
			29 01 00 00 00 00 05 B1 01 C2 10 00   /*35cd */
			29 01 00 00 00 00 05 B1 01 C2 10 00   /*37cd */
			29 01 00 00 00 00 05 B1 01 C2 10 00   /*39cd */
			29 01 00 00 00 00 05 B1 01 C2 10 00   /*41cd */
			29 01 00 00 00 00 05 B1 01 C2 10 00   /*44cd */
			29 01 00 00 00 00 05 B1 01 C2 10 00   /*47cd */
			29 01 00 00 00 00 05 B1 01 C2 10 00   /*50cd */
			29 01 00 00 00 00 05 B1 01 C2 10 00   /*53cd */
			29 01 00 00 00 00 05 B1 01 C2 10 00   /*56cd */
			29 01 00 00 00 00 05 B1 01 C2 10 00   /*60cd */
			29 01 00 00 00 00 05 B1 01 C2 10 00   /*64cd */
			29 01 00 00 00 00 05 B1 01 C2 10 00   /*68cd */
			29 01 00 00 00 00 05 B1 01 C2 10 00   /*72cd */
			29 01 00 00 00 00 05 B1 02 A2 10 00   /*77cd */
			29 01 00 00 00 00 05 B1 02 A2 10 00   /*82cd */
			29 01 00 00 00 00 05 B1 02 A2 10 00   /*87cd */
			29 01 00 00 00 00 05 B1 02 A2 10 00   /*93cd */
			29 01 00 00 00 00 05 B1 02 A2 10 00   /*99cd */
			29 01 00 00 00 00 05 B1 02 A2 10 00   /*105cd */
		];

		/* bl_level, Index in acl command list */
		samsung,hmt_reverse_aid_map_table_revA = <
			10	0
			11	1
			12	2
			13	3
			14	4
			15	5
			16	6
			17	7
			19	8
			20	9
			21	10
			22	11
			23	12
			25	13
			27	14
			29	15
			31	16
			33	17
			35	18
			37	19
			39	20
			41	21
			44	22
			47	23
			50	24
			53	25
			56	26
			60	27
			64	28
			68	29
			72	30
			77	31
			82	32
			87	33
			93	34
			99	35
			105	36
		>;

		samsung,hmt_candela_map_table_revA = <
		/*<idx>	  <from>  <till> <candella> */
			0	0	26	10
			1	27	29	11
			2	30	31	12
			3	32	33	13
			4	34	36	14
			5	37	38	15
			6	39	41	16
			7	42	46	17
			8	47	48	19
			9	49	50	20
			10	51	53	21
			11	54	55	22
			12	56	60	23
			13	61	65	25
			14	66	70	27
			15	71	75	29
			16	76	80	31
			17	81	84	33
			18	85	89	35
			19	90	94	37
			20	95	99	39
			21	100	106	41
			22	107	114	44
			23	115	121	47
			24	122	128	50
			25	129	135	53
			26	136	145	56
			27	146	155	60
			28	156	165	64
			29	166	174	68
			30	175	186	72
			31	187	199	77
			32	200	211	82
			33	212	225	87
			34	226	240	93
			35	241	254	99
			36	255	255	105
		>;

		samsung,hmt_gamma_tx_cmds_revA = [
			29 01 00 00 00 00 22 CA				/* 1) Gamma 2.2 Setting */
						07					/* VTR/V255 R[8],G[8],B[8] */
						00					/* VTG/VTB */
						00					/* V255 R[7:0] */
						00					/* V255 G[7:0] */
						00					/* nothing */
						00					/* V255 B[7:0] */
						80 80 80			/* V203 R,G,B */
						80 80 80			/* V151 R,G,B */
						80 80 80			/* V87 R,G,B */
						80 80 80			/* V51 R,G,B */
						80 80 80			/* V35 R,G,B */
						80 80 80			/* V23 R,G,B */
						80 80 80			/* V11 R,G,B */
						80 80 80			/*  V7 R,G,B */
						80 80 80			/*  V1 R,G,B */
			29 01 00 00 00 00 08 B4 00 44 7F 00 00 0A 00  /* 2nd:0x44 16frame avg, 3rd:0x7F start point 50%, 7th:0x00 ACL Off */
			29 01 00 00 00 00 02 55 00		/* ACL OFF */
			29 01 00 00 00 00 03 B8 00 00	/* IRC OFF */
			29 01 00 00 01 00 02 F7 03		/* Gamma, LTPS(AID) update */
		];

		samsung,hmt_elvss_tx_cmds_revA = [
			29 01 00 00 00 00 04 B5 19 00 04
		];

		samsung,hmt_irc_tx_cmds_revA = [
			29 01 00 00 00 00 0C B8 00 00 00 00 00 80 00 00 00 00 00
		];


		samsung,hmt_enable_tx_cmds_revA = [
				29 01 00 00 00 00 03 F0 5A 5A
				29 01 00 00 00 00 05 B1 02 A2 10 00	/* AID 1-Cycle */
				29 01 00 00 00 00 03 F0 A5 A5
			];

		samsung,hmt_disable_tx_cmds_revA = [
				29 01 00 00 00 00 03 F0 5A 5A
				29 01 00 00 00 00 05 B1 02 A2 10 80	/* AID 4-Cycle */
				29 01 00 00 01 00 02 F7 03				/* Gamma, LTPS(AID) update */
				29 01 00 00 00 00 03 F0 A5 A5
			];

		samsung,hmt_reverse_tx_cmds_revA = [
				29 01 00 00 00 00 03 F0 5A 5A
				29 01 00 00 00 00 60 CB					/* LTPS setting */
					08 00 01 01 01 09 61 81
					00 00 03 0E 00 00 00 00
					00 00 19 66 00 00 00 00
					00 00 00 00 00 00 00 00
					15 00 00 00 00 00 00 00
					72 00 00 D1 D5 13 04 C5
					82 00 C0 C0 00 00 00 C0
					C0 E0 E0 A0 E4 E5 E2 00
					00 00 00 00 00 20 80 00
					00 0F 02 00 00 00 00 5A
					33 00 00 00 00 05 00 00
					00 00 00 00 00 00 86
				29 01 00 00 01 00 02 F7 03				/* Gamma, LTPS(AID) update */
				29 01 00 00 00 00 03 F0 A5 A5
			];

		samsung,hmt_forward_tx_cmds_revA = [
				29 01 00 00 00 00 03 F0 5A 5A
				29 01 00 00 00 00 60 CB					/* LTPS setting */
					08 00 01 01 01 09 61 81
					00 00 0B 06 00 00 00 00
					00 00 19 66 00 00 00 00
					00 00 00 00 00 00 00 00
					05 00 00 00 00 00 00 00
					72 00 00 D1 D5 13 04 C5
					82 00 C0 C0 00 00 00 C0
					C0 E0 E0 20 E4 E5 E2 00
					00 00 00 00 00 20 80 00
					00 0F 02 00 00 00 00 5A
					33 00 00 00 00 05 00 00
					00 00 00 00 00 00 86
				29 01 00 00 01 00 02 F7 03				/* Gamma, LTPS(AID) update */
				29 01 00 00 00 00 03 F0 A5 A5
			];

		/*
		* ************************************************************************************************************************
		* Self Display Operation (ENABLE)
		* ************************************************************************************************************************
		*/

		samsung,self_dispaly_on_revA = [
			29 01 00 00 00 00 03 F0 5A 5A	/* TEST KEY Enable */
			29 01 00 00 00 00 07 76
								08 10 84 38 08
								AC
			29 01 00 00 00 00 03 F0 A5 A5	/* TEST KEY Disable */
		];

		samsung,self_dispaly_off_revA = [
			29 01 00 00 00 00 03 F0 5A 5A	/* TEST KEY Enable */
			29 01 00 00 00 00 04 76
								08 10 00
			29 01 00 00 00 00 03 F0 A5 A5	/* TEST KEY Disable */
		];

		/*
		* ************************************************************************************************************************
		* Self Display Operation (SELF MOVE)
		* ************************************************************************************************************************
		*/

		samsung,self_move_small_jump_on_revA = [
			29 01 00 00 00 00 03 F0 5A 5A	/* TEST KEY Enable */
			29 01 00 00 00 00 02 B0 33
			29 01 00 00 00 00 62 7D
								00 00 00 00 00
								00 00 33 33 33
								33 33 33 33 33
								33 33 33 33 33
								33 33 33 33 33
								33 33 33 33 33
								33 33 33 33 33
								33 33 33 33 33
								33 33 33 33 33
								33 33 33 33 33
								33 33 33 33 33
								33 33 33 33 33
								33 33 33 33 33
								33 11 11 11 11
								11 11 11 11 11
								11 11 11 11 11
								11 11 11 11 11
								11 11 11 11 11
								11 11 11 11 11
								11 90
			29 01 00 00 00 00 03 F0 A5 A5	/* TEST KEY Disable */
		];

		samsung,self_move_mid_big_jump_on_revA = [
			29 01 00 00 00 00 03 F0 5A 5A	/* TEST KEY Enable */
		/*	29 01 00 00 00 00 02 B0 33 */
			29 01 00 00 00 00 62 7D
								00 00 00 00 00
								00 00 33 33 33
								33 33 33 33 33
								33 33 33 33 33
								33 33 33 33 33
								33 33 33 33 33
								33 33 33 33 33
								33 33 33 33 33
								33 33 33 33 33
								33 33 33 33 33
								33 33 33 33 33
								33 33 33 33 33
								33 33 33 33 33
								33 11 11 11 11
								11 11 11 11 11
								11 11 11 11 11
								11 11 11 11 11
								11 11 11 11 11
								11 11 11 11 11
								11 90
			29 01 00 00 00 00 03 F0 A5 A5	/* TEST KEY Disable */
		];

		samsung,self_move_off_revA = [
			29 01 00 00 00 00 03 F0 5A 5A	/* TEST KEY Enable  */
			29 01 00 00 00 00 03 7D 00 03
			29 01 00 00 00 00 03 F0 A5 A5	/* TEST KEY Disable */
		];

		samsung,self_move_2c_sync_off_revA = [
			29 01 00 00 00 00 03 F0 5A 5A	/* TEST KEY Enable */
			29 01 00 00 00 00 02 7C 01
			29 01 00 00 00 00 03 F0 A5 A5	/* TEST KEY Disable */
		];

		/*
		* ************************************************************************************************************************
		* Self Display Operation (SELF MASK)
		* ************************************************************************************************************************
		*/

		samsung,self_mask_mem_setting_revA = [
			29 01 00 00 00 00 02 7A 00		/* SM_MASK_EN(0)   */
			29 01 00 00 00 00 02 75 10		/* MA_SEL(1), IC_SEL, VI_SEL, DC_SEL, AC_SEL */
			/* image data (4C,5C) ... */
		];

		samsung,self_mask_on_revA = [
			29 01 00 00 00 00 03 F0 5A 5A	/* TEST KEY Enable */
			29 01 00 00 00 00 10 7A
								01 00 00 00 3B
								08 70 08 AB 08
								10 00 00 00 00
			29 01 00 00 00 00 03 F0 A5 A5	/* TEST KEY Disable */
		];

		samsung,self_mask_off_revA = [
			29 01 00 00 00 00 03 F0 5A 5A	/* TEST KEY Enable  */
			29 01 00 00 00 00 02 7A 00		/* SM_MASK_EN(0)	*/
			29 01 00 00 00 00 03 F0 A5 A5	/* TEST KEY Disable */
		];

		/*
		* ************************************************************************************************************************
		* Self Display Operation (SELF ICON)
		* ************************************************************************************************************************
		*/

		samsung,self_icon_mem_setting_revA = [
			29 01 00 00 00 00 03 7C 00 00
			29 01 00 00 00 00 02 75 08		/* MA_SEL, IC_SEL(1), VI_SEL, DC_SEL, AC_SEL */
			/* image data (4C,5C) ... */
		];

		samsung,self_icon_on_grid_on_revA = [
			29 01 00 00 00 00 03 F0 5A 5A	/* TEST KEY Enable */
			29 01 00 00 00 00 16 7C
								00 11 02 00 02
								00 01 00 01 00
								70 11 00 00 00
								00 04 38 08 AC
								1E
			29 01 00 00 00 00 03 F0 A5 A5	/* TEST KEY Disable */
		];

		samsung,self_icon_on_grid_off_revA = [
			29 01 00 00 00 00 03 F0 5A 5A	/* TEST KEY Enable */
			29 01 00 00 00 00 0B 7C
								00 01 02 00 02
								00 01 00 01 00
			29 01 00 00 00 00 03 F0 A5 A5	/* TEST KEY Disable */
		];

		samsung,self_icon_off_grid_on_revA = [
			29 01 00 00 00 00 03 F0 5A 5A	/* TEST KEY Enable */
			29 01 00 00 00 00 16 7C
								00 10 00 00 00
								00 00 00 00 00
								70 11 00 00 00
								00 04 38 08 AC
								1E
			29 01 00 00 00 00 03 F0 A5 A5	/* TEST KEY Disable */
		];

		samsung,self_icon_off_grid_off_revA = [
			29 01 00 00 00 00 03 F0 5A 5A	/* TEST KEY Enable */
			29 01 00 00 00 00 03 7C
								00 00
			29 01 00 00 00 00 03 F0 A5 A5	/* TEST KEY Disable */
		];

		samsung,self_brightness_icon_on_revA = [
			29 01 00 00 00 00 03 F0 5A 5A	/* TEST KEY Enable */
			29 01 00 00 00 00 16 7C
								00 11 02 00 02
								00 01 00 01 00
								70 1F 00 00 00
								00 04 38 08 AC
								1E
			29 01 00 00 00 00 03 F0 A5 A5	/* TEST KEY Disable */
		];

		samsung,self_brightness_icon_off_revA = [
			29 01 00 00 00 00 03 F0 5A 5A	/* TEST KEY Enable */
			29 01 00 00 00 00 16 7C
								00 10 00 00 00
								00 00 00 00 00
								70 1F 00 00 00
								00 04 38 08 AC
								1E
			29 01 00 00 00 00 03 F0 A5 A5	/* TEST KEY Disable */
		];

		samsung,self_icon_grid_2c_sync_off_revA = [
			29 01 00 00 00 00 03 F0 5A 5A	/* TEST KEY Enable */
			29 01 00 00 00 00 02 7C 03
			29 01 00 00 00 00 03 F0 A5 A5	/* TEST KEY Disable */
		];

		/*
		* ************************************************************************************************************************
		* Self Display Operation (SELF ALALOG CLOCK)
		* ************************************************************************************************************************
		*/

		samsung,self_aclock_sidemem_setting_revA = [
			29 01 00 00 00 00 03 7C 00 00
			29 01 00 00 00 00 02 75 01
			/* image data (4C,5C) ... */
		];

		samsung,self_aclock_on_revA = [
			29 01 00 00 00 00 03 F0 5A 5A	/* TEST KEY Enable */
			29 01 00 00 00 00 16 77
								00 07 00 0A 0A
								1D 00 03 01 02
								00 02 00 00 00
								B4 13 B4 13 B4
								13
			29 01 00 00 00 00 03 F0 A5 A5	/* TEST KEY Disable */
		];

		samsung,self_aclock_time_update_revA = [
			29 01 00 00 00 00 03 F0 5A 5A	/* TEST KEY Enable */
			29 01 00 00 00 00 08 77
								00 07 00 05 03
								20 00
			29 01 00 00 00 00 02 78 01		/* SC_TIME_UPDATE */
			29 01 00 00 00 00 03 F0 A5 A5	/* TEST KEY Disable */
		];

		samsung,self_aclock_rotation_revA = [
			29 01 00 00 00 00 03 F0 5A 5A	/* TEST KEY Enable */
			29 01 00 00 00 00 0F 77
								00 07 00 00 00
								00 00 03 01 02
								00 02 00 D1
			29 01 00 00 00 00 03 F0 A5 A5	/* TEST KEY Disable */
		];

		samsung,self_aclock_off_revA = [
			29 01 00 00 00 00 03 F0 5A 5A	/* TEST KEY Enable */
			29 01 00 00 00 00 03 77 00 00
			29 01 00 00 00 00 03 F0 A5 A5	/* TEST KEY Disable */
		];

		samsung,self_clock_2c_sync_off_revA = [
			29 01 00 00 00 00 03 F0 5A 5A	/* TEST KEY Enable */
			29 01 00 00 00 00 02 77 01
			29 01 00 00 00 00 03 F0 A5 A5	/* TEST KEY Disable */
		];

		/*
		* ************************************************************************************************************************
		* Self Display Operation (SELF DIGITAL CLOCK)
		* ************************************************************************************************************************
		*/

		samsung,self_dclock_sidemem_setting_revA = [
			29 01 00 00 00 00 03 77 00 00
			29 01 00 00 00 00 02 75 02
			/* image data (4C,5C) ... */
		];

		samsung,self_dclock_on_revA = [
			29 01 00 00 00 00 03 F0 5A 5A	/* TEST KEY Enable */
			29 01 00 00 00 00 2A 77
								00 36 05 0A 03
								00 00 03 00 00
								00 00 00 00 00
								00 00 00 00 00
								00 01 2C 01 90
								01 F4 01 90 01
								2C 02 F4 02 F4
								01 F4 00 C8 01
								64
			29 01 00 00 00 00 03 F0 A5 A5	/* TEST KEY Disable */
		];

		samsung,self_dclock_dlinking_on_revA = [
			29 01 00 00 00 00 03 F0 5A 5A	/* TEST KEY Enable */
			29 01 00 00 00 00 1B 79
								00 C0 00 00 00
								00 57 01 0A 0A
								00 FF 00 00 FF
								00 02 08 06 72
								02 08 06 D6 1D
								1D
			29 01 00 00 00 00 03 F0 A5 A5	/* TEST KEY Disable */
		];

		samsung,self_dclock_time_update_revA = [
			29 01 00 00 00 00 03 F0 5A 5A	/* TEST KEY Enable */
			29 01 00 00 00 00 08 77
								00 36 05 03 1A
								20 00
			29 01 00 00 00 00 02 78 01		/* SC_TIME_UPDATE */
			29 01 00 00 00 00 03 F0 A5 A5	/* TEST KEY Disable */
		];

		samsung,self_dclock_off_revA = [
			29 01 00 00 00 00 03 F0 5A 5A	/* TEST KEY Enable */
			29 01 00 00 00 00 03 77 00 00
			29 01 00 00 00 00 03 F0 A5 A5	/* TEST KEY Disable */
		];

		samsung,self_dclock_dlinking_off_revA = [
			29 01 00 00 00 00 03 F0 5A 5A	/* TEST KEY Enable */
			29 01 00 00 00 00 03 79
								00 00
			29 01 00 00 00 00 03 F0 A5 A5	/* TEST KEY Disable */
		];

		/*
		* ************************************************************************************************************************
		* Self Display Operation (DEBUGGING FEATURE)
		* ************************************************************************************************************************
		*/

		samsung,self_display_debug_rx_cmds_revA = [ 06 01 00 00 00 00 01 7F 12 00];	/* read 7F 1st ~ 18th */

		samsung,ldi_error_rx_cmds_revA	= [06 01 00 00 00 00 01 EA 02 00];

		/*
		* ************************************************************************************************************************
		* Multi. Resolution
		* ************************************************************************************************************************
		*/

		samsung,panel_multires_fhd_revA = [

			/* OMOK Disable */
			29 00 00 00 00 00 03 FC 5A 5A  /* TEST KEY Enable */
			29 00 00 00 00 00 02 BA 01
			29 00 00 00 00 00 05 2A 00 00 04 37
			29 00 00 00 00 00 05 2B 00 00 07 7F
			29 01 00 00 00 00 03 FC A5 A5  /* TEST KEY Disable */
		];

		samsung,panel_multires_hd_revA = [

			/* OMOK Enable */
			29 00 00 00 00 00 03 FC 5A 5A		/* TEST KEY Enable */
			29 00 00 00 00 00 02 BA 00
			29 00 00 00 00 00 05 2A 00 00 02 CF
			29 00 00 00 00 00 05 2B 00 00 04 FF
			29 01 00 00 00 00 03 FC A5 A5		/* TEST KEY Disable */
		];

		/*
		* ************************************************************************************************************************
		* MULTI_RESOLUTION (DSC configs were moved all to below timing set)
		* (C10P does not support MULTI_RESOLUTION, only FHD.)
		* ************************************************************************************************************************
		*/

		qcom,mdss-dsi-display-timings {
			fhd {
				qcom,mdss-dsi-timing-default;

				qcom,mdss-dsi-panel-width = <1080>;
				qcom,mdss-dsi-panel-height = <2220>;
				qcom,mdss-dsi-t-clk-pre = <0x35>; /*53*/
				qcom,mdss-dsi-t-clk-post = <0x0E>; /*14*/
				qcom,mdss-dsi-panel-framerate = <60>;
				qcom,mdss-dsi-panel-clockrate = <999900000>; /*999.9*/
				qcom,mdss-dsi-panel-timings-phy-v2 = [
					25 1f 09 0A 06 03 04 a0
					25 1f 09 0A 06 03 04 a0
					25 1f 09 0A 06 03 04 a0
					25 1f 09 0A 06 03 04 a0
					25 1f 08 0A 06 03 04 a0
				];

				qcom,mdss-dsi-h-pulse-width = <24>;
				qcom,mdss-dsi-h-back-porch = <36>;
				qcom,mdss-dsi-h-front-porch = <100>;
				qcom,mdss-dsi-h-sync-skew = <0>;
				qcom,mdss-dsi-v-pulse-width = <2>;
				qcom,mdss-dsi-v-back-porch = <2>;
				qcom,mdss-dsi-v-front-porch = <16>;

				/*qcom,mdss-dsi-timing-switch-command; use samsung,panel_multires_XXX instead*/
				/*qcom,mdss-dsi-timing-switch-command-state;*/

				qcom,mdss-dsi-on-command= [
					05 01 00 00 14 00 02 11 00			/* Sleep out, wait 20ms(0x14) */

					/*Common Setting*/
					/* TE Vsync On */
					29 01 00 00 00 00 02 35 00

					/* PCD Setting */
					29 01 00 00 00 00 03 F0 5A 5A		/* TEST KEY Enable */
					29 01 00 00 00 00 02 CC 4C
					29 01 00 00 00 00 03 F0 A5 A5

					/* ERR_FG Setting */
					29 01 00 00 00 00 03 F0 5A 5A		/* TEST KEY Enable */
					29 01 00 00 00 00 02 ED 44
					29 01 00 00 00 00 03 F0 A5 A5

					/* TSP SYNC Setting */
					29 01 00 00 00 00 03 F0 5A 5A		/* TEST KEY Enable */
					29 01 00 00 00 00 10 B9 00 00 14 00 18 00 00 00 00 11 01 02 40 02 40
					29 01 00 00 00 00 03 F0 A5 A5

					/* FFC SYNC Setting */
					29 01 00 00 00 00 03 F0 5A 5A		/* TEST KEY Enable */
					29 01 00 00 00 00 09 C5 09 10 C8 21 3C 11 3A 3E
					29 01 00 00 00 00 03 F0 A5 A5

					/* POC On Setting */
/*					29 01 00 00 00 00 03 F0 5A 5A*/
/*					29 00 00 00 00 00 05 EB FF 52 00 FF*/
/*					29 01 00 00 00 00 03 F0 A5 A5*/

					/* SAVE 5C */
					29 01 00 00 00 00 03 F0 5A 5A		/* TEST KEY Enable */
					29 01 00 00 00 00 02 B0 0E
					29 01 00 00 00 00 02 F2 80
					29 01 00 00 00 00 03 F0 A5 A5

					29 01 00 00 00 00 03 F0 5A 5A		/* TEST KEY Enable */
					29 01 00 00 00 00 02 F2 13			/* DDI Log Enable */
					29 01 00 00 00 00 03 F0 A5 A5

					/* Brightness condition set */
					29 01 00 00 00 00 03 F0 5A 5A		/* TEST KEY Enable */
					29 01 00 00 00 00 22 CA				/* 1) Gamma 2.2 Setting */
						07					/* VTR/V255 R[8],G[8],B[8] */
						00					/* VTG/VTB */
						00					/* V255 R[7:0] */
						00					/* V255 G[7:0] */
						00					/* nothing */
						00					/* V255 B[7:0] */
						80 80 80			/* V203 R,G,B */
						80 80 80			/* V151 R,G,B */
						80 80 80			/* V87 R,G,B */
						80 80 80			/* V51 R,G,B */
						80 80 80			/* V35 R,G,B */
						80 80 80			/* V23 R,G,B */
						80 80 80			/* V11 R,G,B */
						80 80 80			/*  V7 R,G,B */
						80 80 80			/*  V1 R,G,B */
					29 01 00 00 00 00 03 B1 00 10		/* AID set : AOR 0% */
					29 01 00 00 00 00 18 B5 19 DC 0A
											01 34 67 9A CD 01 22 33
											44 C0 00 09 99 33 13 01
											11 10 00 00
					29 01 00 00 00 00 02 F7 03			/* Gamma, LTPS(AID) update */
					29 01 00 00 50 00 03 F0 A5 A5		/* TEST KEY Disable */

					/* Memory Access */
					05 01 00 00 00 00 02 2C 00
					05 01 00 00 00 00 02 3C 00
				];

				qcom,mdss-dsi-on-command-state = "dsi_lp_mode";
			};
		};
	};
};
