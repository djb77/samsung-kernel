/* Copyright (c) 2013-2014, The Linux Foundation. All rights reserved.
 *
 * This program is free software; you can redistribute it and/or modify
 * it under the terms of the GNU General Public License version 2 and
 * only version 2 as published by the Free Software Foundation.
 *
 * This program is distributed in the hope that it will be useful,
 * but WITHOUT ANY WARRANTY; without even the implied warranty of
 * MERCHANTABILITY or FITNESS FOR A PARTICULAR PURPOSE.  See the
 * GNU General Public License for more details.
 */

/*---------------------------------------------------------------------------
 * This file is autogenerated file using gcdb parser. Please do not edit it.
 * Update input XML file to add a new entry or update variable in this file
 * VERSION = "1.0"
 *---------------------------------------------------------------------------*/
&mdss_mdp {
	dsi_samsung_fhd: ss_dsi_panel_S6E3FA3_AMS598KH01_FHD {
		qcom,mdss-dsi-panel-name = "ss_dsi_panel_S6E3FA3_AMS598KH01_FHD";
		qcom,mdss-dsi-panel-controller = <&mdss_dsi0>;
		qcom,mdss-dsi-panel-width = <1080>;
		qcom,mdss-dsi-panel-height = <1920>;
		qcom,mdss-dsi-bpp = <24>;
		qcom,mdss-dsi-panel-destination = "display_1";

		qcom,mdss-dsi-panel-timings = [E6 38 26 00 68 6E 2A 46 2C 03 04 00];
		qcom,mdss-dsi-panel-timings-phy-v2 = [
			24 1F 08 09 05 03 04 a0
			24 1F 08 09 05 03 04 a0
			24 1F 08 09 05 03 04 a0
			24 1F 08 09 05 03 04 a0
			24 1B 08 09 05 03 04 a0];

		qcom,mdss-dsi-on-command= [
			05 01 00 00 78 00 02 11 00			/* Sleep out, wait 20ms(0x14) */

			/* TE Vsync On */
			29 01 00 00 00 00 02 35 00

			/* AVC setting */
			29 01 00 00 00 00 03 FC 5A 5A		/* TEST KEY Enable */
			29 01 00 00 00 00 02 B0 1E
			29 01 00 00 00 00 02 FD 94
			29 01 00 00 00 00 03 FC A5 A5

			/* PCD Setting */
			29 01 00 00 00 00 03 FC 5A 5A		/* TEST KEY Enable */
			29 01 00 00 00 00 02 CC 4C
			29 01 00 00 00 00 03 FC A5 A5

			/* ERR_FG Setting */
			29 01 00 00 00 00 03 FC 5A 5A		/* TEST KEY Enable */
			29 01 00 00 00 00 02 ED 44
			29 01 00 00 00 00 03 FC A5 A5

			/* Brightness condition set */
			29 01 00 00 00 00 03 F0 5A 5A		/* TEST KEY Enable */
			29 01 00 00 00 00 24 CA				/* 1) Gamma 2.2 Setting */
				01 00 01 00 01 00	/* V255 R,G,B */
				80 80 80			/* V203 R,G,B */
				80 80 80			/* V151 R,G,B */
				80 80 80			/* V87 R,G,B */
				80 80 80			/* V51 R,G,B */
				80 80 80			/* V35 R,G,B */
				80 80 80			/* V23 R,G,B */
				80 80 80			/* V11 R,G,B */
				80 80 80			/*  V3 R,G,B */
				00 00 00			/*  V0 R,G,B */
				00 00				/*  VT R,G,B */
			29 01 00 00 00 00 03 B2 00 10		/* AID set : AOR 0% */
			29 01 00 00 00 00 03 B6 BC 0A		/* CAPS ELVSS Set(ACL ON : 0x8C) */
			29 01 00 00 00 00 02 F7 03			/* Gamma, LTPS(AID) update */
			29 01 00 00 50 00 03 F0 A5 A5		/* TEST KEY Disable */

			/* Memory Access */
			05 01 00 00 00 00 02 2C 00
			05 01 00 00 00 00 02 3C 00
		];

		qcom,mdss-dsi-off-command=[
			05 01 00 00 0A 00 02 28 00	/* wait 10ms(0x0A) */
			05 01 00 00 96 00 02 10 00	/* wait 150ms(0x96) */
		];

		qcom,cont-splash-enabled;
		qcom,mdss-dsi-force-clk-lane-hs;
		/*qcom,cmd-sync-wait-broadcast;*/
		/*qcom,cmd-sync-wait-trigger;*/
		/*qcom,mdss-dsi-fbc-enable=*/
		/*qcom,mdss-dsi-fbc-bpp=*/
		/*qcom,mdss-dsi-fbc-packing=*/
		/*qcom,mdss-dsi-fbc-quant-error=*/
		/*qcom,mdss-dsi-fbc-bias=*/
		/*qcom,mdss-dsi-fbc-pat-mode=*/
		/*qcom,mdss-dsi-fbc-vlc-mode=*/
		/*qcom,mdss-dsi-fbc-bflc-mode=*/
		/*qcom,mdss-dsi-fbc-h-line-budget=*/
		/*qcom,mdss-dsi-fbc-budget-ctrl=*/
		/*qcom,mdss-dsi-fbc-block-budget=*/
		/*qcom,mdss-dsi-fbc-lossless-threshold=*/
		/*qcom,mdss-dsi-fbc-lossy-threshold=*/
		/*qcom,mdss-dsi-fbc-rgb-threshold=*/
		/*qcom,mdss-dsi-fbc-lossy-mode-idx=*/

		qcom,mdss-dsi-h-back-porch = <36>;
		qcom,mdss-dsi-h-front-porch = <160>;
		qcom,mdss-dsi-h-pulse-width = <12>;
		qcom,mdss-dsi-h-sync-skew = <0>;
		qcom,mdss-dsi-v-back-porch = <7>;
		qcom,mdss-dsi-v-front-porch = <7>;
		qcom,mdss-dsi-v-pulse-width = <2>;

		qcom,mdss-dsi-h-left-border = <0>;
		qcom,mdss-dsi-h-right-border = <0>;
		qcom,mdss-dsi-v-top-border = <0>;
		qcom,mdss-dsi-v-bottom-border = <0>;

		qcom,mdss-dsi-underflow-color = <0xFF>;
		qcom,mdss-dsi-border-color = <0>;

		/*qcom,mdss-dsi-pan-enable-dynamic-fps=*/
		/*qcom,mdss-dsi-pan-fps-update=*/

		qcom,mdss-dsi-bl-pmic-control-type = "bl_ctrl_dcs";
		/*qcom,mdss-dsi-bl-pmic-bank-select=*/
		/*qcom,mdss-dsi-bl-pmic-pwm-frequency=*/
		/*qcom,mdss-dsi-pwm-gpio=*/

		qcom,mdss-dsi-bl-min-level = <0>;
		qcom,mdss-dsi-bl-max-level = <255>;
		qcom,mdss-brightness-max-level = <255>;
		qcom,mdss-dsi-interleave-mode = <0>;
		qcom,mdss-dsi-panel-type = "dsi_cmd_mode";

		qcom,mdss-dsi-te-check-enable;
		qcom,mdss-dsi-te-using-te-pin;
		qcom,mdss-dsi-te-pin-select = <1>;

		qcom,mdss-dsi-te-dcs-command = <1>;
		qcom,mdss-dsi-wr-mem-start = <0x2C>;
		qcom,mdss-dsi-wr-mem-continue = <0x3C>;

		/* CMD mode panel doesn't need below stuff */
		qcom,mdss-dsi-h-sync-pulse= <0>;
		/*qcom,mdss-dsi-hfp-power-mode=*/
		/*qcom,mdss-dsi-hbp-power-mode=*/
		/*qcom,mdss-dsi-hsa-power-mode=*/
		/*qcom,mdss-dsi-last-line-interleave=*/
		qcom,mdss-dsi-bllp-eof-power-mode;
		qcom,mdss-dsi-bllp-power-mode;
		qcom,mdss-dsi-traffic-mode= "burst_mode";

		qcom,mdss-dsi-pixel-packing = "loose";

		qcom,mdss-dsi-virtual-channel-id = <0>;
		qcom,mdss-dsi-color-order = "rgb_swap_rgb";
		qcom,mdss-dsi-lane-0-state;
		qcom,mdss-dsi-lane-1-state;
		qcom,mdss-dsi-lane-2-state;
		qcom,mdss-dsi-lane-3-state;
		qcom,mdss-dsi-lane-map = "lane_map_0123";

		qcom,mdss-dsi-t-clk-pre = <0x30>;
		qcom,mdss-dsi-t-clk-post = <0x0D>;

		qcom,mdss-dsi-stream = <0>;
		qcom,mdss-dsi-mdp-trigger = "none";
		qcom,mdss-dsi-dma-trigger = "trigger_sw";
		qcom,mdss-dsi-panel-framerate = <60>;
		qcom,mdss-dsi-panel-clockrate = <850000000>;
		qcom,mdss-dsi-on-command-state = "dsi_lp_mode";
		qcom,mdss-dsi-off-command-state = "dsi_hs_mode";

		qcom,mdss-pan-physical-width-dimension = <69>;
		qcom,mdss-pan-physical-height-dimension = <122>;

		qcom,mdss-dsi-panel-mode-gpio-state = "invalid";

		qcom,mdss-dsi-reset-sequence = <1 5>, <0 5>, <1 5>;

		/* S6E3FA3(LDI) Does not support Partial Update */
		/*qcom,partial-update-enabled;*/
		/*qcom,panel-roi-alignment=<8 8 1 1 1 1>;*/
		/*qcom,mdss-dsi-horizontal-line-idle*/

		qcom,mdss-dsi-lp11-init;
		qcom,mdss-dsi-init-delay-us = <1000>;

		qcom,mdss-dsi-rx-eot-ignore;
		qcom,mdss-dsi-tx-eot-append;

		qcom,ulps-enabled;
		/*qcom,mdss-dsi-panel-status-command=*/
		/*qcom,mdss-dsi-panel-status-command-mode="dsi_lp_mode";*/
		/*qcom,esd-check-enabled;*/
		qcom,mdss-dsi-panel-status-check-mode="reg_read_irq";
		qcom,mdss-dsi-panel-status-value = <1>;
		qcom,mdss-dsi-panel-status-irq-trigger="rising";
		/*qcom,dynamic-mode-switch-enabled*/
		/*qcom,video-to-cmd-mode-switch-commands=*/
		/*qcom,cmd-to-video-mode-switch-commands=*/
/*
 * ************************************************************************************************************************************
 *
 *
 *			Below  parameters are samsung dependent thigs
 *
 *
 * ************************************************************************************************************************************
 */

		samsung,support_panel_max = <1>;
		samsung,hw-config = "single_dsi";
		samsung,support_mdnie_lite;

		/*samsung,dsi-lp11-init;*/

		samsung,display_on_tx_cmds_revA = [05 01 00 00 00 00 02 29 00];
		samsung,display_off_tx_cmds_revA = [05 01 00 00 00 00 02 28 00];

		samsung,level1_key_enable_tx_cmds_revA = [
			29 01 00 00 00 00 03 F0 5A 5A
		];
		samsung,level1_key_disable_tx_cmds_revA = [
			29 01 00 00 00 00 03 F0 A5 A5
		];
		samsung,level2_key_enable_tx_cmds_revA = [
			29 00 00 00 00 00 03 F0 5A 5A
			29 01 00 00 00 00 03 FC 5A 5A
		];
		samsung,level2_key_disable_tx_cmds_revA = [
			29 00 00 00 00 00 03 F0 A5 A5
			29 01 00 00 00 00 03 FC A5 A5
		];

		samsung,packet_size_tx_cmds_revA = [
			37 01 00 00 00 00 02 07 00
		];

		/*
		 * First parameters can be changed
		 * by function of samsung_nv_read()
		 * because of that means offset of
		 * read position
		 */
		samsung,reg_read_pos_tx_cmds_revA = [
			15 01 00 00 00 00 02 B0 00
		];


		/*
		 * ************************************************************************************************************************
		 *	 06 01 00 00 00 00 01 c8 07 21
		 *	READ 0xC8 SIZE 0x07 OFFSET 0x21
		 * ************************************************************************************************************************
		 */
		samsung,smart_dimming_mtp_rx_cmds_revA = [ 06 01 00 00 00 00 01 c8 23 00];
		/* the last byte in all read commands will represent READ LENGH */
		samsung,manufacture_id0_rx_cmds_revA = [ 06 01 00 00 00 00 01 da 01 00];
		samsung,manufacture_id1_rx_cmds_revA = [ 06 01 00 00 00 00 01 db 01 00];
		samsung,manufacture_id2_rx_cmds_revA = [ 06 01 00 00 00 00 01 dc 01 00];

		samsung,manufacture_date_rx_cmds_revA = [ 06 01 00 00 00 00 01 c8 02 28];	/* read C8 41~42th , 40=0x28*/
		samsung,ddi_id_rx_cmds_revA = [ 06 01 00 00 00 00 01 d6 05 00];	/* read D6 1~5th */
		samsung,cell_id_rx_cmds_revA = [ 06 01 00 00 00 00 01 C8 0B 28];	/* read C8 41~51th, 40=0x28 */
		samsung,mtp_read_sysfs_rx_cmds_revA = [ 06 01 00 00 00 00 01 01 01 01];

		samsung,elvss_rx_cmds_revA = [ 06 01 00 00 00 00 01 b6 02 15];	/* read B6 22th~23 , 21=0x15*/
		samsung,mdnie_read_rx_cmds_revA	= [ 06 01 00 00 00 00 01 A1 04 00];

		samsung,ldi_debug0_rx_cmds_revA = [06 01 00 00 00 00 01 0A 01 00];
		samsung,ldi_debug1_rx_cmds_revA = [06 01 00 00 00 00 01 0E 01 00];
		samsung,ldi_debug2_rx_cmds_revA = [06 01 00 00 00 00 01 EA 08 00];
		samsung,hbm_rx_cmds_revA = [ 06 01 00 00 00 00 01 B4 04 00];	/* read B4 1th~4th */
		samsung,hbm2_rx_cmds_revA = [ 06 01 00 00 00 00 01 B4 1D 04];	/* read B4 5th~33th */

		/*
		 * ************************************************************************************************************************
		 *	 COMMON CMD LIST
		 * ************************************************************************************************************************
		 */

		samsung,elvss_lowtemp_tx_cmds_revA = [
			29 01 00 00 00 00 02 B8 19
		];	/* Low Temperature Command */

		samsung,elvss_lowtemp2_tx_cmds_revA = [
			29 01 00 00 00 00 02 B0 15
			29 01 00 00 00 00 02 B6 00
		];	/* Low Temperature Command: default */

		samsung,gamma_tx_cmds_revA = [
			29 01 00 00 00 00 24 CA				/* 1) Gamma 2.2 Setting */
				01 00 01 00 01 00	/* V255 R,G,B */
				80 80 80			/* V203 R,G,B */
				80 80 80			/* V151 R,G,B */
				80 80 80			/* V87 R,G,B */
				80 80 80			/* V51 R,G,B */
				80 80 80			/* V35 R,G,B */
				80 80 80			/* V23 R,G,B */
				80 80 80			/* V11 R,G,B */
				80 80 80			/*  V3 R,G,B */
				00 00 00			/*  V0 R,G,B */
				00 00				/*  VT R,G,B */
			29 01 00 00 00 00 02 F7 03	/* Gamma, LTPS(AID) update */

			29 01 00 00 00 00 3C		/* dummy for single transmission more 100ns delay */
			00 00 00 00 00 00 00 00 00 00
			00 00 00 00 00 00 00 00 00 00
			00 00 00 00 00 00 00 00 00 00
			00 00 00 00 00 00 00 00 00 00
			00 00 00 00 00 00 00 00 00 00
			00 00 00 00 00 00 00 00 00 00
		];

		samsung,hbm_gamma_tx_cmds_revA = [
			29 01 00 00 00 00 24 CA		/* 1) Gamma 2.2 Setting */
				01 00 01 00 01 00	/* V255 R,G,B */
				80 80 80			/* V203 R,G,B */
				80 80 80			/* V151 R,G,B */
				80 80 80			/* V87 R,G,B */
				80 80 80			/* V51 R,G,B */
				80 80 80			/* V35 R,G,B */
				80 80 80			/* V23 R,G,B */
				80 80 80			/* V11 R,G,B */
				80 80 80			/*  V3 R,G,B */
				00 00 00			/*  V0 R,G,B */
				00 00				/*  VT R,G,B */
			29 01 00 00 00 00 03 B2 00 10		/* AID set : AOR 0% */
			29 01 00 00 00 00 02 F7 03			/* Gamma, LTPS(AID) update */
		];

		samsung,hbm_etc_tx_cmds_revA = [		/* for HBM interpolation: 465~578nit */
			29 01 00 00 00 00 03 B6 BC 04		/* HBM ELVSS */
			29 01 00 00 00 00 02 B0 15
			29 01 00 00 00 00 02 B6 00
			29 01 00 00 00 00 02 B5 50		/* ACL OPR 32 Frame Average */
			29 01 00 00 00 00 02 53 00		/* HBM Off */
			29 01 00 00 00 00 02 55 02		/* ACL ON */
		];

		samsung,hbm_etc2_tx_cmds_revA = [	/* for HBM pure mode : 600nit */
			29 01 00 00 00 00 03 B6 BC 04		/* HBM ELVSS */
			29 01 00 00 00 00 02 B5 50		/* ACL OPR 32 Frame Average */
			29 01 00 00 00 00 02 53 C0		/* HBM On : elvss acl auto */
		];

		samsung,hbm_off_tx_cmds_revA = [
			29 01 00 00 00 00 02 53 00		/* HBM Off */
		];


		/*
		 * ************************************************************************************************************************
		 * AID command list and mappings
		 * ************************************************************************************************************************
		 */
		/* bl_level, Index in acl command list */
		samsung,aid_tx_cmds_revA = [
			/*	0	*/29 01 00 00 00 00 03 B2 70 73	/*   2CD */
			/*	1	*/29 01 00 00 00 00 03 B2 70 65 /*   3CD */
			/*	2	*/29 01 00 00 00 00 03 B2 70 55 /*   4CD */
			/*	3	*/29 01 00 00 00 00 03 B2 70 46 /*   5CD */
			/*	4	*/29 01 00 00 00 00 03 B2 70 37 /*   6CD */
			/*	5	*/29 01 00 00 00 00 03 B2 70 27 /*   7CD */
			/*	6	*/29 01 00 00 00 00 03 B2 70 17 /*   8CD */
			/*	7	*/29 01 00 00 00 00 03 B2 70 07 /*   9CD */
			/*	8	*/29 01 00 00 00 00 03 B2 60 F7 /*  10CD */
			/*	9	*/29 01 00 00 00 00 03 B2 60 E7 /*  11CD */
			/*	10	*/29 01 00 00 00 00 03 B2 60 D7 /*  12CD */
			/*	11	*/29 01 00 00 00 00 03 B2 60 D1 /*  13CD */
			/*	12	*/29 01 00 00 00 00 03 B2 60 B7 /*  14CD */
			/*	13	*/29 01 00 00 00 00 03 B2 60 B1 /*  15CD */
			/*	14	*/29 01 00 00 00 00 03 B2 60 A1 /*  16CD */
			/*	15	*/29 01 00 00 00 00 03 B2 60 91 /*  17CD */
			/*	16	*/29 01 00 00 00 00 03 B2 60 71 /*  19CD */
			/*	17	*/29 01 00 00 00 00 03 B2 60 61 /*  20CD */
			/*	18	*/29 01 00 00 00 00 03 B2 60 51 /*  21CD */
			/*	19	*/29 01 00 00 00 00 03 B2 60 42 /*  22CD */
			/*	20	*/29 01 00 00 00 00 03 B2 60 22 /*  24CD */
			/*	21	*/29 01 00 00 00 00 03 B2 60 12 /*  25CD */
			/*	22	*/29 01 00 00 00 00 03 B2 50 F3 /*  27CD */
			/*	23	*/29 01 00 00 00 00 03 B2 50 D3 /*  29CD */
			/*	24	*/29 01 00 00 00 00 03 B2 50 C3 /*  30CD */
			/*	25	*/29 01 00 00 00 00 03 B2 50 A3 /*  32CD */
			/*	26	*/29 01 00 00 00 00 03 B2 50 83 /*  34CD */
			/*	27	*/29 01 00 00 00 00 03 B2 50 53 /*  37CD */
			/*	28	*/29 01 00 00 00 00 03 B2 50 33 /*  39CD */
			/*	29	*/29 01 00 00 00 00 03 B2 50 13 /*  41CD */
			/*	30	*/29 01 00 00 00 00 03 B2 40 E2 /*  44CD */
			/*	31	*/29 01 00 00 00 00 03 B2 40 B2 /*  47CD */
			/*	32	*/29 01 00 00 00 00 03 B2 40 82 /*  50CD */
			/*	33	*/29 01 00 00 00 00 03 B2 40 51 /*  53CD */
			/*	34	*/29 01 00 00 00 00 03 B2 40 17 /*  56CD */
			/*	35	*/29 01 00 00 00 00 03 B2 30 E0 /*  60CD */
			/*	36	*/29 01 00 00 00 00 03 B2 30 95 /*  64CD */
			/*	37	*/29 01 00 00 00 00 03 B2 30 52 /*  68CD */
			/*	38	*/29 01 00 00 00 00 03 B2 30 11 /*  77CD */
			/*	39	*/29 01 00 00 00 00 03 B2 20 C4 /*  77 ~ 183CD*/
			/*	40	*/29 01 00 00 00 00 03 B2 20 67 /* 195CD */
			/*	41	*/29 01 00 00 00 00 03 B2 20 05 /* 207CD */
			/*	42	*/29 01 00 00 00 00 03 B2 10 97 /* 220CD */
			/*	43	*/29 01 00 00 00 00 03 B2 10 25 /* 234CD */
			/*	44	*/29 01 00 00 00 00 03 B2 00 C1 /* 249~365CD */
			/*	45	*/29 01 00 00 00 00 03 B2 00 AF /* 372 CD */
			/*	46	*/29 01 00 00 00 00 03 B2 00 79 /* 380 CD */
			/*	47	*/29 01 00 00 00 00 03 B2 00 6D /* 387 CD */
			/*	48	*/29 01 00 00 00 00 03 B2 00 43 /* 395 CD */
			/*	49	*/29 01 00 00 00 00 03 B2 00 33 /* 403 CD */
			/*	50	*/29 01 00 00 00 00 03 B2 00 21 /* 412 CD */
			/*	51	*/29 01 00 00 00 00 03 B2 00 10 /* 420 CD */
		];


		/* bl_level, Index in acl command list */
		samsung,aid_map_table_revA = <
			2	0		3	1		4	2		5	3		6	4
			7	5		8	6		9	7		10	8		11	9
			12	10		13	11		14	12		15	13		16	14
			17	15		19	16		20	17		21	18		22	19
			24	20		25	21		27	22		29	23		30	24
			32	25		34	26		37	27		39	28		41	29
			44	30		47	31		50	32		53	33		56	34
			60	35		64	36		68	37		72	38		77	39
			82	39		87	39		93	39		98	39		105	39
			111	39		119	39		126	39		134	39		143	39
			152	39		162	39		172	39		183	39		195	40
			207	41		220	42		234	43		249	44		265	44
			282	44		300	44		316	44		333	44		350	44
			357	44		365	44		372	45		380	46		387	47
			395	48		403	49		412	50		420	51
		>;

		samsung,aid_subdivision_tx_cmds_revA = [
			/*	0	*/	29	01	00	00	00	00	03	B2	70	73	/*	2	*/
			/*	1	*/	29	01	00	00	00	00	03	B2	70	65	/*	3	*/
			/*	2	*/	29	01	00	00	00	00	03	B2	70	5D	/*	3.5	*/
			/*	3	*/	29	01	00	00	00	00	03	B2	70	55	/*	4	*/
			/*	4	*/	29	01	00	00	00	00	03	B2	70	46	/*	5	*/
			/*	5	*/	29	01	00	00	00	00	03	B2	70	37	/*	6	*/
			/*	6	*/	29	01	00	00	00	00	03	B2	70	27	/*	7	*/
			/*	7	*/	29	01	00	00	00	00	03	B2	70	17	/*	8	*/
			/*	8	*/	29	01	00	00	00	00	03	B2	70	07	/*	9	*/
			/*	9	*/	29	01	00	00	00	00	03	B2	60	F7	/*	10	*/
			/*	10	*/	29	01	00	00	00	00	03	B2	60	E7	/*	11	*/
			/*	11	*/	29	01	00	00	00	00	03	B2	60	D7	/*	12	*/
			/*	12	*/	29	01	00	00	00	00	03	B2	60	D1	/*	13	*/
			/*	13	*/	29	01	00	00	00	00	03	B2	60	B7	/*	14	*/
			/*	14	*/	29	01	00	00	00	00	03	B2	60	B1	/*	15	*/
			/*	15	*/	29	01	00	00	00	00	03	B2	60	A1	/*	16	*/
			/*	16	*/	29	01	00	00	00	00	03	B2	60	91	/*	17	*/
			/*	17	*/	29	01	00	00	00	00	03	B2	60	81	/*	18	*/
			/*	18	*/	29	01	00	00	00	00	03	B2	60	71	/*	19	*/
			/*	19	*/	29	01	00	00	00	00	03	B2	60	61	/*	20	*/
			/*	20	*/	29	01	00	00	00	00	03	B2	60	51	/*	21	*/
			/*	21	*/	29	01	00	00	00	00	03	B2	60	42	/*	22	*/
			/*	22	*/	29	01	00	00	00	00	03	B2	60	22	/*	24	*/
			/*	23	*/	29	01	00	00	00	00	03	B2	60	12	/*	25	*/
			/*	24	*/	29	01	00	00	00	00	03	B2	60	03	/*	26	*/
			/*	25	*/	29	01	00	00	00	00	03	B2	50	F3	/*	27	*/
			/*	26	*/	29	01	00	00	00	00	03	B2	50	D3	/*	29	*/
			/*	27	*/	29	01	00	00	00	00	03	B2	50	C3	/*	30	*/
			/*	28	*/	29	01	00	00	00	00	03	B2	50	B3	/*	31	*/
			/*	29	*/	29	01	00	00	00	00	03	B2	50	A3	/*	32	*/
			/*	30	*/	29	01	00	00	00	00	03	B2	50	93	/*	33	*/
			/*	31	*/	29	01	00	00	00	00	03	B2	50	83	/*	34	*/
			/*	32	*/	29	01	00	00	00	00	03	B2	50	6B	/*	35.5	*/
			/*	33	*/	29	01	00	00	00	00	03	B2	50	53	/*	37	*/
			/*	34	*/	29	01	00	00	00	00	03	B2	50	33	/*	39	*/
			/*	35	*/	29	01	00	00	00	00	03	B2	50	23	/*	40	*/
			/*	36	*/	29	01	00	00	00	00	03	B2	50	13	/*	41	*/
			/*	37	*/	29	01	00	00	00	00	03	B2	40	FA	/*	42.5	*/
			/*	38	*/	29	01	00	00	00	00	03	B2	40	E2	/*	44	*/
			/*	39	*/	29	01	00	00	00	00	03	B2	40	D2	/*	45	*/
			/*	40	*/	29	01	00	00	00	00	03	B2	40	C2	/*	46	*/
			/*	41	*/	29	01	00	00	00	00	03	B2	40	B2	/*	47	*/
			/*	42	*/	29	01	00	00	00	00	03	B2	40	9A	/*	48.5	*/
			/*	43	*/	29	01	00	00	00	00	03	B2	40	82	/*	50	*/
			/*	44	*/	29	01	00	00	00	00	03	B2	40	69	/*	51.5	*/
			/*	45	*/	29	01	00	00	00	00	03	B2	40	51	/*	53	*/
			/*	46	*/	29	01	00	00	00	00	03	B2	40	34	/*	54.5	*/
			/*	47	*/	29	01	00	00	00	00	03	B2	40	17	/*	56	*/
			/*	48	*/	29	01	00	00	00	00	03	B2	40	05	/*	57.33333333	*/
			/*	49	*/	29	01	00	00	00	00	03	B2	30	F2	/*	58.66666667	*/
			/*	50	*/	29	01	00	00	00	00	03	B2	30	E0	/*	60	*/
			/*	51	*/	29	01	00	00	00	00	03	B2	30	C7	/*	61.33333333	*/
			/*	52	*/	29	01	00	00	00	00	03	B2	30	AE	/*	62.66666667	*/
			/*	53	*/	29	01	00	00	00	00	03	B2	30	95	/*	64	*/
			/*	54	*/	29	01	00	00	00	00	03	B2	30	7F	/*	65.33333333	*/
			/*	55	*/	29	01	00	00	00	00	03	B2	30	68	/*	66.66666667	*/
			/*	56	*/	29	01	00	00	00	00	03	B2	30	52	/*	68	*/
			/*	57	*/	29	01	00	00	00	00	03	B2	30	32	/*	70	*/
			/*	58	*/	29	01	00	00	00	00	03	B2	30	11	/*	72	*/
			/*	59	*/	29	01	00	00	00	00	03	B2	30	00	/*	73.25	*/
			/*	60	*/	29	01	00	00	00	00	03	B2	20	EC	/*	74.5	*/
			/*	61	*/	29	01	00	00	00	00	03	B2	20	D8	/*	75.75	*/
			/*	62	*/	29	01	00	00	00	00	03	B2	20	C4	/*	77	*/
			/*	63	*/	29	01	00	00	00	00	03	B2	20	F6	/*	78.66666667	*/
			/*	64	*/	29	01	00	00	00	00	03	B2	20	DD	/*	80.33333333	*/
			/*	65	*/	29	01	00	00	00	00	03	B2	20	C4	/*	82	*/
			/*	66	*/	29	01	00	00	00	00	03	B2	20	F9	/*	83.25	*/
			/*	67	*/	29	01	00	00	00	00	03	B2	20	E7	/*	84.5	*/
			/*	68	*/	29	01	00	00	00	00	03	B2	20	D6	/*	85.75	*/
			/*	69	*/	29	01	00	00	00	00	03	B2	20	C4	/*	87	*/
			/*	70	*/	29	01	00	00	00	00	03	B2	20	FF	/*	88.5	*/
			/*	71	*/	29	01	00	00	00	00	03	B2	20	EC	/*	90	*/
			/*	72	*/	29	01	00	00	00	00	03	B2	20	D8	/*	91.5	*/
			/*	73	*/	29	01	00	00	00	00	03	B2	20	C4	/*	93	*/
			/*	74	*/	29	01	00	00	00	00	03	B2	20	EE	/*	94.66666667	*/
			/*	75	*/	29	01	00	00	00	00	03	B2	20	D9	/*	96.33333333	*/
			/*	76	*/	29	01	00	00	00	00	03	B2	20	C4	/*	98	*/
			/*	77	*/	29	01	00	00	00	00	03	B2	30	01	/*	99.75	*/
			/*	78	*/	29	01	00	00	00	00	03	B2	20	ED	/*	101.5	*/
			/*	79	*/	29	01	00	00	00	00	03	B2	20	D8	/*	103.25	*/
			/*	80	*/	29	01	00	00	00	00	03	B2	20	C4	/*	105	*/
			/*	81	*/	29	01	00	00	00	00	03	B2	20	F6	/*	106.5	*/
			/*	82	*/	29	01	00	00	00	00	03	B2	20	E5	/*	108	*/
			/*	83	*/	29	01	00	00	00	00	03	B2	20	D5	/*	109.5	*/
			/*	84	*/	29	01	00	00	00	00	03	B2	20	C4	/*	111	*/
			/*	85	*/	29	01	00	00	00	00	03	B2	30	06	/*	112.6	*/
			/*	86	*/	29	01	00	00	00	00	03	B2	20	F6	/*	114.2	*/
			/*	87	*/	29	01	00	00	00	00	03	B2	20	E5	/*	115.8	*/
			/*	88	*/	29	01	00	00	00	00	03	B2	20	D5	/*	117.4	*/
			/*	89	*/	29	01	00	00	00	00	03	B2	20	C4	/*	119	*/
			/*	90	*/	29	01	00	00	00	00	03	B2	20	FB	/*	120.4	*/
			/*	91	*/	29	01	00	00	00	00	03	B2	20	ED	/*	121.8	*/
			/*	92	*/	29	01	00	00	00	00	03	B2	20	DF	/*	123.2	*/
			/*	93	*/	29	01	00	00	00	00	03	B2	20	D2	/*	124.6	*/
			/*	94	*/	29	01	00	00	00	00	03	B2	20	C4	/*	126	*/
			/*	95	*/	29	01	00	00	00	00	03	B2	20	FF	/*	127.6	*/
			/*	96	*/	29	01	00	00	00	00	03	B2	20	F0	/*	129.2	*/
			/*	97	*/	29	01	00	00	00	00	03	B2	20	E1	/*	130.8	*/
			/*	98	*/	29	01	00	00	00	00	03	B2	20	D3	/*	132.4	*/
			/*	99	*/	29	01	00	00	00	00	03	B2	20	C4	/*	134	*/
			/*	100	*/	29	01	00	00	00	00	03	B2	30	02	/*	135.8	*/
			/*	101	*/	29	01	00	00	00	00	03	B2	20	F2	/*	137.6	*/
			/*	102	*/	29	01	00	00	00	00	03	B2	20	E3	/*	139.4	*/
			/*	103	*/	29	01	00	00	00	00	03	B2	20	D3	/*	141.2	*/
			/*	104	*/	29	01	00	00	00	00	03	B2	20	C4	/*	143	*/
			/*	105	*/	29	01	00	00	00	00	03	B2	30	01	/*	144.5	*/
			/*	106	*/	29	01	00	00	00	00	03	B2	20	F4	/*	146	*/
			/*	107	*/	29	01	00	00	00	00	03	B2	20	E8	/*	147.5	*/
			/*	108	*/	29	01	00	00	00	00	03	B2	20	DC	/*	149	*/
			/*	109	*/	29	01	00	00	00	00	03	B2	20	D0	/*	150.5	*/
			/*	110	*/	29	01	00	00	00	00	03	B2	20	C4	/*	152	*/
			/*	111	*/	29	01	00	00	00	00	03	B2	30	03	/*	153.6666667	*/
			/*	112	*/	29	01	00	00	00	00	03	B2	20	F7	/*	155.3333333	*/
			/*	113	*/	29	01	00	00	00	00	03	B2	20	EA	/*	157	*/
			/*	114	*/	29	01	00	00	00	00	03	B2	20	DD	/*	158.6666667	*/
			/*	115	*/	29	01	00	00	00	00	03	B2	20	D1	/*	160.3333333	*/
			/*	116	*/	29	01	00	00	00	00	03	B2	20	C4	/*	162	*/
			/*	117	*/	29	01	00	00	00	00	03	B2	20	FD	/*	164	*/
			/*	118	*/	29	01	00	00	00	00	03	B2	20	EF	/*	166	*/
			/*	119	*/	29	01	00	00	00	00	03	B2	20	E1	/*	168	*/
			/*	120	*/	29	01	00	00	00	00	03	B2	20	D2	/*	170	*/
			/*	121	*/	29	01	00	00	00	00	03	B2	20	C4	/*	172	*/
			/*	122	*/	29	01	00	00	00	00	03	B2	30	03	/*	173.5714286	*/
			/*	123	*/	29	01	00	00	00	00	03	B2	20	F9	/*	175.1428571	*/
			/*	124	*/	29	01	00	00	00	00	03	B2	20	EE	/*	176.7142857	*/
			/*	125	*/	29	01	00	00	00	00	03	B2	20	E4	/*	178.2857143	*/
			/*	126	*/	29	01	00	00	00	00	03	B2	20	D9	/*	179.8571429	*/
			/*	127	*/	29	01	00	00	00	00	03	B2	20	CF	/*	181.4285714	*/
			/*	128	*/	29	01	00	00	00	00	03	B2	20	C4	/*	183	*/
			/*	129	*/	29	01	00	00	00	00	03	B2	20	B7	/*	184.7142857	*/
			/*	130	*/	29	01	00	00	00	00	03	B2	20	A9	/*	186.4285714	*/
			/*	131	*/	29	01	00	00	00	00	03	B2	20	9C	/*	188.1428571	*/
			/*	132	*/	29	01	00	00	00	00	03	B2	20	8F	/*	189.8571429	*/
			/*	133	*/	29	01	00	00	00	00	03	B2	20	82	/*	191.5714286	*/
			/*	134	*/	29	01	00	00	00	00	03	B2	20	74	/*	193.2857143	*/
			/*	135	*/	29	01	00	00	00	00	03	B2	20	67	/*	195	*/
			/*	136	*/	29	01	00	00	00	00	03	B2	20	59	/*	196.7142857	*/
			/*	137	*/	29	01	00	00	00	00	03	B2	20	4B	/*	198.4285714	*/
			/*	138	*/	29	01	00	00	00	00	03	B2	20	3D	/*	200.1428571	*/
			/*	139	*/	29	01	00	00	00	00	03	B2	20	2F	/*	201.8571429	*/
			/*	140	*/	29	01	00	00	00	00	03	B2	20	21	/*	203.5714286	*/
			/*	141	*/	29	01	00	00	00	00	03	B2	20	13	/*	205.2857143	*/
			/*	142	*/	29	01	00	00	00	00	03	B2	20	05	/*	207	*/
			/*	143	*/	29	01	00	00	00	00	03	B2	10	F5	/*	208.8571429	*/
			/*	144	*/	29	01	00	00	00	00	03	B2	10	E6	/*	210.7142857	*/
			/*	145	*/	29	01	00	00	00	00	03	B2	10	D6	/*	212.5714286	*/
			/*	146	*/	29	01	00	00	00	00	03	B2	10	C6	/*	214.4285714	*/
			/*	147	*/	29	01	00	00	00	00	03	B2	10	B7	/*	216.2857143	*/
			/*	148	*/	29	01	00	00	00	00	03	B2	10	A7	/*	218.1428571	*/
			/*	149	*/	29	01	00	00	00	00	03	B2	10	97	/*	220	*/
			/*	150	*/	29	01	00	00	00	00	03	B2	10	89	/*	221.75	*/
			/*	151	*/	29	01	00	00	00	00	03	B2	10	7A	/*	223.5	*/
			/*	152	*/	29	01	00	00	00	00	03	B2	10	6C	/*	225.25	*/
			/*	153	*/	29	01	00	00	00	00	03	B2	10	5E	/*	227	*/
			/*	154	*/	29	01	00	00	00	00	03	B2	10	50	/*	228.75	*/
			/*	155	*/	29	01	00	00	00	00	03	B2	10	42	/*	230.5	*/
			/*	156	*/	29	01	00	00	00	00	03	B2	10	33	/*	232.25	*/
			/*	157	*/	29	01	00	00	00	00	03	B2	10	25	/*	234	*/
			/*	158	*/	29	01	00	00	00	00	03	B2	10	1D	/*	235.875	*/
			/*	159	*/	29	01	00	00	00	00	03	B2	10	10	/*	237.75	*/
			/*	160	*/	29	01	00	00	00	00	03	B2	10	03	/*	239.625	*/
			/*	161	*/	29	01	00	00	00	00	03	B2	00	F6	/*	241.5	*/
			/*	162	*/	29	01	00	00	00	00	03	B2	00	E8	/*	243.375	*/
			/*	163	*/	29	01	00	00	00	00	03	B2	00	DB	/*	245.25	*/
			/*	164	*/	29	01	00	00	00	00	03	B2	00	CE	/*	247.125	*/
			/*	165	*/	29	01	00	00	00	00	03	B2	00	C1	/*	249	*/
			/*	166	*/	29	01	00	00	00	00	03	B2	10	1F	/*	250.7777778	*/
			/*	167	*/	29	01	00	00	00	00	03	B2	10	13	/*	252.5555556	*/
			/*	168	*/	29	01	00	00	00	00	03	B2	10	07	/*	254.3333333	*/
			/*	169	*/	29	01	00	00	00	00	03	B2	00	FB	/*	256.1111111	*/
			/*	170	*/	29	01	00	00	00	00	03	B2	00	F0	/*	257.8888889	*/
			/*	171	*/	29	01	00	00	00	00	03	B2	00	E4	/*	259.6666667	*/
			/*	172	*/	29	01	00	00	00	00	03	B2	00	D8	/*	261.4444444	*/
			/*	173	*/	29	01	00	00	00	00	03	B2	00	CD	/*	263.2222222	*/
			/*	174	*/	29	01	00	00	00	00	03	B2	00	C1	/*	265	*/
			/*	175	*/	29	01	00	00	00	00	03	B2	10	1E	/*	266.8888889	*/
			/*	176	*/	29	01	00	00	00	00	03	B2	10	13	/*	268.7777778	*/
			/*	177	*/	29	01	00	00	00	00	03	B2	10	07	/*	270.6666667	*/
			/*	178	*/	29	01	00	00	00	00	03	B2	00	FB	/*	272.5555556	*/
			/*	179	*/	29	01	00	00	00	00	03	B2	00	F0	/*	274.4444444	*/
			/*	180	*/	29	01	00	00	00	00	03	B2	00	E4	/*	276.3333333	*/
			/*	181	*/	29	01	00	00	00	00	03	B2	00	D8	/*	278.2222222	*/
			/*	182	*/	29	01	00	00	00	00	03	B2	00	CD	/*	280.1111111	*/
			/*	183	*/	29	01	00	00	00	00	03	B2	00	C1	/*	282	*/
			/*	184	*/	29	01	00	00	00	00	03	B2	10	1F	/*	283.8	*/
			/*	185	*/	29	01	00	00	00	00	03	B2	10	15	/*	285.6	*/
			/*	186	*/	29	01	00	00	00	00	03	B2	10	0A	/*	287.4	*/
			/*	187	*/	29	01	00	00	00	00	03	B2	10	00	/*	289.2	*/
			/*	188	*/	29	01	00	00	00	00	03	B2	00	F5	/*	291	*/
			/*	189	*/	29	01	00	00	00	00	03	B2	00	EB	/*	292.8	*/
			/*	190	*/	29	01	00	00	00	00	03	B2	00	E0	/*	294.6	*/
			/*	191	*/	29	01	00	00	00	00	03	B2	00	D6	/*	296.4	*/
			/*	192	*/	29	01	00	00	00	00	03	B2	00	CB	/*	298.2	*/
			/*	193	*/	29	01	00	00	00	00	03	B2	00	C1	/*	300	*/
			/*	194	*/	29	01	00	00	00	00	03	B2	10	0E	/*	302	*/
			/*	195	*/	29	01	00	00	00	00	03	B2	10	03	/*	304	*/
			/*	196	*/	29	01	00	00	00	00	03	B2	00	F8	/*	306	*/
			/*	197	*/	29	01	00	00	00	00	03	B2	00	ED	/*	308	*/
			/*	198	*/	29	01	00	00	00	00	03	B2	00	E2	/*	310	*/
			/*	199	*/	29	01	00	00	00	00	03	B2	00	D7	/*	312	*/
			/*	200	*/	29	01	00	00	00	00	03	B2	00	CC	/*	314	*/
			/*	201	*/	29	01	00	00	00	00	03	B2	00	C1	/*	316	*/
			/*	202	*/	29	01	00	00	00	00	03	B2	10	10	/*	317.8888889	*/
			/*	203	*/	29	01	00	00	00	00	03	B2	10	06	/*	319.7777778	*/
			/*	204	*/	29	01	00	00	00	00	03	B2	00	FC	/*	321.6666667	*/
			/*	205	*/	29	01	00	00	00	00	03	B2	00	F2	/*	323.5555556	*/
			/*	206	*/	29	01	00	00	00	00	03	B2	00	E9	/*	325.4444444	*/
			/*	207	*/	29	01	00	00	00	00	03	B2	00	DF	/*	327.3333333	*/
			/*	208	*/	29	01	00	00	00	00	03	B2	00	D5	/*	329.2222222	*/
			/*	209	*/	29	01	00	00	00	00	03	B2	00	CB	/*	331.1111111	*/
			/*	210	*/	29	01	00	00	00	00	03	B2	00	C1	/*	333	*/
			/*	211	*/	29	01	00	00	00	00	03	B2	10	0C	/*	334.8888889	*/
			/*	212	*/	29	01	00	00	00	00	03	B2	10	03	/*	336.7777778	*/
			/*	213	*/	29	01	00	00	00	00	03	B2	00	F9	/*	338.6666667	*/
			/*	214	*/	29	01	00	00	00	00	03	B2	00	F0	/*	340.5555556	*/
			/*	215	*/	29	01	00	00	00	00	03	B2	00	E7	/*	342.4444444	*/
			/*	216	*/	29	01	00	00	00	00	03	B2	00	DD	/*	344.3333333	*/
			/*	217	*/	29	01	00	00	00	00	03	B2	00	D4	/*	346.2222222	*/
			/*	218	*/	29	01	00	00	00	00	03	B2	00	CA	/*	348.1111111	*/
			/*	219	*/	29	01	00	00	00	00	03	B2	00	C1	/*	350	*/
			/*	220	*/	29	01	00	00	00	00	03	B2	00	DB	/*	351.75	*/
			/*	221	*/	29	01	00	00	00	00	03	B2	00	D2	/*	353.5	*/
			/*	222	*/	29	01	00	00	00	00	03	B2	00	CA	/*	355.25	*/
			/*	223	*/	29	01	00	00	00	00	03	B2	00	C1	/*	357	*/
			/*	224	*/	29	01	00	00	00	00	03	B2	00	DE	/*	359	*/
			/*	225	*/	29	01	00	00	00	00	03	B2	00	D4	/*	361	*/
			/*	226	*/	29	01	00	00	00	00	03	B2	00	CB	/*	363	*/
			/*	227	*/	29	01	00	00	00	00	03	B2	00	C1	/*	365	*/
			/*	228	*/	29	01	00	00	00	00	03	B2	00	C5	/*	367.3333333	*/
			/*	229	*/	29	01	00	00	00	00	03	B2	00	BA	/*	369.6666667	*/
			/*	230	*/	29	01	00	00	00	00	03	B2	00	AF	/*	372	*/
			/*	231	*/	29	01	00	00	00	00	03	B2	00	96	/*	374	*/
			/*	232	*/	29	01	00	00	00	00	03	B2	00	8C	/*	376	*/
			/*	233	*/	29	01	00	00	00	00	03	B2	00	83	/*	378	*/
			/*	234	*/	29	01	00	00	00	00	03	B2	00	79	/*	380	*/
			/*	235	*/	29	01	00	00	00	00	03	B2	00	86	/*	381.75	*/
			/*	236	*/	29	01	00	00	00	00	03	B2	00	7E	/*	383.5	*/
			/*	237	*/	29	01	00	00	00	00	03	B2	00	75	/*	385.25	*/
			/*	238	*/	29	01	00	00	00	00	03	B2	00	6D	/*	387	*/
			/*	239	*/	29	01	00	00	00	00	03	B2	00	5F	/*	389	*/
			/*	240	*/	29	01	00	00	00	00	03	B2	00	56	/*	391	*/
			/*	241	*/	29	01	00	00	00	00	03	B2	00	4C	/*	393	*/
			/*	242	*/	29	01	00	00	00	00	03	B2	00	43	/*	395	*/
			/*	243	*/	29	01	00	00	00	00	03	B2	00	4F	/*	397	*/
			/*	244	*/	29	01	00	00	00	00	03	B2	00	46	/*	399	*/
			/*	245	*/	29	01	00	00	00	00	03	B2	00	3C	/*	401	*/
			/*	246	*/	29	01	00	00	00	00	03	B2	00	33	/*	403	*/
			/*	247	*/	29	01	00	00	00	00	03	B2	00	40	/*	405.25	*/
			/*	248	*/	29	01	00	00	00	00	03	B2	00	36	/*	407.5	*/
			/*	249	*/	29	01	00	00	00	00	03	B2	00	2B	/*	409.75	*/
			/*	250	*/	29	01	00	00	00	00	03	B2	00	21	/*	412	*/
			/*	251	*/	29	01	00	00	00	00	03	B2	00	2B	/*	414	*/
			/*	252	*/	29	01	00	00	00	00	03	B2	00	22	/*	416	*/
			/*	253	*/	29	01	00	00	00	00	03	B2	00	19	/*	418	*/
			/*	254	*/	29	01	00	00	00	00	03	B2	00	10	/*	420	*/
			/*	255	*/	29	01	00	00	00	00	03	B2	00	10	/*	420	*/
		];

		samsung,aid_subdivision_tx_cmds_revB = [
			/*	0	*/	29	01	00	00	00	00	03	B2	70	73	/*	1.9	*/
			/*	1	*/	29	01	00	00	00	00	03	B2	70	65	/*	2.8	*/
			/*	2	*/	29	01	00	00	00	00	03	B2	70	5D	/*	3.3	*/
			/*	3	*/	29	01	00	00	00	00	03	B2	70	55	/*	3.8	*/
			/*	4	*/	29	01	00	00	00	00	03	B2	70	46	/*	4.7	*/
			/*	5	*/	29	01	00	00	00	00	03	B2	70	37	/*	5.7	*/
			/*	6	*/	29	01	00	00	00	00	03	B2	70	27	/*	6.7	*/
			/*	7	*/	29	01	00	00	00	00	03	B2	70	17	/*	7.8	*/
			/*	8	*/	29	01	00	00	00	00	03	B2	70	07	/*	8.8	*/
			/*	9	*/	29	01	00	00	00	00	03	B2	60	F7	/*	9.8	*/
			/*	10	*/	29	01	00	00	00	00	03	B2	60	E7	/*	10.8	*/
			/*	11	*/	29	01	00	00	00	00	03	B2	60	D7	/*	11.8	*/
			/*	12	*/	29	01	00	00	00	00	03	B2	60	D1	/*	12.2	*/
			/*	13	*/	29	01	00	00	00	00	03	B2	60	B7	/*	13.9	*/
			/*	14	*/	29	01	00	00	00	00	03	B2	60	B1	/*	14.3	*/
			/*	15	*/	29	01	00	00	00	00	03	B2	60	A1	/*	15.3	*/
			/*	16	*/	29	01	00	00	00	00	03	B2	60	91	/*	16.3	*/
			/*	17	*/	29	01	00	00	00	00	03	B2	60	81	/*	17.4	*/
			/*	18	*/	29	01	00	00	00	00	03	B2	60	71	/*	18.4	*/
			/*	19	*/	29	01	00	00	00	00	03	B2	60	61	/*	19.4	*/
			/*	20	*/	29	01	00	00	00	00	03	B2	60	51	/*	20.4	*/
			/*	21	*/	29	01	00	00	00	00	03	B2	60	42	/*	21.4	*/
			/*	22	*/	29	01	00	00	00	00	03	B2	60	22	/*	23.4	*/
			/*	23	*/	29	01	00	00	00	00	03	B2	60	12	/*	24.5	*/
			/*	24	*/	29	01	00	00	00	00	03	B2	60	03	/*	25.5	*/
			/*	25	*/	29	01	00	00	00	00	03	B2	50	F3	/*	26.5	*/
			/*	26	*/	29	01	00	00	00	00	03	B2	50	D3	/*	28.5	*/
			/*	27	*/	29	01	00	00	00	00	03	B2	50	C3	/*	29.5	*/
			/*	28	*/	29	01	00	00	00	00	03	B2	50	B3	/*	30.6	*/
			/*	29	*/	29	01	00	00	00	00	03	B2	50	A3	/*	31.6	*/
			/*	30	*/	29	01	00	00	00	00	03	B2	50	93	/*	32.6	*/
			/*	31	*/	29	01	00	00	00	00	03	B2	50	83	/*	33.6	*/
			/*	32	*/	29	01	00	00	00	00	03	B2	50	6B	/*	35.2	*/
			/*	33	*/	29	01	00	00	00	00	03	B2	50	53	/*	36.7	*/
			/*	34	*/	29	01	00	00	00	00	03	B2	50	33	/*	38.8	*/
			/*	35	*/	29	01	00	00	00	00	03	B2	50	23	/*	39.8	*/
			/*	36	*/	29	01	00	00	00	00	03	B2	50	13	/*	40.8	*/
			/*	37	*/	29	01	00	00	00	00	03	B2	40	FA	/*	42.4	*/
			/*	38	*/	29	01	00	00	00	00	03	B2	40	E2	/*	43.9	*/
			/*	39	*/	29	01	00	00	00	00	03	B2	40	D2	/*	45	*/
			/*	40	*/	29	01	00	00	00	00	03	B2	40	C2	/*	46	*/
			/*	41	*/	29	01	00	00	00	00	03	B2	40	B2	/*	47	*/
			/*	42	*/	29	01	00	00	00	00	03	B2	40	9A	/*	48.5	*/
			/*	43	*/	29	01	00	00	00	00	03	B2	40	82	/*	50.1	*/
			/*	44	*/	29	01	00	00	00	00	03	B2	40	69	/*	51.7	*/
			/*	45	*/	29	01	00	00	00	00	03	B2	40	51	/*	53.2	*/
			/*	46	*/	29	01	00	00	00	00	03	B2	40	34	/*	55.1	*/
			/*	47	*/	29	01	00	00	00	00	03	B2	40	17	/*	56.9	*/
			/*	48	*/	29	01	00	00	00	00	03	B2	40	05	/*	58.1	*/
			/*	49	*/	29	01	00	00	00	00	03	B2	30	F2	/*	59.3	*/
			/*	50	*/	29	01	00	00	00	00	03	B2	30	E0	/*	60.5	*/
			/*	51	*/	29	01	00	00	00	00	03	B2	30	C7	/*	62.1	*/
			/*	52	*/	29	01	00	00	00	00	03	B2	30	AE	/*	63.7	*/
			/*	53	*/	29	01	00	00	00	00	03	B2	30	95	/*	65.3	*/
			/*	54	*/	29	01	00	00	00	00	03	B2	30	7F	/*	66.7	*/
			/*	55	*/	29	01	00	00	00	00	03	B2	30	68	/*	68.1	*/
			/*	56	*/	29	01	00	00	00	00	03	B2	30	52	/*	69.6	*/
			/*	57	*/	29	01	00	00	00	00	03	B2	30	32	/*	71.6	*/
			/*	58	*/	29	01	00	00	00	00	03	B2	30	11	/*	73.7	*/
			/*	59	*/	29	01	00	00	00	00	03	B2	30	12	/*	74.9	*/
			/*	60	*/	29	01	00	00	00	00	03	B2	20	FE	/*	76.1	*/
			/*	61	*/	29	01	00	00	00	00	03	B2	20	EB	/*	77.4	*/
			/*	62	*/	29	01	00	00	00	00	03	B2	20	D7	/*	78.7	*/
			/*	63	*/	29	01	00	00	00	00	03	B2	30	08	/*	79.1	*/
			/*	64	*/	29	01	00	00	00	00	03	B2	20	F0	/*	80.8	*/
			/*	65	*/	29	01	00	00	00	00	03	B2	20	D7	/*	82.4	*/
			/*	66	*/	29	01	00	00	00	00	03	B2	30	0B	/*	83.7	*/
			/*	67	*/	29	01	00	00	00	00	03	B2	20	FA	/*	84.9	*/
			/*	68	*/	29	01	00	00	00	00	03	B2	20	E8	/*	86.2	*/
			/*	69	*/	29	01	00	00	00	00	03	B2	20	D7	/*	87.4	*/
			/*	70	*/	29	01	00	00	00	00	03	B2	30	12	/*	88.5	*/
			/*	71	*/	29	01	00	00	00	00	03	B2	20	FE	/*	90	*/
			/*	72	*/	29	01	00	00	00	00	03	B2	20	EB	/*	91.5	*/
			/*	73	*/	29	01	00	00	00	00	03	B2	20	D7	/*	93	*/
			/*	74	*/	29	01	00	00	00	00	03	B2	30	00	/*	94.1	*/
			/*	75	*/	29	01	00	00	00	00	03	B2	20	EC	/*	95.8	*/
			/*	76	*/	29	01	00	00	00	00	03	B2	20	D7	/*	97.4	*/
			/*	77	*/	29	01	00	00	00	00	03	B2	30	13	/*	98.5	*/
			/*	78	*/	29	01	00	00	00	00	03	B2	20	FF	/*	100.2	*/
			/*	79	*/	29	01	00	00	00	00	03	B2	20	EB	/*	101.9	*/
			/*	80	*/	29	01	00	00	00	00	03	B2	20	D7	/*	103.7	*/
			/*	81	*/	29	01	00	00	00	00	03	B2	30	08	/*	104.9	*/
			/*	82	*/	29	01	00	00	00	00	03	B2	20	F8	/*	106.3	*/
			/*	83	*/	29	01	00	00	00	00	03	B2	20	E7	/*	107.8	*/
			/*	84	*/	29	01	00	00	00	00	03	B2	20	D7	/*	109.3	*/
			/*	85	*/	29	01	00	00	00	00	03	B2	30	18	/*	110.5	*/
			/*	86	*/	29	01	00	00	00	00	03	B2	30	08	/*	112.1	*/
			/*	87	*/	29	01	00	00	00	00	03	B2	20	F8	/*	113.6	*/
			/*	88	*/	29	01	00	00	00	00	03	B2	20	E7	/*	115.2	*/
			/*	89	*/	29	01	00	00	00	00	03	B2	20	D7	/*	116.8	*/
			/*	90	*/	29	01	00	00	00	00	03	B2	30	0D	/*	117	*/
			/*	91	*/	29	01	00	00	00	00	03	B2	20	FF	/*	118.3	*/
			/*	92	*/	29	01	00	00	00	00	03	B2	20	F2	/*	119.7	*/
			/*	93	*/	29	01	00	00	00	00	03	B2	20	E4	/*	121	*/
			/*	94	*/	29	01	00	00	00	00	03	B2	20	D7	/*	122.4	*/
			/*	95	*/	29	01	00	00	00	00	03	B2	30	11	/*	123.7	*/
			/*	96	*/	29	01	00	00	00	00	03	B2	30	02	/*	125.2	*/
			/*	97	*/	29	01	00	00	00	00	03	B2	20	F4	/*	126.8	*/
			/*	98	*/	29	01	00	00	00	00	03	B2	20	E5	/*	128.3	*/
			/*	99	*/	29	01	00	00	00	00	03	B2	20	D7	/*	129.9	*/
			/*	100	*/	29	01	00	00	00	00	03	B2	30	14	/*	131.1	*/
			/*	101	*/	29	01	00	00	00	00	03	B2	30	05	/*	132.8	*/
			/*	102	*/	29	01	00	00	00	00	03	B2	20	F5	/*	134.5	*/
			/*	103	*/	29	01	00	00	00	00	03	B2	20	E6	/*	136.3	*/
			/*	104	*/	29	01	00	00	00	00	03	B2	20	D7	/*	138	*/
			/*	105	*/	29	01	00	00	00	00	03	B2	30	13	/*	138.9	*/
			/*	106	*/	29	01	00	00	00	00	03	B2	30	07	/*	140.4	*/
			/*	107	*/	29	01	00	00	00	00	03	B2	20	FB	/*	141.8	*/
			/*	108	*/	29	01	00	00	00	00	03	B2	20	EF	/*	143.2	*/
			/*	109	*/	29	01	00	00	00	00	03	B2	20	E3	/*	144.7	*/
			/*	110	*/	29	01	00	00	00	00	03	B2	20	D7	/*	146.1	*/
			/*	111	*/	29	01	00	00	00	00	03	B2	30	15	/*	145.1	*/
			/*	112	*/	29	01	00	00	00	00	03	B2	30	09	/*	146.7	*/
			/*	113	*/	29	01	00	00	00	00	03	B2	20	FC	/*	148.3	*/
			/*	114	*/	29	01	00	00	00	00	03	B2	20	F0	/*	149.9	*/
			/*	115	*/	29	01	00	00	00	00	03	B2	20	E3	/*	151.4	*/
			/*	116	*/	29	01	00	00	00	00	03	B2	20	D7	/*	153	*/
			/*	117	*/	29	01	00	00	00	00	03	B2	30	0F	/*	155.4	*/
			/*	118	*/	29	01	00	00	00	00	03	B2	30	01	/*	157.3	*/
			/*	119	*/	29	01	00	00	00	00	03	B2	20	F3	/*	159.2	*/
			/*	120	*/	29	01	00	00	00	00	03	B2	20	E5	/*	161.1	*/
			/*	121	*/	29	01	00	00	00	00	03	B2	20	D7	/*	163	*/
			/*	122	*/	29	01	00	00	00	00	03	B2	30	15	/*	164.1	*/
			/*	123	*/	29	01	00	00	00	00	03	B2	30	0B	/*	165.6	*/
			/*	124	*/	29	01	00	00	00	00	03	B2	30	01	/*	167	*/
			/*	125	*/	29	01	00	00	00	00	03	B2	20	F6	/*	168.5	*/
			/*	126	*/	29	01	00	00	00	00	03	B2	20	EC	/*	170	*/
			/*	127	*/	29	01	00	00	00	00	03	B2	20	E1	/*	171.5	*/
			/*	128	*/	29	01	00	00	00	00	03	B2	20	D7	/*	173	*/
			/*	129	*/	29	01	00	00	00	00	03	B2	20	C7	/*	175.3	*/
			/*	130	*/	29	01	00	00	00	00	03	B2	20	B7	/*	177.6	*/
			/*	131	*/	29	01	00	00	00	00	03	B2	20	A7	/*	179.9	*/
			/*	132	*/	29	01	00	00	00	00	03	B2	20	97	/*	182.1	*/
			/*	133	*/	29	01	00	00	00	00	03	B2	20	87	/*	184.4	*/
			/*	134	*/	29	01	00	00	00	00	03	B2	20	77	/*	186.7	*/
			/*	135	*/	29	01	00	00	00	00	03	B2	20	67	/*	189	*/
			/*	136	*/	29	01	00	00	00	00	03	B2	20	59	/*	191	*/
			/*	137	*/	29	01	00	00	00	00	03	B2	20	4B	/*	193	*/
			/*	138	*/	29	01	00	00	00	00	03	B2	20	3D	/*	195	*/
			/*	139	*/	29	01	00	00	00	00	03	B2	20	2F	/*	197	*/
			/*	140	*/	29	01	00	00	00	00	03	B2	20	21	/*	199	*/
			/*	141	*/	29	01	00	00	00	00	03	B2	20	13	/*	201	*/
			/*	142	*/	29	01	00	00	00	00	03	B2	20	05	/*	203	*/
			/*	143	*/	29	01	00	00	00	00	03	B2	10	F5	/*	205.3	*/
			/*	144	*/	29	01	00	00	00	00	03	B2	10	E6	/*	207.5	*/
			/*	145	*/	29	01	00	00	00	00	03	B2	10	D6	/*	209.8	*/
			/*	146	*/	29	01	00	00	00	00	03	B2	10	C6	/*	212	*/
			/*	147	*/	29	01	00	00	00	00	03	B2	10	B7	/*	214.3	*/
			/*	148	*/	29	01	00	00	00	00	03	B2	10	A7	/*	216.5	*/
			/*	149	*/	29	01	00	00	00	00	03	B2	10	97	/*	218.8	*/
			/*	150	*/	29	01	00	00	00	00	03	B2	10	89	/*	220.8	*/
			/*	151	*/	29	01	00	00	00	00	03	B2	10	7A	/*	222.8	*/
			/*	152	*/	29	01	00	00	00	00	03	B2	10	6C	/*	224.9	*/
			/*	153	*/	29	01	00	00	00	00	03	B2	10	5E	/*	226.9	*/
			/*	154	*/	29	01	00	00	00	00	03	B2	10	50	/*	229	*/
			/*	155	*/	29	01	00	00	00	00	03	B2	10	42	/*	231	*/
			/*	156	*/	29	01	00	00	00	00	03	B2	10	33	/*	233	*/
			/*	157	*/	29	01	00	00	00	00	03	B2	10	25	/*	235.1	*/
			/*	158	*/	29	01	00	00	00	00	03	B2	10	33	/*	236.5	*/
			/*	159	*/	29	01	00	00	00	00	03	B2	10	26	/*	238.4	*/
			/*	160	*/	29	01	00	00	00	00	03	B2	10	19	/*	240.2	*/
			/*	161	*/	29	01	00	00	00	00	03	B2	10	0C	/*	242.1	*/
			/*	162	*/	29	01	00	00	00	00	03	B2	00	FF	/*	244	*/
			/*	163	*/	29	01	00	00	00	00	03	B2	00	F2	/*	245.9	*/
			/*	164	*/	29	01	00	00	00	00	03	B2	00	E5	/*	247.8	*/
			/*	165	*/	29	01	00	00	00	00	03	B2	00	D8	/*	249.6	*/
			/*	166	*/	29	01	00	00	00	00	03	B2	10	34	/*	250.5	*/
			/*	167	*/	29	01	00	00	00	00	03	B2	10	29	/*	252.3	*/
			/*	168	*/	29	01	00	00	00	00	03	B2	10	1D	/*	254.1	*/
			/*	169	*/	29	01	00	00	00	00	03	B2	10	12	/*	255.9	*/
			/*	170	*/	29	01	00	00	00	00	03	B2	10	06	/*	257.6	*/
			/*	171	*/	29	01	00	00	00	00	03	B2	00	FB	/*	259.4	*/
			/*	172	*/	29	01	00	00	00	00	03	B2	00	EF	/*	261.2	*/
			/*	173	*/	29	01	00	00	00	00	03	B2	00	E4	/*	263	*/
			/*	174	*/	29	01	00	00	00	00	03	B2	00	D8	/*	264.8	*/
			/*	175	*/	29	01	00	00	00	00	03	B2	10	34	/*	266.5	*/
			/*	176	*/	29	01	00	00	00	00	03	B2	10	29	/*	268.4	*/
			/*	177	*/	29	01	00	00	00	00	03	B2	10	1D	/*	270.3	*/
			/*	178	*/	29	01	00	00	00	00	03	B2	10	12	/*	272.2	*/
			/*	179	*/	29	01	00	00	00	00	03	B2	10	06	/*	274.1	*/
			/*	180	*/	29	01	00	00	00	00	03	B2	00	FB	/*	276	*/
			/*	181	*/	29	01	00	00	00	00	03	B2	00	EF	/*	277.9	*/
			/*	182	*/	29	01	00	00	00	00	03	B2	00	E4	/*	279.7	*/
			/*	183	*/	29	01	00	00	00	00	03	B2	00	D8	/*	281.6	*/
			/*	184	*/	29	01	00	00	00	00	03	B2	10	35	/*	279	*/
			/*	185	*/	29	01	00	00	00	00	03	B2	10	2B	/*	280.8	*/
			/*	186	*/	29	01	00	00	00	00	03	B2	10	20	/*	282.6	*/
			/*	187	*/	29	01	00	00	00	00	03	B2	10	16	/*	284.3	*/
			/*	188	*/	29	01	00	00	00	00	03	B2	10	0C	/*	286.1	*/
			/*	189	*/	29	01	00	00	00	00	03	B2	10	01	/*	287.9	*/
			/*	190	*/	29	01	00	00	00	00	03	B2	00	F7	/*	289.6	*/
			/*	191	*/	29	01	00	00	00	00	03	B2	00	ED	/*	291.4	*/
			/*	192	*/	29	01	00	00	00	00	03	B2	00	E2	/*	293.2	*/
			/*	193	*/	29	01	00	00	00	00	03	B2	00	D8	/*	295	*/
			/*	194	*/	29	01	00	00	00	00	03	B2	10	24	/*	297.2	*/
			/*	195	*/	29	01	00	00	00	00	03	B2	10	19	/*	299.1	*/
			/*	196	*/	29	01	00	00	00	00	03	B2	10	0E	/*	301.1	*/
			/*	197	*/	29	01	00	00	00	00	03	B2	10	04	/*	303.1	*/
			/*	198	*/	29	01	00	00	00	00	03	B2	00	F9	/*	305	*/
			/*	199	*/	29	01	00	00	00	00	03	B2	00	EE	/*	307	*/
			/*	200	*/	29	01	00	00	00	00	03	B2	00	E3	/*	309	*/
			/*	201	*/	29	01	00	00	00	00	03	B2	00	D8	/*	311	*/
			/*	202	*/	29	01	00	00	00	00	03	B2	10	26	/*	313	*/
			/*	203	*/	29	01	00	00	00	00	03	B2	10	1C	/*	314.8	*/
			/*	204	*/	29	01	00	00	00	00	03	B2	10	13	/*	316.7	*/
			/*	205	*/	29	01	00	00	00	00	03	B2	10	09	/*	318.5	*/
			/*	206	*/	29	01	00	00	00	00	03	B2	00	FF	/*	320.4	*/
			/*	207	*/	29	01	00	00	00	00	03	B2	00	F5	/*	322.3	*/
			/*	208	*/	29	01	00	00	00	00	03	B2	00	EC	/*	324.1	*/
			/*	209	*/	29	01	00	00	00	00	03	B2	00	E2	/*	326	*/
			/*	210	*/	29	01	00	00	00	00	03	B2	00	D8	/*	327.8	*/
			/*	211	*/	29	01	00	00	00	00	03	B2	10	22	/*	327.3	*/
			/*	212	*/	29	01	00	00	00	00	03	B2	10	19	/*	329.1	*/
			/*	213	*/	29	01	00	00	00	00	03	B2	10	10	/*	331	*/
			/*	214	*/	29	01	00	00	00	00	03	B2	10	06	/*	332.8	*/
			/*	215	*/	29	01	00	00	00	00	03	B2	00	FD	/*	334.7	*/
			/*	216	*/	29	01	00	00	00	00	03	B2	00	F4	/*	336.5	*/
			/*	217	*/	29	01	00	00	00	00	03	B2	00	EB	/*	338.4	*/
			/*	218	*/	29	01	00	00	00	00	03	B2	00	E1	/*	340.2	*/
			/*	219	*/	29	01	00	00	00	00	03	B2	00	D8	/*	342	*/
			/*	220	*/	29	01	00	00	00	00	03	B2	00	F1	/*	344	*/
			/*	221	*/	29	01	00	00	00	00	03	B2	00	E9	/*	345.7	*/
			/*	222	*/	29	01	00	00	00	00	03	B2	00	E0	/*	347.4	*/
			/*	223	*/	29	01	00	00	00	00	03	B2	00	D8	/*	349.2	*/
			/*	224	*/	29	01	00	00	00	00	03	B2	00	F4	/*	351.3	*/
			/*	225	*/	29	01	00	00	00	00	03	B2	00	EB	/*	353.2	*/
			/*	226	*/	29	01	00	00	00	00	03	B2	00	E1	/*	355.2	*/
			/*	227	*/	29	01	00	00	00	00	03	B2	00	D8	/*	357.1	*/
			/*	228	*/	29	01	00	00	00	00	03	B2	00	CC	/*	359.7	*/
			/*	229	*/	29	01	00	00	00	00	03	B2	00	BF	/*	362.3	*/
			/*	230	*/	29	01	00	00	00	00	03	B2	00	B3	/*	364.8	*/
			/*	231	*/	29	01	00	00	00	00	03	B2	00	A7	/*	367.3	*/
			/*	232	*/	29	01	00	00	00	00	03	B2	00	9B	/*	369.7	*/
			/*	233	*/	29	01	00	00	00	00	03	B2	00	90	/*	372.1	*/
			/*	234	*/	29	01	00	00	00	00	03	B2	00	84	/*	374.6	*/
			/*	235	*/	29	01	00	00	00	00	03	B2	00	79	/*	376.9	*/
			/*	236	*/	29	01	00	00	00	00	03	B2	00	6E	/*	379.2	*/
			/*	237	*/	29	01	00	00	00	00	03	B2	00	63	/*	381.5	*/
			/*	238	*/	29	01	00	00	00	00	03	B2	00	58	/*	383.7	*/
			/*	239	*/	29	01	00	00	00	00	03	B2	00	4E	/*	385.8	*/
			/*	240	*/	29	01	00	00	00	00	03	B2	00	44	/*	387.9	*/
			/*	241	*/	29	01	00	00	00	00	03	B2	00	3A	/*	389.9	*/
			/*	242	*/	29	01	00	00	00	00	03	B2	00	30	/*	392	*/
			/*	243	*/	29	01	00	00	00	00	03	B2	00	2D	/*	393.7	*/
			/*	244	*/	29	01	00	00	00	00	03	B2	00	23	/*	395.7	*/
			/*	245	*/	29	01	00	00	00	00	03	B2	00	1A	/*	397.7	*/
			/*	246	*/	29	01	00	00	00	00	03	B2	00	10	/*	399.7	*/
			/*	247	*/	29	01	00	00	00	00	03	B2	00	2F	/*	401.9	*/
			/*	248	*/	29	01	00	00	00	00	03	B2	00	25	/*	404.1	*/
			/*	249	*/	29	01	00	00	00	00	03	B2	00	1A	/*	406.4	*/
			/*	250	*/	29	01	00	00	00	00	03	B2	00	10	/*	408.6	*/
			/*	251	*/	29	01	00	00	00	00	03	B2	00	2B	/*	410.6	*/
			/*	252	*/	29	01	00	00	00	00	03	B2	00	22	/*	412.6	*/
			/*	253	*/	29	01	00	00	00	00	03	B2	00	19	/*	414.5	*/
			/*	254	*/	29	01	00	00	00	00	03	B2	00	10	/*	416.5	*/
			/*	255	*/	29	01	00	00	00	00	03	B2	00	10	/*	416.5	*/
		];

		/*
		 * ************************************************************************************************************************
		 * ACL command list and mappings
		 * ************************************************************************************************************************
		 */

		samsung,acl_on_tx_cmds_revA = [
			29 01 00 00 00 00 02 B5 50	/* ACL 32Frame Averaging */
			29 01 00 00 00 00 02 55 02	/* ACL 15%(default) ON */
		];

		samsung,acl_percent_tx_cmds_revA = [
			29 01 00 00 00 00 02 55 00	/* ACL OFF */
			29 01 00 00 00 00 02 55 01	/* ACL 15% */
			29 01 00 00 00 00 02 55 02	/* Default ACL 8% */
			29 01 00 00 00 00 02 55 03	/* ACL 20% */

		];

		samsung,acl_off_tx_cmds_revA = [
			29 01 00 00 00 00 02 B5 40	/* 16 Frame Avg. */
			29 01 00 00 00 00 02 55 00	/* ACL OFF */
		];

		/* bl_level , Index in acl command list */
		samsung,acl_map_table_revA =  <
			2	2		3	2		4	2		5	2		6	2
			7	2		8	2		9	2		10	2		11	2
			12	2		13	2		14	2		15	2		16	2
			17	2		19	2		20	2		21	2		22	2
			24	2		25	2		27	2		29	2		30	2
			32	2		34	2		37	2		39	2		41	2
			44	2		47	2		50	2		53	2		56	2
			60	2		64	2		68	2		72	2		77	2
			82	2		87	2		93	2		98	2		105	2
			111	2		119	2		126	2		134	2		143	2
			152	2		162	2		172	2		183	2		195	2
			207	2		220	2		234	2		249	2		265	2
			282	2		300	2		316	2		333	2		350	2
			357	2		365	2		372	2		380	2		387	2
			395	2		403	2		412	2		420	2
		>;

		/*
		 * ************************************************************************************************************************
		 * ELVSS(ACL Off) command list and mappings
		 * ************************************************************************************************************************
		 */
		samsung,elvss_tx_cmds_revA = [
			29 01 00 00 00 00 03 b6 AC 05 /* 0 */
			29 01 00 00 00 00 03 b6 AC 06 /* 1 */
			29 01 00 00 00 00 03 b6 AC 07 /* 2 */
			29 01 00 00 00 00 03 b6 AC 08 /* 3 */
			29 01 00 00 00 00 03 b6 AC 09 /* 4 */
			29 01 00 00 00 00 03 b6 AC 0A /* 5 */
			29 01 00 00 00 00 03 b6 AC 0B /* 6 */
			29 01 00 00 00 00 03 b6 AC 0C /* 7 */
			29 01 00 00 00 00 03 b6 AC 0D /* 8 */
			29 01 00 00 00 00 03 b6 AC 0E /* 9 */
			29 01 00 00 00 00 03 b6 AC 14 /* 10 */
			29 01 00 00 00 00 03 b6 BC 14 /* 11 */
			29 01 00 00 00 00 03 b6 BC 13 /* 12 */
			29 01 00 00 00 00 03 b6 BC 12 /* 13 */
			29 01 00 00 00 00 03 b6 BC 11 /* 14 */
			29 01 00 00 00 00 03 b6 BC 10 /* 15 */
			29 01 00 00 00 00 03 b6 BC 0F /* 16 */
			29 01 00 00 00 00 03 b6 BC 0E /* 17 */
			29 01 00 00 00 00 03 b6 BC 0D /* 18 */
			29 01 00 00 00 00 03 b6 BC 0C /* 19 */
			29 01 00 00 00 00 03 b6 BC 0B /* 20 */
			29 01 00 00 00 00 03 b6 BC 0A /* 21 */
			29 01 00 00 00 00 03 b6 BC 09 /* 22 */
			29 01 00 00 00 00 03 b6 BC 08 /* 23 */
			29 01 00 00 00 00 03 b6 BC 07 /* 24 */
			29 01 00 00 00 00 03 b6 BC 06 /* 25 */
			29 01 00 00 00 00 03 b6 BC 05 /* 26 */
			29 01 00 00 00 00 03 b6 BC 04 /* 27 */

		];

		/*
		 * ************************************************************************************************************************
		 * SMART ACL(ACL On) ELVSS command list and mappings
		 * ************************************************************************************************************************
		 */
		samsung,smart_acl_elvss_tx_cmds_revA = [
			29 01 00 00 00 00 03 b6 AC 05 /* 0 */
			29 01 00 00 00 00 03 b6 AC 06 /* 1 */
			29 01 00 00 00 00 03 b6 AC 07 /* 2 */
			29 01 00 00 00 00 03 b6 AC 08 /* 3 */
			29 01 00 00 00 00 03 b6 AC 09 /* 4 */
			29 01 00 00 00 00 03 b6 AC 0A /* 5 */
			29 01 00 00 00 00 03 b6 AC 0B /* 6 */
			29 01 00 00 00 00 03 b6 AC 0C /* 7 */
			29 01 00 00 00 00 03 b6 AC 0D /* 8 */
			29 01 00 00 00 00 03 b6 AC 0E /* 9 */
			29 01 00 00 00 00 03 b6 AC 14 /* 10 */
			29 01 00 00 00 00 03 b6 BC 14 /* 11 */
			29 01 00 00 00 00 03 b6 BC 13 /* 12 */
			29 01 00 00 00 00 03 b6 BC 12 /* 13 */
			29 01 00 00 00 00 03 b6 BC 11 /* 14 */
			29 01 00 00 00 00 03 b6 BC 10 /* 15 */
			29 01 00 00 00 00 03 b6 BC 0F /* 16 */
			29 01 00 00 00 00 03 b6 BC 0E /* 17 */
			29 01 00 00 00 00 03 b6 BC 0D /* 18 */
			29 01 00 00 00 00 03 b6 BC 0C /* 19 */
			29 01 00 00 00 00 03 b6 BC 0B /* 20 */
			29 01 00 00 00 00 03 b6 BC 0A /* 21 */
			29 01 00 00 00 00 03 b6 BC 09 /* 22 */
			29 01 00 00 00 00 03 b6 BC 08 /* 23 */
			29 01 00 00 00 00 03 b6 BC 07 /* 24 */
			29 01 00 00 00 00 03 b6 BC 06 /* 25 */
			29 01 00 00 00 00 03 b6 BC 05 /* 26 */
			29 01 00 00 00 00 03 b6 BC 04 /* 27 */
		];

		/* bl_level, Index in elvss command list */
		samsung,smart_acl_elvss_map_table_revA = <
			2	0		3	1		4	2		5	3		6	4
			7	5		8	6		9	7		10	7		11	8
			12	8		13	9		14	9		15	10		16	10
			17	10		19	10		20	10		21	10		22	10
			24	10		25	10		27	10		29	10		30	10
			32	10		34	10		37	10		39	10		41	11
			44	11		47	11		50	11		53	11		56	11
			60	11		64	11		68	11		72	11		77	11
			82	11		87	12		93	12		98	12		105	13
			111	13		119	14		126	14		134	15		143	15
			152	16		162	16		172	17		183	17		195	18
			207	18		220	18		234	18		249	18		265	19
			282	20		300	21		316	22		333	23		350	24
			357	24		365	25		372	25		380	25		387	26
			395	26		403	26		412	27		420	27
		>;

		/*
		 * ************************************************************************************************************************
		 * candela to index mappings
		 * ************************************************************************************************************************
		 */
		samsung,candela_map_table_revA = <
		/*<idx><PMSL range> <candella> *//*linear map*/
			0	0	0	2
			1	1	2	3
			2	3	3	4
			3	4	4	5
			4	5	5	6
			5	6	6	7
			6	7	7	8
			7	8	8	9
			8	9	9	10
			9	10	10	11
			10	11	11	12
			11	12	12	13
			12	13	13	14
			13	14	14	15
			14	15	15	16
			15	16	17	17
			16	18	18	19
			17	19	19	20 /* dimming*/
			18	20	20	21
			19	21	21	22
			20	22	22	24
			21	23	24	25
			22	25	25	27
			23	26	26	29
			24	27	28	30
			25	29	30	32
			26	31	32	34
			27	33	33	37
			28	34	35	39
			29	36	37	41
			30	38	40	44
			31	41	42	47
			32	43	44	50
			33	45	46	53
			34	47	49	56
			35	50	52	60
			36	53	55	64
			37	56	57	68
			38	58	61	72
			39	62	64	77
			40	65	68	82
			41	69	72	87
			42	73	75	93
			43	76	79	98
			44	80	83	105
			45	84	88	111
			46	89	93	119
			47	94	98	126
			48	99	103	134
			49	104	109	143
			50	110	115	152
			51	116	120	162
			52	121	127	172
			53	128	134	183 /* default */
			54	135	141	195
			55	142	148	207
			56	149	156	220
			57	157	164	234
			58	165	173	249
			59	174	182	265
			60	183	192	282
			61	193	200	300
			62	201	209	316
			63	210	218	333
			64	219	222	350
			65	223	226	357
			66	227	229	365
			67	230	233	372
			68	234	237	380
			69	238	241	387
			70	242	245	395
			71	246	249	403
			72	250	253	412
			73	254	255	420
		>;

		/*
		 * ************************************************************************************************************************
		 *   APLPM
		 * ************************************************************************************************************************
		 */
		samsung,alpm_on_tx_cmds_revA = [
			05 01 00 00 14 00 02 28 00	/* display off wait 20ms */
			29 01 00 00 00 00 03 F0 5A 5A	/* TEST KEY Enable */
			29 01 00 00 00 00 0A		/* Update Gamma */
				BB 01 00 00 00
				07 80 4D 4A 5B
			29 01 00 00 00 00 03 F0 A5 A5	/* TEST KEY Enable */
			/* image write for APLM mode */
			29 01 00 00 00 00 05 30 00 00 00 00	/* user set partial area */
			29 01 00 00 00 00 02 12 00		/* partial mode on */
			29 01 00 00 14 00 02 39 00		/* idel mode on wait 20ms */
/*			29 01 00 00 00 00 02 29 00*/		/* display on */
		];

		samsung,alpm_off_tx_cmds_revA = [
			05 01 00 00 14 00 02 28 00	/* display off wait 20ms */
			/* image write for normal mode */
			29 01 00 00 00 00 02 38 00	/* idel Mode off */
			29 01 00 00 00 00 02 13 00	/* normal mode on */

/*			29 01 00 00 00 00 02 29 00*/	/* display on */
		];
	};
};
