/* Copyright (c) 2013-14, Samsung Electronics Corporation. All rights reserved.
 *
 * This program is free software; you can redistribute it and/or modify
 * it under the terms of the GNU General Public License version 2 and
 * only version 2 as published by the Free Software Foundation.
 *
 * This program is distributed in the hope that it will be useful,
 * but WITHOUT ANY WARRANTY; without even the implied warranty of
 * MERCHANTABILITY or FITNESS FOR A PARTICULAR PURPOSE.  See the
 * GNU General Public License for more details.
 */

/*---------------------------------------------------------------------------
 * This file is autogenerated file using gcdb parser. Please do not edit it.
 * Update input XML file to add a new entry or update variable in this file
 * VERSION = "1.0"
 *---------------------------------------------------------------------------*/
&mdss_mdp {
	ss_dsi_panel_TD4100_BV050HDM_HD: ss_dsi_panel_TD4100_BV050HDM_HD {
		qcom,mdss-dsi-panel-name = "ss_dsi_panel_TD4100_BV050HDM_HD";
		qcom,mdss-dsi-panel-controller = <&mdss_dsi0>;
		qcom,mdss-dsi-panel-width = <720>;
		qcom,mdss-dsi-panel-height = <1280>;
		qcom,mdss-dsi-bpp = <24>;
		qcom,mdss-dsi-panel-destination = "display_1";
		qcom,mdss-dsi-panel-timings = [DA 34 24 00 64 68 28 38 2A 03 04 00];
		qcom,mdss-dsi-on-command = [
			/* Initializing Sequence(1)*/
			39 00 00 00 00 00 02 B0 04		/* MCS enable */
			39 00 00 00 00 00 04 B3 10 00 06	/* Interface setting */
			39 00 00 00 00 00 08 B6 33 53 80 00 00 07 86	/* DSI control */
			39 00 00 00 00 00 07 BA 07 87 3A 0A 2D 88	/* Backlight control 3, Movie mode 40% */
			/* Sunlight readablility enhancement */
			39 00 00 00 00 00 04 BB 00 B4 A0
			39 00 00 00 00 00 04 BC 00 B4 A0
			39 00 00 00 00 00 04 BD 00 B4 A0
			39 00 00 00 00 00 02 BE 04
			39 00 00 00 00 00 12 C0 00 00 00 00 00 00 00 00 00 00 00 00 00 00 00 00 00 /* Display setting 4 */
			39 00 00 00 00 00 23 C1 04 48 01 00 33 08 11 00 11 00 73 23 23 11 00 00 00 00 00 00 00 00 00 00 00 00 DF 00 30 00 01 00 00 00 /* Display setting 1 */
			39 00 00 00 00 00 14 C2 00 F0 05 00 0A 04 08 00 24 19 00 00 00 00 00 00 00 03 00 /* Display setting 2 */
			39 00 00 00 00 00 40 C3 51 15 11 51 10 00 00 00 00 00 00 00 00 00 00 00 00 00 00 00 01 01 03 28 00 01 01 01 00 00 00 00 00 00 00 00 00 00 00 00 00 00 00 00 00 00 00 00 6C 01 00 00 00 00 6C 01 00 00 00 00 40 20 04 /* Display setting 3 */
			39 00 00 00 00 00 29 C4 70 01 00 00 00 00 00 00 00 00 00 00 00 00 00 00 00 00 00 00 00 00 00 00 00 00 00 00 00 00 00 00 00 00 00 00 00 00 01 01 /* Source timing setting and SOUT equalize setting */

			/* Initializing Sequence(2)*/
			39 00 00 00 00 00 0B C5 08 00 00 00 00 70 00 00 2D 41 /* Crosshair */
			39 00 00 00 00 00 22 C6 B8 25 9B 00 00 25 9B 00 00 00 00 00 00 00 00 00 00 00 00 00 00 00 00 00 00 00 00 00 00 00 00 C3 B8 /* Panel timing setting */
			39 00 00 00 00 00 2F C7 01 12 1E 2D 39 46 5F 71 80 8E 40 4E 5B 6E 78 84 9A 98 A0 00 12 1E 2C 39 46 5F 71 84 8E 44 4E 5B 6E 78 84 8F 9A A0 00 97 00 97 00 97 00 97 /* Gamma setting common set */
			39 00 00 00 00 00 38 C8 00 00 00 00 00 FC 00 00 00 00 00 FC 00 00 00 00 00 FC 00 00 00 00 00 FC 00 00 00 00 00 FC 00 00 00 00 00 FC 00 00 00 00 00 FC 00 00 00 00 00 FC 00 00 00 00 00 FC 00 /* Digital gamma setting 1 */
			39 00 00 00 00 00 14 C9 00 00 00 00 00 FC 00 00 00 00 00 FC 00 00 00 00 00 FC 00 /* Digital gamma setting 2 */
			39 00 00 00 00 00 2C CA 1D FA FC FA 00 E6 E1 A5 00 DB B1 DC 00 CD 00 05 F7 E5 00 00 07 F3 00 00 00 00 00 00 00 00 00 00 00 00 00 00 00 00 00 00 00 00 00 /* Color enhancement */
			39 00 00 00 00 00 2E CC 00 00 D2 72 46 42 12 16 1A 1E 00 00 D0 70 00 00 00 00 00 00 00 00 00 00 00 00 00 00 00 00 70 D0 00 00 1C 18 14 10 40 44 72 D2 00 00 00 /* Panel interface control */

			/* Initializing Sequence(3)*/
			39 00 00 00 00 00 14 CD 32 05 6E 01 00 00 00 00 00 00 00 00 00 00 00 00 01 00 00 /* Touch control */
			39 00 00 00 00 00 19 CE 7d 40 48 56 67 78 88 98 A7 B5 C3 D1 DE E9 F2 FA FF 04 00 01 04 45 00 00 /* Backlight control 4 */
			39 00 00 00 00 00 03 CF 48 10 /* Panel synchronous output */
			39 00 00 00 00 00 13 D0 11 04 5A E4 03 10 10 40 19 08 99 00 00 00 00 00 00 00 /* Power setting for CHGP */
			39 00 00 00 00 00 02 D1 04 /* Touch period and source drive mode select */
			39 00 00 00 00 00 1C D3 BB 3B 33 3B 44 3B 44 3B 00 00 EC 9B 8B 23 22 D5 D9 3B BB 4F D0 3C 10 12 10 00 10 /* Power setting for internal power */
			39 00 00 00 00 00 19 D4 80 04 04 33 00 04 00 00 00 00 00 00 00 00 00 00 00 00 0A 90 05 00 64 94 /* Temperature sensor */
			39 00 00 00 00 00 02 D6 01 /* Sequencer test control */


			39 00 00 00 00 00 25 D7 F6 FF 03 05 43 24 80 1F C7 1F 1B 00 0F 01 20 08 80 3F 00 78 00 40 24 15 00 33 02 C0 AF CB 60 30 FC 00 3F 00 /* Timing control for power on sequencer test mode */
			39 00 00 00 00 00 09 D8 00 00 00 00 00 00 00 00 /* Temperature sensor read */
			39 00 00 00 00 00 05 DD 30 06 23 65 /* Outline sharpening control */

			/* PWM INIT */
			39 00 00 00 00 00 02 51 00
			39 00 00 00 00 00 02 53 0C
			39 00 00 00 00 00 02 55 00
			39 00 00 00 00 00 02 5E 30
			39 01 00 00 00 00 02 35 00

			/* Display on Sequence(4) */
			05 01 00 00 00 00 02 11 00	/* Sleep Out & 120ms(0x78) Delay. 120ms delay wait at DISPLAY_ON cmd */

			39 00 00 00 00 00 02 B0 03	/* MCS disable */
		];
		qcom,mdss-dsi-off-command = [
			05 01 00 00 00 00 02 28 00	/* no wait */
			05 01 00 00 6E 00 02 10 00	/* wait 6 frame(mininum) */
		];
		//qcom,mdss-dsi-post-panel-on-command = ;

		//qcom,cmd-sync-wait-broadcast = ;
		//qcom,mdss-dsi-fbc-enable = ;
		//qcom,mdss-dsi-fbc-slice-height = ;
		//qcom,mdss-dsi-fbc-2d-pred-mode = ;
		//qcom,mdss-dsi-fbc-ver2-mode = ;
		//qcom,mdss-dsi-fbc-bpp = ;
		//qcom,mdss-dsi-fbc-packing = ;
		//qcom,mdss-dsi-fbc-quant-error = ;
		//qcom,mdss-dsi-fbc-bias = ;
		//qcom,mdss-dsi-fbc-pat-mode = ;
		//qcom,mdss-dsi-fbc-vlc-mode = ;
		//qcom,mdss-dsi-fbc-bflc-mode = ;
		//qcom,mdss-dsi-fbc-h-line-budget = ;
		//qcom,mdss-dsi-fbc-budget-ctrl = ;
		//qcom,mdss-dsi-fbc-block-budget = ;
		//qcom,mdss-dsi-fbc-lossless-threshold = ;
		//qcom,mdss-dsi-fbc-lossy-threshold = ;
		//qcom,mdss-dsi-fbc-rgb-threshold = ;
		//qcom,mdss-dsi-fbc-lossy-mode-idx = ;
		//qcom,mdss-dsi-fbc-max-pred-err = ;

		qcom,mdss-dsi-h-back-porch = <254>;
		qcom,mdss-dsi-v-back-porch = <13>;
		qcom,mdss-dsi-v-front-porch = <400>;
		qcom,mdss-dsi-v-pulse-width = <2>;
		qcom,mdss-dsi-h-front-porch = <254>;
		qcom,mdss-dsi-h-pulse-width = <165>;

		qcom,mdss-dsi-h-sync-skew = <0>;
		qcom,mdss-dsi-h-left-border = <0>;
		qcom,mdss-dsi-h-right-border = <0>;
		qcom,mdss-dsi-v-top-border = <0>;
		qcom,mdss-dsi-v-bottom-border = <0>;
		qcom,mdss-dsi-underflow-color = <0xff>;
		qcom,mdss-dsi-border-color = <0>;

		//qcom,mdss-dsi-pan-enable-dynamic-fps = ;
		//qcom,mdss-dsi-pan-fps-update = ;
		//qcom,min-refresh-rate = ;
		//qcom,max-refresh-rate = ;
		qcom,mdss-dsi-bl-pmic-control-type = "bl_ctrl_dcs";
		//qcom,mdss-dsi-bl-pwm-pmi = ;
		//qcom,mdss-dsi-bl-pmic-bank-select = ;
		//qcom,mdss-dsi-bl-pmic-pwm-frequency = ;
		//qcom,mdss-dsi-pwm-gpio = ;
		qcom,mdss-dsi-bl-min-level = <1>;
		qcom,mdss-dsi-bl-max-level = <256>;
		qcom,mdss-brightness-max-level = <256>;
		//qcom,mdss-dsi-interleave-mode = ;
		qcom,mdss-dsi-panel-type = "dsi_video_mode";
		//qcom,5v-boost-gpio = ;
		//qcom,mdss-dsi-te-check-enable = ;
		//qcom,mdss-dsi-te-using-te-pin = ;
		//qcom,mdss-dsi-te-pin-select = ;
		//qcom,mdss-dsi-te-dcs-command = ;
		//qcom,mdss-dsi-wr-mem-start = ;
		//qcom,mdss-dsi-wr-mem-continue = ;
		qcom,mdss-dsi-h-sync-pulse = <0>;
		qcom,mdss-dsi-hfp-power-mode;
		//qcom,mdss-dsi-hbp-power-mode;
		//qcom,mdss-dsi-hsa-power-mode;
		//qcom,mdss-dsi-last-line-interleave = ;
		qcom,mdss-dsi-bllp-eof-power-mode;
		qcom,mdss-dsi-bllp-power-mode;
		qcom,mdss-dsi-traffic-mode = "burst_mode";
		qcom,mdss-dsi-pixel-packing = "loose";
		qcom,mdss-dsi-virtual-channel-id = <0>;
		qcom,mdss-dsi-color-order = <0>;
		qcom,mdss-dsi-lane-0-state;
		qcom,mdss-dsi-lane-1-state;
		qcom,mdss-dsi-lane-2-state;
		qcom,mdss-dsi-lane-3-state;
		qcom,mdss-dsi-t-clk-post = <0x03>;
		qcom,mdss-dsi-t-clk-pre = <0x29>;
		qcom,mdss-dsi-stream = <0>;
		qcom,mdss-dsi-mdp-trigger = "none";
		qcom,mdss-dsi-dma-trigger = "trigger_sw";
		qcom,mdss-dsi-panel-framerate = <60>;
		qcom,mdss-dsi-panel-clockrate = <850000000>;
		//qcom,mdss-mdp-transfer-time-us = ;
		qcom,mdss-dsi-on-command-state = "dsi_lp_mode";
		qcom,mdss-dsi-off-command-state = "dsi_hs_mode";
		//qcom,mdss-dsi-post-mode-switch-on-command-state = ;
		qcom,mdss-pan-physical-width-dimension = <62>;
		qcom,mdss-pan-physical-height-dimension = <111>;
		//qcom,mdss-dsi-panel-mode-gpio-state = ;
		//qcom,mdss-tear-check-disable = ;
		//qcom,mdss-tear-check-sync-cfg-height = ;
		//qcom,mdss-tear-check-sync-init-val = ;
		//qcom,mdss-tear-check-sync-threshold-start = ;
		//qcom,mdss-tear-check-sync-threshold-continue = ;
		//qcom,mdss-tear-check-start-pos = ;
		//qcom,mdss-tear-check-rd-ptr-trigger-intr = ;
		//qcom,mdss-tear-check-frame-rate = ;
		qcom,mdss-dsi-reset-sequence = <0 20>, <1 0>;
		//qcom,partial-update-enabled = ;
		//qcom,mdss-dsi-horizontal-line-idle = ;
		//qcom,partial-update-roi-merge = ;
		//qcom,dcs-cmd-by-left = ;
		qcom,mdss-dsi-lp11-init;
		qcom,mdss-dsi-init-delay-us = <100>;
		qcom,mdss-dsi-rx-eot-ignore;
		qcom,mdss-dsi-tx-eot-append;
		//qcom,ulps-enabled = ;
		//qcom,suspend-ulps-enabled = ;
		//qcom,panel-roi-alignment = ;
		qcom,esd-check-enabled;
		//qcom,mdss-dsi-panel-status-command = ;
		//qcom,mdss-dsi-panel-status-command-mode = ;
		qcom,mdss-dsi-panel-status-check-mode="reg_read_irq";
		qcom,mdss-dsi-panel-status-irq-trigger1 ="rising";
		//qcom,mdss-dsi-panel-status-read-length = ;
		//qcom,mdss-dsi-panel-status-valid-params = ;
		qcom,mdss-dsi-panel-status-value = <1>;
		//qcom,mdss-dsi-panel-max-error-count = ;
		//qcom,dynamic-mode-switch-enabled = ;
		//qcom,dynamic-mode-switch-type = ;
		//qcom,mdss-dsi-post-mode-switch-on-command = ;
		//qcom,video-to-cmd-mode-switch-commands = ;
		//qcom,cmd-to-video-mode-switch-commands = ;
		//qcom,mdss-dsi-panel-orientation = ;
		//qcom,panel-ack-disabled = ;
		//qcom,mdss-dsi-force-clock-lane-hs;
		//qcom,compression-mode = ;
		//qcom,panel-supply-entries = ;
		//qcom,config-select = ;
		//qcom,lm-split = ;
		//qcom,split-mode = ;
		//qcom,mdss-dsc-encoders = ;
		//qcom,mdss-dsc-slice-height = ;
		//qcom,mdss-dsc-slice-width = ;
		//qcom,mdss-dsc-slice-per-pkt = ;
		//qcom,mdss-dsc-bit-per-component = ;
		//qcom,mdss-dsc-bit-per-pixel = ;
		//qcom,mdss-dsc-block-prediction-enable = ;
		//qcom,mdss-dsc-config-by-manufacture-cmd = ;
		//qcom,dba-panel = ;
		//qcom,bridge-name = ;
		//qcom,adjust-timer-wakeup-ms = ;
		//qcom,mdss-dsi-display-timings = ;
		//qcom,mdss-dsi-timing-default = ;
		//qcom,mdss-dsi-timing-switch-command = ;
		//qcom,mdss-dsi-timing-switch-command-state  = ;

/*
 * ************************************************************************************************************************************
 *
 *
 *			Below  parameters are samsung dependent thigs
 *
 *
 * ************************************************************************************************************************************
 */
		samsung,panel-vendor = "BOE";
		samsung,tft-common-support;
		samsung,enter_hbm_lux = <20000>;
		samsung,support_mdnie_lite;

		/* To use device_resume & device_suspend for optimizing display on time */
		samsung,reduce_display_on_time;
		samsung,dsi_force_clock_lane_hs;
		samsung,wait_after_reset_delay = <80>; /* Flash loading time */
		samsung,wait_after_sleep_out_delay = <107>; /* More than 6frame 16.6 * 6 = 99.6ms+7ms*/

		samsung,level1_key_enable_tx_cmds_revA = [
			39 01 00 00 00 00 02 B0 04
		];
		samsung,level1_key_disable_tx_cmds_revA = [
			39 01 00 00 00 00 02 B0 03
		];

		samsung,packet_size_tx_cmds_revA = [
			37 01 00 00 00 00 02 07 00
		];

		samsung,display_on_tx_cmds_revA = [
			05 01 00 00 00 00 02 29 00
		];

		samsung,display_off_tx_cmds_revA = [05 01 00 00 00 00 02 28 00];

		/*
		 * First parameters can be changed
		 * by function of samsung_nv_read()
		 * because of that means offset of
		 * read position
		 */
		samsung,reg_read_pos_tx_cmds_revA = [
			15 01 00 00 00 00 02 B0 00
		];
		samsung,manufacture_id0_rx_cmds_revA = [06 01 00 00 00 00 01 da 01 00];
		samsung,manufacture_id1_rx_cmds_revA = [06 01 00 00 00 00 01 db 01 00];
		samsung,manufacture_id2_rx_cmds_revA = [06 01 00 00 00 00 01 dc 01 00];

		samsung,mtp_read_sysfs_rx_cmds_revA = [06 01 00 00 00 00 01 00 00 00];

		samsung,tft_pwm_tx_cmds_revA=[
			39 01 00 00 00 00 02 51 FF/*First command should be PWM duty change command*/
		];
		samsung,cabc_on_tx_cmds_revA = [
			39 00 00 00 00 00 02 53 0C /* slope dimming */
			39 01 00 00 00 00 02 55 01
		];
		samsung,cabc_off_tx_cmds_revA = [
			39 00 00 00 00 00 02 53 0C /* slope dimming */
			39 01 00 00 00 00 02 55 00
		];
		/*
		* ************************************************************************************************************************
		* Scaled level to index mappings
		* ************************************************************************************************************************
		*/
		samsung,candela_map_table_revA = <
		/*<idx>	  <from>  <till> <scaled_level> */
			0		0		0		0
			1		1		2		2		/* MIN 4 CD */
			2		3		3		3
			3		4		5		4
			4		6		6		5
			5		7		8		6
			6		9		9		7
			7		10		11		8		/* DIMMING 20 CD */
			8		12		13		9
			9		14		16		10
			10		17		18		11
			11		19		20		12
			12		21		22		13
			13		23		24		14
			14		25		26		15
			15		27		29		16
			16		30		31		17
			17		32		33		18
			18		34		35		19
			19		36		37		20
			20		38		40		21
			21		41		42		22
			22		43		44		23
			23		45		46		24
			24		47		48		25
			25		49		51		26
			26		52		53		27
			27		54		55		28
			28		56		57		29
			29		58		59		30
			30		60		61		31
			31		62		64		32
			32		65		66		33
			33		67		68		34
			34		69		70		35
			35		71		72		36
			36		73		75		37
			37		76		77		38
			38		78		79		39
			39		80		81		40
			40		82		83		41
			41		84		85		42
			42		86		88		43
			43		89		90		44
			44		91		92		45
			45		93		94		46
			46		95		96		47
			47		97		99		48
			48		100		101		49
			49		102		103		50
			50		104		105		52
			51		106		107		54
			52		108		110		56
			53		111		112		58
			54		113		114		60
			55		115		116		62
			56		117		118		64
			57		119		120		66
			58		121		123		68
			59		124		125		70
			60		126		127		72
			61		128		131		73
			62		132		134		76
			63		135		138		79
			64		139		141		82		/* DEFAULT 190 CD */
			65		142		145		86
			66		146		148		90
			67		149		152		93
			68		153		155		97
			69		156		159		101
			70		160		162		105
			71		163		166		108
			72		167		170		112
			73		171		173		116
			74		174		177		120
			75		178		180		124
			76		181		184		127
			77		185		187		131
			78		188		191		135
			79		192		194		139
			80		195		198		143
			81		199		201		146
			82		202		205		150
			83		206		208		154
			84		209		212		158
			85		213		216		161
			86		217		219		165
			87		220		223		169
			88		224		226		173
			89		227		230		177
			90		231		233		180
			91		234		237		184
			92		238		240		188
			93		241		244		192
			94		245		247		195
			95		248		251		199
			96		252		255		203
			97		256		256		233
		>;
	};
};
