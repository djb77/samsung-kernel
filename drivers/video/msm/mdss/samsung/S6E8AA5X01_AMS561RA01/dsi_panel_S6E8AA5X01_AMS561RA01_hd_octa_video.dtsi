/* Copyright (c) 2013-2014, The Linux Foundation. All rights reserved.
 *
 * This program is free software; you can redistribute it and/or modify
 * it under the terms of the GNU General Public License version 2 and
 * only version 2 as published by the Free Software Foundation.
 *
 * This program is distributed in the hope that it will be useful,
 * but WITHOUT ANY WARRANTY; without even the implied warranty of
 * MERCHANTABILITY or FITNESS FOR A PARTICULAR PURPOSE.  See the
 * GNU General Public License for more details.
 */

/*---------------------------------------------------------------------------
 * This file is autogenerated file using gcdb parser. Please do not edit it.
 * Update input XML file to add a new entry or update variable in this file
 * VERSION = "1.0"
 *---------------------------------------------------------------------------*/
&mdss_mdp {
	ss_dsi_panel_S6E8AA5X01_AMS561RA01_HD: ss_dsi_panel_S6E8AA5X01_AMS561RA01_HD {
		qcom,mdss-dsi-panel-name = "ss_dsi_panel_S6E8AA5X01_AMS561RA01_HD";
		qcom,mdss-dsi-panel-controller = <&mdss_dsi0>;
		qcom,mdss-dsi-panel-width = <720>;
		qcom,mdss-dsi-panel-height = <1480>;
		qcom,mdss-dsi-bpp = <24>;
		qcom,mdss-dsi-panel-destination = "display_1";

		qcom,mdss-dsi-panel-timings-phy-v2 = [
			1E 1B 04 06 02 03 04 a0
			1E 1B 04 06 02 03 04 a0
			1E 1B 04 06 02 03 04 a0
			1E 1B 04 06 02 03 04 a0
			1E 0D 04 05 02 03 04 a0];

		qcom,mdss-dsi-on-command= [
			05 01 00 00 14 00 02 11 00		/* Sleep out, wait 20ms(0x14) */

			/* Brightness condition set */
			29 01 00 00 00 00 03 F0 5A 5A		/* TEST KEY Enable */
			29 01 00 00 00 00 22 CA			/* 1) Gamma 2.2 Setting */
				01 00 01 00 01 00		/* V255 R,G,B */
				80 80 80			/* V203 R,G,B */
				80 80 80			/* V151 R,G,B */
				80 80 80			/* V87 R,G,B */
				80 80 80			/* V51 R,G,B */
				80 80 80			/* V35 R,G,B */
				80 80 80			/* V23 R,G,B */
				80 80 80			/* V11 R,G,B */
				80 80 80			/*  V3 R,G,B */
				00 00 00			/*  VT R,G,B */
			29 01 00 00 00 00 03 B2 00 10		/* AID set : AOR 0% */
			29 01 00 00 00 00 02 F7 03		/* Gamma, LTPS(AID) update */
			29 01 00 00 00 00 03 F0 A5 A5

			/* Pentile setting */
			29 01 00 00 00 00 03 F0 5A 5A		/* TEST KEY Enable */
			29 01 00 00 00 00 04 C0 D8 D8 00
			29 01 00 00 00 00 03 F0 A5 A5

			/* PCD Setting */
			29 01 00 00 00 00 03 F0 5A 5A		/* TEST KEY Enable */
			29 01 00 00 00 00 02 CC 4C 			/* high active*/
			29 01 00 00 00 00 03 F0 A5 A5

			/* Error Flag Setting */
			29 01 00 00 00 00 03 F0 5A 5A		/* TEST KEY Enable */
			29 01 00 00 00 00 05 E7 ED C7 23 67
			29 01 00 00 00 00 03 F0 A5 A5

			/* Display control Setting */
			29 01 00 00 00 00 03 F0 5A 5A		/* TEST KEY Enable */
			29 01 00 00 00 00 05 F2 0C 0C B9 01
			29 01 00 00 78 00 03 F0 A5 A5		/* TEST KEY Disable */
		];

		qcom,mdss-dsi-off-command=[
			05 01 00 00 0A 00 02 28 00	/* wait 10ms(0x0A) */
			05 01 00 00 96 00 02 10 00	/* wait 150ms(0x96) */
		];

		qcom,cont-splash-enabled;
		qcom,mdss-dsi-force-clock-lane-hs;

		qcom,mdss-dsi-t-clk-pre = <0x21>;
		qcom,mdss-dsi-t-clk-post = <0x0A>;

		qcom,mdss-dsi-h-pulse-width = <4>;
		qcom,mdss-dsi-h-back-porch = <8>;
		qcom,mdss-dsi-h-front-porch = <64>;
		qcom,mdss-dsi-h-sync-skew = <0>;

		qcom,mdss-dsi-v-pulse-width = <6>;
		qcom,mdss-dsi-v-back-porch = <6>;
		qcom,mdss-dsi-v-front-porch = <12>;

		qcom,mdss-dsi-h-left-border = <0>;
		qcom,mdss-dsi-h-right-border = <0>;
		qcom,mdss-dsi-v-top-border = <0>;
		qcom,mdss-dsi-v-bottom-border = <0>;

		qcom,mdss-dsi-panel-clockrate = <500290000>;

		qcom,mdss-dsi-underflow-color = <0xFF>;
		qcom,mdss-dsi-border-color = <0>;

		qcom,mdss-dsi-bl-pmic-control-type = "bl_ctrl_dcs";

		qcom,mdss-dsi-bl-min-level = <1>;
		qcom,mdss-dsi-bl-max-level = <365>;
		qcom,mdss-brightness-max-level = <365>;

		/*qcom,mdss-dsi-interleave-mode = <0>; */
		qcom,mdss-dsi-panel-type = "dsi_video_mode";

		/*qcom,mdss-dsi-te-check-enable;*/
		/*qcom,mdss-dsi-te-using-te-pin;*/
		/*qcom,mdss-dsi-te-pin-select = <1>;*/

		/*qcom,mdss-dsi-te-dcs-command = <1>;*/
		/*qcom,mdss-dsi-wr-mem-start = <0x2C>;*/
		/*qcom,mdss-dsi-wr-mem-continue = <0x3C>;*/

		/* CMD mode panel doesn't need below stuff */
		/*qcom,mdss-dsi-h-sync-pulse;*/
		/*qcom,mdss-dsi-hfp-power-mode=*/
		/*qcom,mdss-dsi-hbp-power-mode=*/
		/*qcom,mdss-dsi-hsa-power-mode=*/
		/*qcom,mdss-dsi-last-line-interleave=*/
		qcom,mdss-dsi-bllp-eof-power-mode;
		qcom,mdss-dsi-bllp-power-mode;
		qcom,mdss-dsi-traffic-mode= "burst_mode";
		qcom,mdss-dsi-pixel-packing = "loose";
		qcom,mdss-dsi-virtual-channel-id = <0>;
		qcom,mdss-dsi-color-order = "rgb_swap_rgb";
		qcom,mdss-dsi-lane-0-state;
		qcom,mdss-dsi-lane-1-state;
		qcom,mdss-dsi-lane-2-state;
		qcom,mdss-dsi-lane-3-state;
		qcom,mdss-dsi-lane-map = "lane_map_0123";

		qcom,mdss-dsi-stream = <0>;
		qcom,mdss-dsi-mdp-trigger = "none";
		qcom,mdss-dsi-dma-trigger = "trigger_sw";
		qcom,mdss-dsi-panel-framerate = <60>;

		qcom,mdss-dsi-on-command-state = "dsi_lp_mode";
		qcom,mdss-dsi-off-command-state = "dsi_hs_mode";

		qcom,mdss-pan-physical-width-dimension = <62>;
		qcom,mdss-pan-physical-height-dimension = <128>;

		qcom,mdss-dsi-panel-mode-gpio-state = "invalid";

		qcom,mdss-dsi-reset-sequence = <1 20>, <0 20>, <1 20>;

		qcom,mdss-dsi-lp11-init;
		qcom,mdss-dsi-init-delay-us = <2000>;//
		qcom,mdss-dsi-rx-eot-ignore;
		qcom,mdss-dsi-tx-eot-append;

		/*qcom,ulps-enabled*/
		/*qcom,mdss-dsi-panel-status-command=*/
		/*qcom,mdss-dsi-panel-status-command-mode="dsi_lp_mode";*/
		qcom,esd-check-enabled;
		qcom,mdss-dsi-panel-status-check-mode="reg_read_irq";
		qcom,mdss-dsi-panel-status-value = <1>;
		qcom,mdss-dsi-panel-status-irq-trigger1="rising";
		qcom,mdss-dsi-panel-status-read-length = <1>;
		/*qcom,dynamic-mode-switch-enabled*/
		/*qcom,video-to-cmd-mode-switch-commands=*/
		/*qcom,cmd-to-video-mode-switch-commands=*/
/*
 * ************************************************************************************************************************************
 *
 *
 *			Below  parameters are samsung dependent thigs
 *
 *
 * ************************************************************************************************************************************
 */
		samsung,support_panel_max = <1>;
		samsung,hw-config = "single_dsi";
		/*samsung,support_mdnie_lite;*/
		samsung,support_factory_panel_swap;

		samsung,mdss-power-on-reset-delay-us = <3000>;

		samsung,display_on_tx_cmds_revA = [05 01 00 00 00 00 02 29 00];
		samsung,display_off_tx_cmds_revA = [05 01 00 00 00 00 02 28 00];

		samsung,level1_key_enable_tx_cmds_revA = [
			29 01 00 00 00 00 03 F0 5A 5A
		];
		samsung,level1_key_disable_tx_cmds_revA = [
			29 01 00 00 00 00 03 F0 A5 A5
		];
		samsung,level2_key_enable_tx_cmds_revA = [
			29 00 00 00 00 00 03 F0 5A 5A
			29 01 00 00 00 00 03 FC 5A 5A
		];
		samsung,level2_key_disable_tx_cmds_revA = [
			29 00 00 00 00 00 03 F0 A5 A5
			29 01 00 00 00 00 03 FC A5 A5
		];

		samsung,packet_size_tx_cmds_revA = [
			37 01 00 00 00 00 02 07 00
		];

		/*
		 * First parameters can be changed
		 * by function of samsung_nv_read()
		 * because of that means offset of
		 * read position
		 */
		samsung,reg_read_pos_tx_cmds_revA = [
			15 01 00 00 00 00 02 B0 00
		];

		/*
		 * ************************************************************************************************************************
		 *	 06 01 00 00 00 00 01 c8 07 21
		 *	READ 0xC8 SIZE 0x07 OFFSET 0x21
		 * ************************************************************************************************************************
		 */
		samsung,smart_dimming_mtp_rx_cmds_revA = [ 06 01 00 00 00 00 01 c8 21 00];
		/* the last byte in all read commands will represent READ LENGH */
		samsung,manufacture_id0_rx_cmds_revA = [ 06 01 00 00 00 00 01 DA 01 00];
		samsung,manufacture_id1_rx_cmds_revA = [ 06 01 00 00 00 00 01 DB 01 00];
		samsung,manufacture_id2_rx_cmds_revA = [ 06 01 00 00 00 00 01 DC 01 00];

		samsung,manufacture_date_rx_cmds_revA = [ 06 01 00 00 00 00 01 C8 02 28];	/* read C8 41~42th , 40=0x28*/
		samsung,ddi_id_rx_cmds_revA = [ 06 01 00 00 00 00 01 D6 05 00];		/* read D6 1~5th *///
		samsung,cell_id_rx_cmds_revA = [ 06 01 00 00 00 00 01 C8 07 28];		/* read C8 41~47th, 40=0x28 */
		samsung,mtp_read_sysfs_rx_cmds_revA = [ 06 01 00 00 00 00 01 01 01 01];

		samsung,elvss_rx_cmds_revA = [ 06 01 00 00 00 00 01 B6 02 15];		/* read B6 22, 23th , 21=0x15*/
		samsung,mdnie_read_rx_cmds_revA	= [ 06 01 00 00 00 00 01 A1 04 00];

		/* samsung,ldi_debug0_rx_cmds_revA = [06 01 00 00 00 00 01 0A 01 00]; */
		/* samsung,ldi_debug1_rx_cmds_revA = [06 01 00 00 00 00 01 0E 01 00]; */
		/* samsung,ldi_debug2_rx_cmds_revA = [06 01 00 00 00 00 01 EA 08 00]; */

		/*
		 * ************************************************************************************************************************
		 *	 COMMON CMD LIST
		 * ************************************************************************************************************************
		 */

		samsung,elvss_lowtemp_tx_cmds_revA = [
			29 01 00 00 00 00 02 B8 19
		];	/* Low Temperature Command */

		samsung,elvss_lowtemp2_tx_cmds_revA = [
			29 01 00 00 00 00 02 B0 15
			29 01 00 00 00 00 02 B6 00
		];	/* Low Temperature Command: default */

		samsung,gamma_tx_cmds_revA = [
			29 01 00 00 00 00 22 CA	/* 1) Gamma 2.2 Setting */
				01 00 01 00 01 00	/* V255 R,G,B */
				80 80 80		/* V203 R,G,B */
				80 80 80		/* V151 R,G,B */
				80 80 80		/* V87 R,G,B */
				80 80 80		/* V51 R,G,B */
				80 80 80		/* V35 R,G,B */
				80 80 80		/* V23 R,G,B */
				80 80 80		/* V11 R,G,B */
				80 80 80		/*  V3 R,G,B */
				00 00 00		/*  VT R,G,B */
			29 01 00 00 00 00 02 00 00
			29 01 00 00 00 00 02 F7 03	/* Gamma, LTPS(AID) update */
		];

		/*
		* ************************************************************************************************************************
		*  HBM
		* ************************************************************************************************************************
		*/
		//samsung,enter_hbm_lux = <10000>;

		samsung,hbm_rx_cmds_revA  = [ 06 01 00 00 00 00 01 B4 04 00];	/* read B4 1th~4th */
		samsung,hbm2_rx_cmds_revA = [ 06 01 00 00 00 00 01 B4 1D 04];	/* read B4 5th~33th */

		samsung,hbm_gamma_tx_cmds_revA = [
			29 01 00 00 00 00 22 CA
				01 00 01 00 01 00
				80 80 80
				80 80 80
				80 80 80
				80 80 80
				80 80 80
				80 80 80
				80 80 80
				80 80 80
				00 00 00
			29 01 00 00 00 00 03 B2 00 C2		// AID set : AOR 10%
			29 01 00 00 00 00 02 F7 03
		];

		samsung,hbm_etc_tx_cmds_revA = [		// HBM interpolation: 465~578 + 600 nit
			29 01 00 00 00 00 03 B2 00 C2		// AID set : AOR 10%
			29 01 00 00 00 00 03 B6 BC 12		// HBM ELVSS (B6h : 2nd Para)
			29 01 00 00 00 00 02 B0 15		// Global para(21th)
			29 01 00 00 00 00 02 B6 00		// HBM ELVSS (B6h : 22nd Para)
			29 01 00 00 00 00 05 B5 50 99 14 0A	// ACL OPR 32 Frame Average, 60% StartPoint, 15% ACL
			29 01 00 00 00 00 02 55 02		// ACL ON
			29 01 00 00 00 00 03 F4 7B 1E		// VINT
			29 01 00 00 00 00 02 53 00		// HBM Off
			29 01 00 00 00 00 02 F7 03		// Gamma, LTPS(AID) update
		];

		samsung,hbm_off_tx_cmds_revA = [
			29 01 00 00 00 00 02 53 00		/* HBM Off */
		];

		/*
		 * ************************************************************************************************************************
		 * AID command list and mappings
		 * ************************************************************************************************************************
		 */
		/* bl_level, Index in acl command list */
		samsung,aid_tx_cmds_revA = [
			29 01 00 00 00 00 03 B2 09 02	/*	5	CD :	0	*/
			29 01 00 00 00 00 03 B2 09 02	/*	6	CD :	1	*/
			29 01 00 00 00 00 03 B2 09 02	/*	7	CD :	2	*/
			29 01 00 00 00 00 03 B2 09 02	/*	8	CD :	3	*/
			29 01 00 00 00 00 03 B2 09 02	/*	9	CD :	4	*/
			29 01 00 00 00 00 03 B2 09 02	/*	10	CD :	5	*/
			29 01 00 00 00 00 03 B2 09 02	/*	11	CD :	6	*/
			29 01 00 00 00 00 03 B2 09 02	/*	12	CD :	7	*/
			29 01 00 00 00 00 03 B2 09 02	/*	13	CD :	8	*/
			29 01 00 00 00 00 03 B2 09 02	/*	14	CD :	9	*/
			29 01 00 00 00 00 03 B2 09 02	/*	15	CD :	10	*/
			29 01 00 00 00 00 03 B2 09 02	/*	16	CD :	11	*/
			29 01 00 00 00 00 03 B2 09 02	/*	17	CD :	12	*/
			29 01 00 00 00 00 03 B2 09 02	/*	19	CD :	13	*/
			29 01 00 00 00 00 03 B2 09 02	/*	20	CD :	14	*/
			29 01 00 00 00 00 03 B2 09 02	/*	21	CD :	15	*/
			29 01 00 00 00 00 03 B2 09 02	/*	22	CD :	16	*/
			29 01 00 00 00 00 03 B2 09 02	/*	24	CD :	17	*/
			29 01 00 00 00 00 03 B2 09 02	/*	25	CD :	18	*/
			29 01 00 00 00 00 03 B2 09 02	/*	27	CD :	19	*/
			29 01 00 00 00 00 03 B2 09 02	/*	29	CD :	20	*/
			29 01 00 00 00 00 03 B2 09 02	/*	30	CD :	21	*/
			29 01 00 00 00 00 03 B2 09 02	/*	32	CD :	22	*/
			29 01 00 00 00 00 03 B2 09 02	/*	34	CD :	23	*/
			29 01 00 00 00 00 03 B2 09 02	/*	37	CD :	24	*/
			29 01 00 00 00 00 03 B2 09 02	/*	39	CD :	25	*/
			29 01 00 00 00 00 03 B2 09 02	/*	41	CD :	26	*/
			29 01 00 00 00 00 03 B2 09 02	/*	44	CD :	27	*/
			29 01 00 00 00 00 03 B2 09 02	/*	47	CD :	28	*/
			29 01 00 00 00 00 03 B2 09 02	/*	50	CD :	29	*/
			29 01 00 00 00 00 03 B2 09 02	/*	53	CD :	30	*/
			29 01 00 00 00 00 03 B2 09 02	/*	56	CD :	31	*/
			29 01 00 00 00 00 03 B2 09 02	/*	60	CD :	32	*/
			29 01 00 00 00 00 03 B2 09 02	/*	64	CD :	33	*/
			29 01 00 00 00 00 03 B2 09 02	/*	68	CD :	34	*/
			29 01 00 00 00 00 03 B2 09 02	/*	72	CD :	35	*/
			29 01 00 00 00 00 03 B2 09 02	/*	77	CD :	36	*/
			29 01 00 00 00 00 03 B2 09 02	/*	82	CD :	37	*/
			29 01 00 00 00 00 03 B2 09 02	/*	87	CD :	38	*/
			29 01 00 00 00 00 03 B2 09 02	/*	93	CD :	39	*/
			29 01 00 00 00 00 03 B2 09 02	/*	98	CD :	40	*/
			29 01 00 00 00 00 03 B2 09 02	/*	105	CD :	41	*/
			29 01 00 00 00 00 03 B2 09 02	/*	111	CD :	42	*/
			29 01 00 00 00 00 03 B2 09 02	/*	119	CD :	43	*/
			29 01 00 00 00 00 03 B2 09 02	/*	126	CD :	44	*/
			29 01 00 00 00 00 03 B2 09 02	/*	134	CD :	45	*/
			29 01 00 00 00 00 03 B2 09 02	/*	143	CD :	46	*/
			29 01 00 00 00 00 03 B2 09 02	/*	152	CD :	47	*/
			29 01 00 00 00 00 03 B2 09 02	/*	162	CD :	48	*/
			29 01 00 00 00 00 03 B2 09 02	/*	172	CD :	49	*/
			29 01 00 00 00 00 03 B2 09 02	/*	183	CD :	50	*/
			29 01 00 00 00 00 03 B2 09 02	/*	195	CD :	51	*/
			29 01 00 00 00 00 03 B2 09 02	/*	207	CD :	52	*/
			29 01 00 00 00 00 03 B2 09 02	/*	220	CD :	53	*/
			29 01 00 00 00 00 03 B2 09 02	/*	234	CD :	54	*/
			29 01 00 00 00 00 03 B2 09 02	/*	249	CD :	55	*/
			29 01 00 00 00 00 03 B2 09 02	/*	265	CD :	56	*/
			29 01 00 00 00 00 03 B2 09 02	/*	282	CD :	57	*/
			29 01 00 00 00 00 03 B2 09 02	/*	300	CD :	58	*/
			29 01 00 00 00 00 03 B2 09 02	/*	316	CD :	59	*/
			29 01 00 00 00 00 03 B2 09 02	/*	333	CD :	60	*/
			29 01 00 00 00 00 03 B2 09 02	/*	360	CD :	61	*/
		];

		samsung,aid_subdivision_tx_cmds_revA = [
			29 01 00 00 00 00 03 B2 70 7B  /*   0 */
			29 01 00 00 00 00 03 B2 70 79  /*   1 */
			29 01 00 00 00 00 03 B2 70 75  /*   2 */
			29 01 00 00 00 00 03 B2 70 73  /*   3 */
			29 01 00 00 00 00 03 B2 70 6F  /*   4 */
			29 01 00 00 00 00 03 B2 70 6D  /*   5 */
			29 01 00 00 00 00 03 B2 70 6C  /*   6 */
			29 01 00 00 00 00 03 B2 70 6B  /*   7 */
			29 01 00 00 00 00 03 B2 70 6A  /*   8 */
			29 01 00 00 00 00 03 B2 70 69  /*   9 */
			29 01 00 00 00 00 03 B2 70 62  /*  10 */
			29 01 00 00 00 00 03 B2 70 5F  /*  11 */
			29 01 00 00 00 00 03 B2 70 5E  /*  12 */
			29 01 00 00 00 00 03 B2 70 5D  /*  13 */
			29 01 00 00 00 00 03 B2 70 5C  /*  14 */
			29 01 00 00 00 00 03 B2 70 5B  /*  15 */
			29 01 00 00 00 00 03 B2 70 5A  /*  16 */
			29 01 00 00 00 00 03 B2 70 59  /*  17 */
			29 01 00 00 00 00 03 B2 70 53  /*  18 */
			29 01 00 00 00 00 03 B2 70 4F  /*  19 */
			29 01 00 00 00 00 03 B2 70 4E  /*  20 */
			29 01 00 00 00 00 03 B2 70 4D  /*  21 */
			29 01 00 00 00 00 03 B2 70 4C  /*  22 */
			29 01 00 00 00 00 03 B2 70 4B  /*  23 */
			29 01 00 00 00 00 03 B2 70 49  /*  24 */
			29 01 00 00 00 00 03 B2 70 46  /*  25 */
			29 01 00 00 00 00 03 B2 70 42  /*  26 */
			29 01 00 00 00 00 03 B2 70 3F  /*  27 */
			29 01 00 00 00 00 03 B2 70 3E  /*  28 */
			29 01 00 00 00 00 03 B2 70 3D  /*  29 */
			29 01 00 00 00 00 03 B2 70 3C  /*  30 */
			29 01 00 00 00 00 03 B2 70 3B  /*  31 */
			29 01 00 00 00 00 03 B2 70 3A  /*  32 */
			29 01 00 00 00 00 03 B2 70 3A  /*  33 */
			29 01 00 00 00 00 03 B2 70 39  /*  34 */
			29 01 00 00 00 00 03 B2 70 32  /*  35 */
			29 01 00 00 00 00 03 B2 70 2B  /*  36 */
			29 01 00 00 00 00 03 B2 70 24  /*  37 */
			29 01 00 00 00 00 03 B2 70 1C  /*  38 */
			29 01 00 00 00 00 03 B2 70 14  /*  39 */
			29 01 00 00 00 00 03 B2 70 0D  /*  40 */
			29 01 00 00 00 00 03 B2 70 0A  /*  41 */
			29 01 00 00 00 00 03 B2 70 07  /*  42 */
			29 01 00 00 00 00 03 B2 70 00  /*  43 */
			29 01 00 00 00 00 03 B2 60 F9  /*  44 */
			29 01 00 00 00 00 03 B2 60 F2  /*  45 */
			29 01 00 00 00 00 03 B2 60 EB  /*  46 */
			29 01 00 00 00 00 03 B2 60 E3  /*  47 */
			29 01 00 00 00 00 03 B2 60 DA  /*  48 */
			29 01 00 00 00 00 03 B2 60 D2  /*  49 */
			29 01 00 00 00 00 03 B2 60 CB  /*  50 */
			29 01 00 00 00 00 03 B2 60 C4  /*  51 */
			29 01 00 00 00 00 03 B2 60 BC  /*  52 */
			29 01 00 00 00 00 03 B2 60 B3  /*  53 */
			29 01 00 00 00 00 03 B2 60 AB  /*  54 */
			29 01 00 00 00 00 03 B2 60 9B  /*  55 */
			29 01 00 00 00 00 03 B2 60 8B  /*  56 */
			29 01 00 00 00 00 03 B2 60 78  /*  57 */
			29 01 00 00 00 00 03 B2 60 71  /*  58 */
			29 01 00 00 00 00 03 B2 60 69  /*  59 */
			29 01 00 00 00 00 03 B2 60 62  /*  60 */
			29 01 00 00 00 00 03 B2 60 5B  /*  61 */
			29 01 00 00 00 00 03 B2 60 4B  /*  62 */
			29 01 00 00 00 00 03 B2 60 3A  /*  63 */
			29 01 00 00 00 00 03 B2 60 33  /*  64 */
			29 01 00 00 00 00 03 B2 60 2C  /*  65 */
			29 01 00 00 00 00 03 B2 60 1D  /*  66 */
			29 01 00 00 00 00 03 B2 60 0E  /*  67 */
			29 01 00 00 00 00 03 B2 60 02  /*  68 */
			29 01 00 00 00 00 03 B2 50 F6  /*  69 */
			29 01 00 00 00 00 03 B2 50 DE  /*  70 */
			29 01 00 00 00 00 03 B2 50 D3  /*  71 */
			29 01 00 00 00 00 03 B2 50 C8  /*  72 */
			29 01 00 00 00 00 03 B2 50 BA  /*  73 */
			29 01 00 00 00 00 03 B2 50 AB  /*  74 */
			29 01 00 00 00 00 03 B2 50 95  /*  75 */
			29 01 00 00 00 00 03 B2 50 7E  /*  76 */
			29 01 00 00 00 00 03 B2 50 6E  /*  77 */
			29 01 00 00 00 00 03 B2 50 5E  /*  78 */
			29 01 00 00 00 00 03 B2 50 4D  /*  79 */
			29 01 00 00 00 00 03 B2 50 3C  /*  80 */
			29 01 00 00 00 00 03 B2 50 25  /*  81 */
			29 01 00 00 00 00 03 B2 50 0F  /*  82 */
			29 01 00 00 00 00 03 B2 40 F7  /*  83 */
			29 01 00 00 00 00 03 B2 40 DF  /*  84 */
			29 01 00 00 00 00 03 B2 40 C6  /*  85 */
			29 01 00 00 00 00 03 B2 40 AD  /*  86 */
			29 01 00 00 00 00 03 B2 40 9B  /*  87 */
			29 01 00 00 00 00 03 B2 40 8A  /*  88 */
			29 01 00 00 00 00 03 B2 40 6F  /*  89 */
			29 01 00 00 00 00 03 B2 40 54  /*  90 */
			29 01 00 00 00 00 03 B2 40 36  /*  91 */
			29 01 00 00 00 00 03 B2 40 18  /*  92 */
			29 01 00 00 00 00 03 B2 30 F7  /*  93 */
			29 01 00 00 00 00 03 B2 30 D6  /*  94 */
			29 01 00 00 00 00 03 B2 30 B6  /*  95 */
			29 01 00 00 00 00 03 B2 30 96  /*  96 */
			29 01 00 00 00 00 03 B2 30 76  /*  97 */
			29 01 00 00 00 00 03 B2 30 55  /*  98 */
			29 01 00 00 00 00 03 B2 30 64  /*  99 */
			29 01 00 00 00 00 03 B2 30 40  /* 100 */
			29 01 00 00 00 00 03 B2 30 62  /* 101 */
			29 01 00 00 00 00 03 B2 30 40  /* 102 */
			29 01 00 00 00 00 03 B2 30 60  /* 103 */
			29 01 00 00 00 00 03 B2 30 40  /* 104 */
			29 01 00 00 00 00 03 B2 30 64  /* 105 */
			29 01 00 00 00 00 03 B2 30 40  /* 106 */
			29 01 00 00 00 00 03 B2 30 5C  /* 107 */
			29 01 00 00 00 00 03 B2 30 40  /* 108 */
			29 01 00 00 00 00 03 B2 30 65  /* 109 */
			29 01 00 00 00 00 03 B2 30 40  /* 110 */
			29 01 00 00 00 00 03 B2 30 5E  /* 111 */
			29 01 00 00 00 00 03 B2 30 40  /* 112 */
			29 01 00 00 00 00 03 B2 30 65  /* 113 */
			29 01 00 00 00 00 03 B2 30 40  /* 114 */
			29 01 00 00 00 00 03 B2 30 5F  /* 115 */
			29 01 00 00 00 00 03 B2 30 40  /* 116 */
			29 01 00 00 00 00 03 B2 30 61  /* 117 */
			29 01 00 00 00 00 03 B2 30 40  /* 118 */
			29 01 00 00 00 00 03 B2 30 63  /* 119 */
			29 01 00 00 00 00 03 B2 30 40  /* 120 */
			29 01 00 00 00 00 03 B2 30 61  /* 121 */
			29 01 00 00 00 00 03 B2 30 40  /* 122 */
			29 01 00 00 00 00 03 B2 30 62  /* 123 */
			29 01 00 00 00 00 03 B2 30 40  /* 124 */
			29 01 00 00 00 00 03 B2 30 60  /* 125 */
			29 01 00 00 00 00 03 B2 30 40  /* 126 */
			29 01 00 00 00 00 03 B2 30 61  /* 127 */
			29 01 00 00 00 00 03 B2 30 40  /* 128 */
			29 01 00 00 00 00 03 B2 30 34  /* 129 */
			29 01 00 00 00 00 03 B2 30 29  /* 130 */
			29 01 00 00 00 00 03 B2 30 1D  /* 131 */
			29 01 00 00 00 00 03 B2 30 12  /* 132 */
			29 01 00 00 00 00 03 B2 30 06  /* 133 */
			29 01 00 00 00 00 03 B2 20 FB  /* 134 */
			29 01 00 00 00 00 03 B2 20 EF  /* 135 */
			29 01 00 00 00 00 03 B2 20 E3  /* 136 */
			29 01 00 00 00 00 03 B2 20 D7  /* 137 */
			29 01 00 00 00 00 03 B2 20 CB  /* 138 */
			29 01 00 00 00 00 03 B2 20 C0  /* 139 */
			29 01 00 00 00 00 03 B2 20 B4  /* 140 */
			29 01 00 00 00 00 03 B2 20 A8  /* 141 */
			29 01 00 00 00 00 03 B2 20 9C  /* 142 */
			29 01 00 00 00 00 03 B2 20 8E  /* 143 */
			29 01 00 00 00 00 03 B2 20 80  /* 144 */
			29 01 00 00 00 00 03 B2 20 72  /* 145 */
			29 01 00 00 00 00 03 B2 20 64  /* 146 */
			29 01 00 00 00 00 03 B2 20 56  /* 147 */
			29 01 00 00 00 00 03 B2 20 48  /* 148 */
			29 01 00 00 00 00 03 B2 20 3A  /* 149 */
			29 01 00 00 00 00 03 B2 20 2C  /* 150 */
			29 01 00 00 00 00 03 B2 20 1E  /* 151 */
			29 01 00 00 00 00 03 B2 20 11  /* 152 */
			29 01 00 00 00 00 03 B2 20 03  /* 153 */
			29 01 00 00 00 00 03 B2 10 F5  /* 154 */
			29 01 00 00 00 00 03 B2 10 E7  /* 155 */
			29 01 00 00 00 00 03 B2 10 DA  /* 156 */
			29 01 00 00 00 00 03 B2 10 CC  /* 157 */
			29 01 00 00 00 00 03 B2 10 E1  /* 158 */
			29 01 00 00 00 00 03 B2 10 D5  /* 159 */
			29 01 00 00 00 00 03 B2 10 CA  /* 160 */
			29 01 00 00 00 00 03 B2 10 BE  /* 161 */
			29 01 00 00 00 00 03 B2 10 B3  /* 162 */
			29 01 00 00 00 00 03 B2 10 A7  /* 163 */
			29 01 00 00 00 00 03 B2 10 9C  /* 164 */
			29 01 00 00 00 00 03 B2 10 90  /* 165 */
			29 01 00 00 00 00 03 B2 10 E2  /* 166 */
			29 01 00 00 00 00 03 B2 10 D8  /* 167 */
			29 01 00 00 00 00 03 B2 10 CE  /* 168 */
			29 01 00 00 00 00 03 B2 10 C4  /* 169 */
			29 01 00 00 00 00 03 B2 10 B9  /* 170 */
			29 01 00 00 00 00 03 B2 10 AF  /* 171 */
			29 01 00 00 00 00 03 B2 10 A5  /* 172 */
			29 01 00 00 00 00 03 B2 10 9A  /* 173 */
			29 01 00 00 00 00 03 B2 10 90  /* 174 */
			29 01 00 00 00 00 03 B2 10 E2  /* 175 */
			29 01 00 00 00 00 03 B2 10 D8  /* 176 */
			29 01 00 00 00 00 03 B2 10 CE  /* 177 */
			29 01 00 00 00 00 03 B2 10 C3  /* 178 */
			29 01 00 00 00 00 03 B2 10 B9  /* 179 */
			29 01 00 00 00 00 03 B2 10 AF  /* 180 */
			29 01 00 00 00 00 03 B2 10 A5  /* 181 */
			29 01 00 00 00 00 03 B2 10 9A  /* 182 */
			29 01 00 00 00 00 03 B2 10 90  /* 183 */
			29 01 00 00 00 00 03 B2 10 E3  /* 184 */
			29 01 00 00 00 00 03 B2 10 DA  /* 185 */
			29 01 00 00 00 00 03 B2 10 D1  /* 186 */
			29 01 00 00 00 00 03 B2 10 C7  /* 187 */
			29 01 00 00 00 00 03 B2 10 BE  /* 188 */
			29 01 00 00 00 00 03 B2 10 B5  /* 189 */
			29 01 00 00 00 00 03 B2 10 AC  /* 190 */
			29 01 00 00 00 00 03 B2 10 A2  /* 191 */
			29 01 00 00 00 00 03 B2 10 99  /* 192 */
			29 01 00 00 00 00 03 B2 10 90  /* 193 */
			29 01 00 00 00 00 03 B2 10 D4  /* 194 */
			29 01 00 00 00 00 03 B2 10 CA  /* 195 */
			29 01 00 00 00 00 03 B2 10 C1  /* 196 */
			29 01 00 00 00 00 03 B2 10 B7  /* 197 */
			29 01 00 00 00 00 03 B2 10 AD  /* 198 */
			29 01 00 00 00 00 03 B2 10 A3  /* 199 */
			29 01 00 00 00 00 03 B2 10 9A  /* 200 */
			29 01 00 00 00 00 03 B2 10 90  /* 201 */
			29 01 00 00 00 00 03 B2 10 D6  /* 202 */
			29 01 00 00 00 00 03 B2 10 CD  /* 203 */
			29 01 00 00 00 00 03 B2 10 C4  /* 204 */
			29 01 00 00 00 00 03 B2 10 BC  /* 205 */
			29 01 00 00 00 00 03 B2 10 B3  /* 206 */
			29 01 00 00 00 00 03 B2 10 AA  /* 207 */
			29 01 00 00 00 00 03 B2 10 A1  /* 208 */
			29 01 00 00 00 00 03 B2 10 99  /* 209 */
			29 01 00 00 00 00 03 B2 10 90  /* 210 */
			29 01 00 00 00 00 03 B2 10 D2  /* 211 */
			29 01 00 00 00 00 03 B2 10 CA  /* 212 */
			29 01 00 00 00 00 03 B2 10 C2  /* 213 */
			29 01 00 00 00 00 03 B2 10 B9  /* 214 */
			29 01 00 00 00 00 03 B2 10 B1  /* 215 */
			29 01 00 00 00 00 03 B2 10 A9  /* 216 */
			29 01 00 00 00 00 03 B2 10 A1  /* 217 */
			29 01 00 00 00 00 03 B2 10 98  /* 218 */
			29 01 00 00 00 00 03 B2 10 90  /* 219 */
			29 01 00 00 00 00 03 B2 10 A7  /* 220 */
			29 01 00 00 00 00 03 B2 10 9F  /* 221 */
			29 01 00 00 00 00 03 B2 10 98  /* 222 */
			29 01 00 00 00 00 03 B2 10 90  /* 223 */
			29 01 00 00 00 00 03 B2 10 A9  /* 224 */
			29 01 00 00 00 00 03 B2 10 A1  /* 225 */
			29 01 00 00 00 00 03 B2 10 98  /* 226 */
			29 01 00 00 00 00 03 B2 10 90  /* 227 */
			29 01 00 00 00 00 03 B2 10 84  /* 228 */
			29 01 00 00 00 00 03 B2 10 79  /* 229 */
			29 01 00 00 00 00 03 B2 10 6D  /* 230 */
			29 01 00 00 00 00 03 B2 10 61  /* 231 */
			29 01 00 00 00 00 03 B2 10 56  /* 232 */
			29 01 00 00 00 00 03 B2 10 4A  /* 233 */
			29 01 00 00 00 00 03 B2 10 3E  /* 234 */
			29 01 00 00 00 00 03 B2 10 36  /* 235 */
			29 01 00 00 00 00 03 B2 10 2D  /* 236 */
			29 01 00 00 00 00 03 B2 10 25  /* 237 */
			29 01 00 00 00 00 03 B2 10 1D  /* 238 */
			29 01 00 00 00 00 03 B2 10 11  /* 239 */
			29 01 00 00 00 00 03 B2 10 06  /* 240 */
			29 01 00 00 00 00 03 B2 00 FA  /* 241 */
			29 01 00 00 00 00 03 B2 00 EE  /* 242 */
			29 01 00 00 00 00 03 B2 00 DC  /* 243 */
			29 01 00 00 00 00 03 B2 00 D3  /* 244 */
			29 01 00 00 00 00 03 B2 00 CB  /* 245 */
			29 01 00 00 00 00 03 B2 00 C2  /* 246 */
			29 01 00 00 00 00 03 B2 00 DF  /* 247 */
			29 01 00 00 00 00 03 B2 00 D5  /* 248 */
			29 01 00 00 00 00 03 B2 00 CC  /* 249 */
			29 01 00 00 00 00 03 B2 00 C2  /* 250 */
			29 01 00 00 00 00 03 B2 00 DB  /* 251 */
			29 01 00 00 00 00 03 B2 00 D3  /* 252 */
			29 01 00 00 00 00 03 B2 00 CA  /* 253 */
			29 01 00 00 00 00 03 B2 00 C2  /* 254 */
			29 01 00 00 00 00 03 B2 00 C2  /* 255 */
		];

		/* bl_level, Index in acl command list */
		samsung,aid_map_table_revA = <
			5	0		6	1		7	2		8	3		9	4
			10	5		11	6		12	7		13	8		14	9
			15	10		16	11		17	12		19	13		20	14
			21	15		22	16		24	17		25	18		27	19
			29	20		30	21		32	22		34	23		37	24
			39	25		41	26		44	27		47	28		50	29
			53	30		56	31		60	32		64	33		68	34
			72	35		77	36		83	37		87	38		93	39
			98	40		105 41		111	42		119	43		126	44
			134	45		143	46		152	47		162	48		172	49
			183	50		195	51		207	52		220	53		234	54
			249	55		265	56		282	57		300	58		316	59
			333	60		360	61
			>;

		/*
		 * ************************************************************************************************************************
		 * ACL command list and mappings
		 * ************************************************************************************************************************
		 */
		samsung,acl_on_tx_cmds_revA = [
			29 01 00 00 00 00 05 B5 50 7F 14 14	/* ACL 32Frame Averaging,50% StartPoint, 15% ACL */
			29 01 00 00 00 00 02 55 02		/* ACL 15%(default) ON */
		];

		samsung,acl_percent_tx_cmds_revA = [//
			29 01 00 00 00 00 06 B5 50 80 64 48 2A  /* 1th : 0x50 32frame avg, 2 3th : 0x80 0x64 start point 60%, 5th: 0x2A ACL 8% */
			29 01 00 00 00 00 06 B5 50 40 FC 48 4F  /* 1th : 0x50 32frame avg, 2 3th : 0x40 0xFC start point 50%, 5th: 0x4F ACL 15% */
		];

		samsung,acl_off_tx_cmds_revA = [
			29 01 00 00 00 00 02 B5 40	/* 16 Frame Avg. */
			29 01 00 00 00 00 02 55 00	/* ACL OFF */
		];

		/* bl_level , Index in acl command list */
		samsung,acl_map_table_revA =  <
			2	2		3	2		4	2		5	2		6	2
			7	2		8	2		9	2		10	2		11	2
			12	2		13	2		14	2		15	2		16	2
			17	2		19	2		20	2		21	2		22	2
			24	2		25	2		27	2		29	2		30	2
			32	2		34	2		37	2		39	2		41	2
			44	2		47	2		50	2		53	2		56	2
			60	2		64	2		68	2		72	2		77	2
			82	2		87	2		93	2		98	2		105	2
			111	2		119	2		126	2		134	2		143	2
			152	2		162	2		172	2		183	2		195	2
			207	2		220	2		234	2		249	2		265	2
			282	2		300	2		316	2		333	2		350	2
			357	2		365	2		372	2		380	2		387	2
			395	2		403	2		412	2		420	2
		>;

		/*
		 * ************************************************************************************************************************
		 * SMART ACL(ACL On) ELVSS command list and mappings
		 * ************************************************************************************************************************
		 */
		samsung,elvss_high_tx_cmds_revA = [
			29 01 00 00 00 00 18 B5 19 DC 04 01 34 67 9A CD 01 22 33 44 C0 00 09 99 33 13 01 11 10 00 00 /* 0  420CD ~ 412CD */
			29 01 00 00 00 00 18 B5 19 DC 05 01 34 67 9A CD 01 22 33 44 C0 00 09 99 33 13 01 11 10 00 00 /* 1  403CD ~ 387CD */
			29 01 00 00 00 00 18 B5 19 DC 06 01 34 67 9A CD 01 22 33 44 C0 00 09 99 33 13 01 11 10 00 00 /* 2  380CD ~ 357CD */
			29 01 00 00 00 00 18 B5 19 DC 07 01 34 67 9A CD 01 22 33 44 C0 00 09 99 33 13 01 11 10 00 00 /* 3  350CD */
			29 01 00 00 00 00 18 B5 19 DC 08 01 34 67 9A CD 01 22 33 44 C0 00 09 99 33 13 01 11 10 00 00 /* 4  333CD */
			29 01 00 00 00 00 18 B5 19 DC 09 01 34 67 9A CD 01 22 33 44 C0 00 09 99 33 13 01 11 10 00 00 /* 5  316CD */
			29 01 00 00 00 00 18 B5 19 DC 0A 01 34 67 9A CD 01 22 33 44 C0 00 09 99 33 13 01 11 10 00 00 /* 6  300CD */
			29 01 00 00 00 00 18 B5 19 DC 0B 01 34 67 9A CD 01 22 33 44 C0 00 09 99 33 13 01 11 10 00 00 /* 7  282CD */
			29 01 00 00 00 00 18 B5 19 DC 0C 01 34 67 9A CD 01 22 33 44 C0 00 09 99 33 13 01 11 10 00 00 /* 8  265CD ~ 234CD */
			29 01 00 00 00 00 18 B5 19 DC 0D 01 34 67 9A CD 01 22 33 44 C0 00 09 99 33 13 01 11 10 00 00 /* 9  220CD ~ 183CD */
			29 01 00 00 00 00 18 B5 19 DC 0E 01 34 67 9A CD 01 22 33 44 C0 00 09 99 33 13 01 11 10 00 00 /* 10 172CD */
			29 01 00 00 00 00 18 B5 19 DC 0F 01 34 67 9A CD 01 22 33 44 C0 00 09 99 33 13 01 11 10 00 00 /* 11 162CD */
			29 01 00 00 00 00 18 B5 19 DC 10 01 34 67 9A CD 01 22 33 44 C0 00 09 99 33 13 01 11 10 00 00 /* 12 152CD ~ 143CD */
			29 01 00 00 00 00 18 B5 19 DC 11 01 34 67 9A CD 01 22 33 44 C0 00 09 99 33 13 01 11 10 00 00 /* 13 134CD ~ 126CD */
			29 01 00 00 00 00 18 B5 19 DC 12 01 34 67 9A CD 01 22 33 44 C0 00 09 99 33 13 01 11 10 00 00 /* 14 119CD ~ 111CD */
			29 01 00 00 00 00 18 B5 19 DC 13 01 34 67 9A CD 01 22 33 44 C0 00 09 99 33 13 01 11 10 00 00 /* 15 105CD ~ 98CD */
			29 01 00 00 00 00 18 B5 19 DC 14 01 34 67 9A CD 01 22 33 44 C0 00 09 99 33 13 01 11 10 00 00 /* 16 93CD ~ 82CD */
			29 01 00 00 00 00 18 B5 19 DC 15 01 34 67 9A CD 01 22 33 44 C0 00 09 99 33 13 01 11 10 00 00 /* 17 77CD ~ 41CD */
			29 01 00 00 00 00 18 B5 19 CC 15 01 34 67 9A CD 01 22 33 44 C0 00 09 99 33 13 01 11 10 00 00 /* 18 39CD ~ 16CD */
			29 01 00 00 00 00 18 B5 19 CC 14 01 34 67 9A CD 01 22 33 44 C0 00 09 99 33 13 01 11 10 00 00 /* 19 15CD */
			29 01 00 00 00 00 18 B5 19 CC 12 01 34 67 9A CD 01 22 33 44 C0 00 09 99 33 13 01 11 10 00 00 /* 20 14CD */
			29 01 00 00 00 00 18 B5 19 CC 10 01 34 67 9A CD 01 22 33 44 C0 00 09 99 33 13 01 11 10 00 00 /* 21 13CD */
			29 01 00 00 00 00 18 B5 19 CC 0E 01 34 67 9A CD 01 22 33 44 C0 00 09 99 33 13 01 11 10 00 00 /* 22 12CD */
			29 01 00 00 00 00 18 B5 19 CC 0D 01 34 67 9A CD 01 22 33 44 C0 00 09 99 33 13 01 11 10 00 00 /* 23 11CD */
			29 01 00 00 00 00 18 B5 19 CC 0C 01 34 67 9A CD 01 22 33 44 C0 00 09 99 33 13 01 11 10 00 00 /* 24 10CD */
			29 01 00 00 00 00 18 B5 19 CC 0B 01 34 67 9A CD 01 22 33 44 C0 00 09 99 33 13 01 11 10 00 00 /* 25 9CD */
			29 01 00 00 00 00 18 B5 19 CC 0A 01 34 67 9A CD 01 22 33 44 C0 00 09 99 33 13 01 11 10 00 00 /* 26 8CD */
			29 01 00 00 00 00 18 B5 19 CC 09 01 34 67 9A CD 01 22 33 44 C0 00 09 99 33 13 01 11 10 00 00 /* 27 7CD */
			29 01 00 00 00 00 18 B5 19 CC 08 01 34 67 9A CD 01 22 33 44 C0 00 09 99 33 13 01 11 10 00 00 /* 28 6CD */
			29 01 00 00 00 00 18 B5 19 CC 07 01 34 67 9A CD 01 22 33 44 C0 00 09 99 33 13 01 11 10 00 00 /* 29 5CD */
			29 01 00 00 00 00 18 B5 19 CC 06 01 34 67 9A CD 01 22 33 44 C0 00 09 99 33 13 01 11 10 00 00 /* 30 4CD */
			29 01 00 00 00 00 18 B5 19 CC 05 01 34 67 9A CD 01 22 33 44 C0 00 09 99 33 13 01 11 10 00 00 /* 31 3CD */
			29 01 00 00 00 00 18 B5 19 CC 04 01 34 67 9A CD 01 22 33 44 C0 00 09 99 33 13 01 11 10 00 00 /* 32 2CD */
		];

		samsung,elvss_mid_tx_cmds_revA = [
			29 01 00 00 00 00 18 B5 19 DC 04 01 34 67 9A CD 01 22 33 44 C0 00 09 99 33 13 01 11 10 00 00 /* 0  420CD ~ 412CD */
			29 01 00 00 00 00 18 B5 19 DC 05 01 34 67 9A CD 01 22 33 44 C0 00 09 99 33 13 01 11 10 00 00 /* 1  403CD ~ 387CD */
			29 01 00 00 00 00 18 B5 19 DC 06 01 34 67 9A CD 01 22 33 44 C0 00 09 99 33 13 01 11 10 00 00 /* 2  380CD ~ 357CD */
			29 01 00 00 00 00 18 B5 19 DC 07 01 34 67 9A CD 01 22 33 44 C0 00 09 99 33 13 01 11 10 00 00 /* 3  350CD */
			29 01 00 00 00 00 18 B5 19 DC 08 01 34 67 9A CD 01 22 33 44 C0 00 09 99 33 13 01 11 10 00 00 /* 4  333CD */
			29 01 00 00 00 00 18 B5 19 DC 09 01 34 67 9A CD 01 22 33 44 C0 00 09 99 33 13 01 11 10 00 00 /* 5  316CD */
			29 01 00 00 00 00 18 B5 19 DC 0A 01 34 67 9A CD 01 22 33 44 C0 00 09 99 33 13 01 11 10 00 00 /* 6  300CD */
			29 01 00 00 00 00 18 B5 19 DC 0B 01 34 67 9A CD 01 22 33 44 C0 00 09 99 33 13 01 11 10 00 00 /* 7  282CD */
			29 01 00 00 00 00 18 B5 19 DC 0C 01 34 67 9A CD 01 22 33 44 C0 00 09 99 33 13 01 11 10 00 00 /* 8  265CD ~ 234CD */
			29 01 00 00 00 00 18 B5 19 DC 0D 01 34 67 9A CD 01 22 33 44 C0 00 09 99 33 13 01 11 10 00 00 /* 9  220CD ~ 183CD */
			29 01 00 00 00 00 18 B5 19 DC 0E 01 34 67 9A CD 01 22 33 44 C0 00 09 99 33 13 01 11 10 00 00 /* 10 172CD */
			29 01 00 00 00 00 18 B5 19 DC 0F 01 34 67 9A CD 01 22 33 44 C0 00 09 99 33 13 01 11 10 00 00 /* 11 162CD */
			29 01 00 00 00 00 18 B5 19 DC 10 01 34 67 9A CD 01 22 33 44 C0 00 09 99 33 13 01 11 10 00 00 /* 12 152CD ~ 143CD */
			29 01 00 00 00 00 18 B5 19 DC 11 01 34 67 9A CD 01 22 33 44 C0 00 09 99 33 13 01 11 10 00 00 /* 13 134CD ~ 126CD */
			29 01 00 00 00 00 18 B5 19 DC 12 01 34 67 9A CD 01 22 33 44 C0 00 09 99 33 13 01 11 10 00 00 /* 14 119CD ~ 111CD */
			29 01 00 00 00 00 18 B5 19 DC 13 01 34 67 9A CD 01 22 33 44 C0 00 09 99 33 13 01 11 10 00 00 /* 15 105CD ~ 98CD */
			29 01 00 00 00 00 18 B5 19 DC 14 01 34 67 9A CD 01 22 33 44 C0 00 09 99 33 13 01 11 10 00 00 /* 16 93CD ~ 82CD */
			29 01 00 00 00 00 18 B5 19 DC 15 01 34 67 9A CD 01 22 33 44 C0 00 09 99 33 13 01 11 10 00 00 /* 17 77CD ~ 41CD */
			29 01 00 00 00 00 18 B5 19 CC 15 01 34 67 9A CD 01 22 33 44 C0 00 09 99 33 13 01 11 10 00 00 /* 18 39CD ~ 16CD */
			29 01 00 00 00 00 18 B5 19 CC 14 01 34 67 9A CD 01 22 33 44 C0 00 09 99 33 13 01 11 10 00 00 /* 19 15CD */
			29 01 00 00 00 00 18 B5 19 CC 12 01 34 67 9A CD 01 22 33 44 C0 00 09 99 33 13 01 11 10 00 00 /* 20 14CD */
			29 01 00 00 00 00 18 B5 19 CC 10 01 34 67 9A CD 01 22 33 44 C0 00 09 99 33 13 01 11 10 00 00 /* 21 13CD */
			29 01 00 00 00 00 18 B5 19 CC 0E 01 34 67 9A CD 01 22 33 44 C0 00 09 99 33 13 01 11 10 00 00 /* 22 12CD */
			29 01 00 00 00 00 18 B5 19 CC 0D 01 34 67 9A CD 01 22 33 44 C0 00 09 99 33 13 01 11 10 00 00 /* 23 11CD */
			29 01 00 00 00 00 18 B5 19 CC 0C 01 34 67 9A CD 01 22 33 44 C0 00 09 99 33 13 01 11 10 00 00 /* 24 10CD */
			29 01 00 00 00 00 18 B5 19 CC 0B 01 34 67 9A CD 01 22 33 44 C0 00 09 99 33 13 01 11 10 00 00 /* 25 9CD */
			29 01 00 00 00 00 18 B5 19 CC 0A 01 34 67 9A CD 01 22 33 44 C0 00 09 99 33 13 01 11 10 00 00 /* 26 8CD */
			29 01 00 00 00 00 18 B5 19 CC 09 01 34 67 9A CD 01 22 33 44 C0 00 09 99 33 13 01 11 10 00 00 /* 27 7CD */
			29 01 00 00 00 00 18 B5 19 CC 08 01 34 67 9A CD 01 22 33 44 C0 00 09 99 33 13 01 11 10 00 00 /* 28 6CD */
			29 01 00 00 00 00 18 B5 19 CC 07 01 34 67 9A CD 01 22 33 44 C0 00 09 99 33 13 01 11 10 00 00 /* 29 5CD */
			29 01 00 00 00 00 18 B5 19 CC 06 01 34 67 9A CD 01 22 33 44 C0 00 09 99 33 13 01 11 10 00 00 /* 30 4CD */
			29 01 00 00 00 00 18 B5 19 CC 05 01 34 67 9A CD 01 22 33 44 C0 00 09 99 33 13 01 11 10 00 00 /* 31 3CD */
			29 01 00 00 00 00 18 B5 19 CC 04 01 34 67 9A CD 01 22 33 44 C0 00 09 99 33 13 01 11 10 00 00 /* 32 2CD */
		];

		samsung,elvss_low_tx_cmds_revA = [
			29 01 00 00 00 00 18 B5 19 DC 04 01 34 67 9A CD 01 22 33 44 C0 00 09 99 33 13 01 11 10 00 00 /* 0  420CD ~ 412CD */
			29 01 00 00 00 00 18 B5 19 DC 05 01 34 67 9A CD 01 22 33 44 C0 00 09 99 33 13 01 11 10 00 00 /* 1  403CD ~ 387CD */
			29 01 00 00 00 00 18 B5 19 DC 06 01 34 67 9A CD 01 22 33 44 C0 00 09 99 33 13 01 11 10 00 00 /* 2  380CD ~ 357CD */
			29 01 00 00 00 00 18 B5 19 DC 07 01 34 67 9A CD 01 22 33 44 C0 00 09 99 33 13 01 11 10 00 00 /* 3  350CD */
			29 01 00 00 00 00 18 B5 19 DC 08 01 34 67 9A CD 01 22 33 44 C0 00 09 99 33 13 01 11 10 00 00 /* 4  333CD */
			29 01 00 00 00 00 18 B5 19 DC 09 01 34 67 9A CD 01 22 33 44 C0 00 09 99 33 13 01 11 10 00 00 /* 5  316CD */
			29 01 00 00 00 00 18 B5 19 DC 0A 01 34 67 9A CD 01 22 33 44 C0 00 09 99 33 13 01 11 10 00 00 /* 6  300CD */
			29 01 00 00 00 00 18 B5 19 DC 0B 01 34 67 9A CD 01 22 33 44 C0 00 09 99 33 13 01 11 10 00 00 /* 7  282CD */
			29 01 00 00 00 00 18 B5 19 DC 0C 01 34 67 9A CD 01 22 33 44 C0 00 09 99 33 13 01 11 10 00 00 /* 8  265CD ~ 234CD */
			29 01 00 00 00 00 18 B5 19 DC 0D 01 34 67 9A CD 01 22 33 44 C0 00 09 99 33 13 01 11 10 00 00 /* 9  220CD ~ 183CD */
			29 01 00 00 00 00 18 B5 19 DC 0E 01 34 67 9A CD 01 22 33 44 C0 00 09 99 33 13 01 11 10 00 00 /* 10 172CD */
			29 01 00 00 00 00 18 B5 19 DC 0F 01 34 67 9A CD 01 22 33 44 C0 00 09 99 33 13 01 11 10 00 00 /* 11 162CD */
			29 01 00 00 00 00 18 B5 19 DC 10 01 34 67 9A CD 01 22 33 44 C0 00 09 99 33 13 01 11 10 00 00 /* 12 152CD ~ 143CD */
			29 01 00 00 00 00 18 B5 19 DC 11 01 34 67 9A CD 01 22 33 44 C0 00 09 99 33 13 01 11 10 00 00 /* 13 134CD ~ 126CD */
			29 01 00 00 00 00 18 B5 19 DC 12 01 34 67 9A CD 01 22 33 44 C0 00 09 99 33 13 01 11 10 00 00 /* 14 119CD ~ 111CD */
			29 01 00 00 00 00 18 B5 19 DC 13 01 34 67 9A CD 01 22 33 44 C0 00 09 99 33 13 01 11 10 00 00 /* 15 105CD ~ 98CD */
			29 01 00 00 00 00 18 B5 19 DC 14 01 34 67 9A CD 01 22 33 44 C0 00 09 99 33 13 01 11 10 00 00 /* 16 93CD ~ 82CD */
			29 01 00 00 00 00 18 B5 19 DC 15 01 34 67 9A CD 01 22 33 44 C0 00 09 99 33 13 01 11 10 00 00 /* 17 77CD ~ 41CD */
			29 01 00 00 00 00 18 B5 19 CC 15 01 34 67 9A CD 01 22 33 44 C0 00 09 99 33 13 01 11 10 00 00 /* 18 39CD ~ 16CD */
			29 01 00 00 00 00 18 B5 19 CC 14 01 34 67 9A CD 01 22 33 44 C0 00 09 99 33 13 01 11 10 00 00 /* 19 15CD */
			29 01 00 00 00 00 18 B5 19 CC 12 01 34 67 9A CD 01 22 33 44 C0 00 09 99 33 13 01 11 10 00 00 /* 20 14CD */
			29 01 00 00 00 00 18 B5 19 CC 10 01 34 67 9A CD 01 22 33 44 C0 00 09 99 33 13 01 11 10 00 00 /* 21 13CD */
			29 01 00 00 00 00 18 B5 19 CC 0E 01 34 67 9A CD 01 22 33 44 C0 00 09 99 33 13 01 11 10 00 00 /* 22 12CD */
			29 01 00 00 00 00 18 B5 19 CC 0E 01 34 67 9A CD 01 22 33 44 C0 00 09 99 33 13 01 11 10 00 00 /* 23 11CD */
			29 01 00 00 00 00 18 B5 19 CC 0E 01 34 67 9A CD 01 22 33 44 C0 00 09 99 33 13 01 11 10 00 00 /* 24 10CD */
			29 01 00 00 00 00 18 B5 19 CC 0E 01 34 67 9A CD 01 22 33 44 C0 00 09 99 33 13 01 11 10 00 00 /* 25 9CD */
			29 01 00 00 00 00 18 B5 19 CC 0E 01 34 67 9A CD 01 22 33 44 C0 00 09 99 33 13 01 11 10 00 00 /* 26 8CD */
			29 01 00 00 00 00 18 B5 19 CC 0E 01 34 67 9A CD 01 22 33 44 C0 00 09 99 33 13 01 11 10 00 00 /* 27 7CD */
			29 01 00 00 00 00 18 B5 19 CC 0E 01 34 67 9A CD 01 22 33 44 C0 00 09 99 33 13 01 11 10 00 00 /* 28 6CD */
			29 01 00 00 00 00 18 B5 19 CC 0E 01 34 67 9A CD 01 22 33 44 C0 00 09 99 33 13 01 11 10 00 00 /* 29 5CD */
			29 01 00 00 00 00 18 B5 19 CC 0E 01 34 67 9A CD 01 22 33 44 C0 00 09 99 33 13 01 11 10 00 00 /* 30 4CD */
			29 01 00 00 00 00 18 B5 19 CC 0E 01 34 67 9A CD 01 22 33 44 C0 00 09 99 33 13 01 11 10 00 00 /* 31 3CD */
			29 01 00 00 00 00 18 B5 19 CC 0E 01 34 67 9A CD 01 22 33 44 C0 00 09 99 33 13 01 11 10 00 00 /* 32 2CD */
		];
		/* bl_level, Index in elvss command list */
		samsung,smart_acl_elvss_map_table_revA = <
			2	32		3	31		4	30		5	29		6	28
			7	27		8	26		9	25		10	24		11	23
			12	22		13	21		14	20		15	19		16	18
			17	18		19	18		20	18		21	18		22	18
			24	18		25	18		27	18		29	18		30	18
			32	18		34	18		37	18		39	18		41	17
			44	17		47	17		50	17		53	17		56	17
			60	17		64	17		68	17		72	17		77	17
			82	16		87	16		93	16		98	15		105	15
			111	14		119	14		126	13		134	13		143	12
			152	12		162	11		172	10		183	9		195	9
			207	9		220	9		234	8		249	8		265	8
			282	7		300	6		316	5		333	4		350	3
			357	2		365	2		372	2		380	2		387	1
			395	1		403	1		412	0		420	0
		>;

		/*
		 * ************************************************************************************************************************
		 * candela to index mappings
		 * ************************************************************************************************************************
		 */
	samsung,candela_map_table_revA = <
		/*<idx>	<from>	<till>		<candella> */
			0		0		5		5
			1		6		6		6
			2		7		7		7
			3		8		8		8
			4		9		9		9
			5		10		10		10
			6		11		11		11
			7		12		12		12
			8		13		13		13
			9		14		14		14
			10		15		15		15
			11		16		16		16
			12		17		17		17
			13		18		18		19
			14		19		19		20
			15		20		20		21
			16		21		21		22
			17		22		22		24
			18		23		23		25
			19		24		24		27
			20		25		25		29
			21		26		26		30
			22		27		27		32
			23		28		28		34
			24		29		29		37
			25		30		30		39
			26		31		32		41
			27		33		34		44
			28		35		36		47
			29		37		38		50
			30		39		40		53
			31		41		43		56
			32		44		46		60
			33		47		49		64
			34		50		52		68
			35		53		56		72
			36		57		59		77
			37		60		63		82
			38		64		67		87
			39		68		71		93
			40		72		76		98
			41		77		80		105
			42		81		86		111
			43		87		91		119
			44		92		97		126
			45		98		104		134
			46		105		110		143
			47		111		118		152
			48		119		125		162
			49		126		133		172
			50		134		142		183
			51		143		150		195
			52		151		160		207
			53		161		170		220
			54		171		181		234
			55		182		193		249
			56		194		205		265
			57		206		218		282
			58		219		230		300
			59		231		242		316
			60		243		254		333
			61		255		255		360
		>;

		samsung,hbm_candela_map_table_revA = <
			0	269	281	378	6
			1	282	295	395	7
			2	296	309	413	8
			3	310	323	430	9
			4	324	336	448	10
			5	337	350	465	11
			6	351	364	483	12
			7	365	365	500	13
		>;
	};
};
