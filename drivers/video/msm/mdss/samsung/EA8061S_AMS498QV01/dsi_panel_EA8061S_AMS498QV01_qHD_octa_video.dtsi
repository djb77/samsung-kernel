/* Copyright (c) 2013-2014, The Linux Foundation. All rights reserved.
 *
 * This program is free software; you can redistribute it and/or modify
 * it under the terms of the GNU General Public License version 2 and
 * only version 2 as published by the Free Software Foundation.
 *
 * This program is distributed in the hope that it will be useful,
 * but WITHOUT ANY WARRANTY; without even the implied warranty of
 * MERCHANTABILITY or FITNESS FOR A PARTICULAR PURPOSE.  See the
 * GNU General Public License for more details.
 */

/*---------------------------------------------------------------------------
 * This file is autogenerated file using gcdb parser. Please do not edit it.
 * Update input XML file to add a new entry or update variable in this file
 * VERSION = "1.0"
 *--------------------------------------------------------------------------- */
&mdss_mdp {
	ss_dsi_panel_EA8061S_AMS498QV01_QHD: ss_dsi_panel_EA8061S_AMS498QV01_QHD {
		qcom,mdss-dsi-panel-name = "ss_dsi_panel_EA8061S_AMS498QV01_QHD";
		qcom,mdss-dsi-panel-controller = <&mdss_dsi0>;
		qcom,mdss-dsi-panel-width = <540>;
		qcom,mdss-dsi-panel-height = <960>;
		qcom,mdss-dsi-bpp = <24>;
		qcom,mdss-dsi-panel-destination = "display_1";
		qcom,mdss-dsi-panel-timings = [8C 1E 14 00 44 4A 18 22 18 03 04 00];

		qcom,mdss-dsi-on-command = [
			/* Common Setting */
			39 01 00 00 00 00 03 F0 5A 5A 				/* TEST KEY Enable */
			39 01 00 00 00 00 02 BA C4					/* Source Slew */
			39 01 00 00 00 00 05 B2 00 00 00 0A			/* AID Setting */
			39 01 00 00 00 00 02 F7 03					/* Gamma, AID Update */
			39 01 00 00 00 00 03 B8 19 00 				/* A-swire Setting */
			
			/* Sleep Out and wait minimum 20ms*/
			05 01 00 00 14 00 02 11 00

			39 01 00 00 78 00 03 F0 A5 A5				/* TEST KEY Disable and wait 120ms */
		];

		qcom,mdss-dsi-off-command = [
			05 01 00 00 14 00 02 28 00					/* Display Off and wait 20ms */
			05 01 00 00 64 00 02 10 00					/* Sleep In and wait 100ms */
		];


		qcom,mdss-dsi-h-back-porch = <43>;
		qcom,mdss-dsi-h-front-porch = <126>;
		qcom,mdss-dsi-h-pulse-width = <1>;
		qcom,mdss-dsi-v-back-porch = <11>;
		qcom,mdss-dsi-v-front-porch = <4>;
		qcom,mdss-dsi-v-pulse-width = <1>;

		qcom,mdss-dsi-h-sync-skew = <0>;		
		qcom,mdss-dsi-h-left-border = <0>;
		qcom,mdss-dsi-h-right-border = <0>;
		qcom,mdss-dsi-v-top-border = <0>;
		qcom,mdss-dsi-v-bottom-border = <0>;

		qcom,mdss-dsi-underflow-color = <0xff>;
		qcom,mdss-dsi-border-color = <0>;

		qcom,mdss-dsi-bl-pmic-control-type = "bl_ctrl_dcs";
		qcom,mdss-dsi-bl-min-level = <1>;
		qcom,mdss-dsi-bl-max-level = <365>;
		qcom,mdss-brightness-max-level = <365>;
		qcom,mdss-dsi-panel-type = "dsi_video_mode";
		qcom,mdss-dsi-h-sync-pulse = <0>;
		//qcom,mdss-dsi-hfp-power-mode;
		qcom,mdss-dsi-bllp-eof-power-mode;
		qcom,mdss-dsi-bllp-power-mode;
		qcom,mdss-dsi-traffic-mode = "burst_mode";
		qcom,mdss-dsi-pixel-packing = "loose";
		qcom,mdss-dsi-virtual-channel-id = <0>;
		qcom,mdss-dsi-color-order = <0>;
		qcom,mdss-dsi-lane-0-state;
		qcom,mdss-dsi-lane-1-state;
		qcom,mdss-dsi-t-clk-post = <0x04>;
		qcom,mdss-dsi-t-clk-pre = <0x1C>;
		qcom,mdss-dsi-stream = <0>;
		qcom,mdss-dsi-mdp-trigger = "none";
		qcom,mdss-dsi-dma-trigger = "trigger_sw";
		qcom,mdss-dsi-panel-framerate = <60>;
		qcom,mdss-dsi-panel-clockrate = <500000000>;
		qcom,mdss-dsi-on-command-state = "dsi_hs_mode";
		qcom,mdss-dsi-off-command-state = "dsi_hs_mode";
		qcom,mdss-pan-physical-width-dimension = <62>;
		qcom,mdss-pan-physical-height-dimension = <110>;
		qcom,mdss-dsi-lp11-init;
		qcom,mdss-dsi-init-delay-us = <100>;
		qcom,mdss-dsi-rx-eot-ignore;
		qcom,mdss-dsi-tx-eot-append;
		qcom,mdss-dsi-gamma-update = [39 01 00 00 00 00 02 F7 03];
		qcom,mdss-dsi-force-clock-lane-hs = <1>;

/*
 * ************************************************************************************************************************************
 *
 *
 *			Below  parameters are samsung dependent thigs
 *
 *
 * ************************************************************************************************************************************
 */
 		samsung,panel-vendor = "SDC";
		samsung,support_mdnie_lite;
		samsung,ux-color-bit-support;
		
		samsung,display_on_tx_cmds_revA  = [05 01 00 00 00 00 02 29 00];

		samsung,level1_key_enable_tx_cmds_revA = [
			39 01 00 00 00 00 03 F0 5A 5A
		];
		samsung,level1_key_disable_tx_cmds_revA = [
			39 01 00 00 00 00 03 F0 A5 A5
		];
		samsung,reg_read_pos_tx_cmds_revA = [15 01 00 00 00 00 02 B0 00];

		/*
		 * ************************************************************************************************************************
		 *	 06 01 00 00 00 00 01 c8 07 21
		 *	READ 0xC8 SIZE 0x07 OFFSET 0x21
		 * ************************************************************************************************************************
		 *        SAMPLE :  samsung,hbm2_rx_cmds_revE = [ 06 01 00 00 00 00 01 DB 01 21];	 // read DB 34th , 33=0x21
		 * ************************************************************************************************************************
		 */

		//=================================
		// REV. A
		//=================================
		samsung,smart_dimming_mtp_rx_cmds_revA = [ 06 01 00 00 00 00 01 C8 21 00];
		samsung,manufacture_id0_rx_cmds_revA   = [ 06 01 00 00 00 00 01 DA 01 00];
		samsung,manufacture_id1_rx_cmds_revA   = [ 06 01 00 00 00 00 01 DB 01 00];
		samsung,manufacture_id2_rx_cmds_revA   = [ 06 01 00 00 00 00 01 DC 01 00];
		samsung,manufacture_date_rx_cmds_revA  = [ 06 01 00 00 00 00 01 A1 02 04];	// read A1 5~6th para
		samsung,cell_id_rx_cmds_revA           = [ 06 01 00 00 00 00 01 A1 0B 00];	// read A1 1~11th para
		samsung,mdnie_read_rx_cmds_revA		   = [ 06 01 00 00 00 00 01 A1 04 00];
		samsung,mtp_read_sysfs_rx_cmds_revA    = [ 06 01 00 00 00 00 01 01 01 01];
		samsung,ldi_debug0_rx_cmds_revA        = [ 06 01 00 00 00 00 01 0A 01 00];
		samsung,ldi_debug1_rx_cmds_revA        = [ 06 01 00 00 00 00 01 0E 01 00];
		samsung,ldi_debug2_rx_cmds_revA        = [ 06 01 00 00 00 00 01 EA 08 00];

		/*
		 * ************************************************************************************************************************
		 *	 COMMON CMD LIST
		 * ************************************************************************************************************************
		 */
		samsung,elvss_lowtemp_tx_cmds_revA  = [39 01 00 00 00 00 02 B8 19 ];		/* Low Temperature Command */

		//========================================
		// Gamma and HBM (REV. A)
		//========================================
		
		samsung,gamma_tx_cmds_revA = [
			39 01 00 00 01 00 22 CA	01 00 01 00 01 00	/* 360 nit 2.2 Gamma */
									80 80 80 80 80 80
									80 80 80 80 80 80
									80 80 80 80 80 80
									80 80 80 80 80 80
									00 00 00

			39 01 00 00 00 00 02 F7 03			// Gamma, AID Update
		];

		samsung,hbm_etc_tx_cmds_revA = [
			39 01 00 00 00 00 05 B2 00 00 00 0A
			39 01 00 00 00 00 03 B6 CC 87
			39 01 00 00 00 00 06 B5 0A 9A 0A 0A 27		/* 1st para :32 Frame Avg , 2nd para : 60% start point , 4th para : 8 % ACL */
			39 01 00 00 00 00 02 53 C0					/* HBM On */
			39 01 00 00 00 00 02 F7 03
		];

		samsung,hbm_off_tx_cmds_revA = [
			39 01 00 00 00 00 02 53 00	/* HBM Off */
		];

		/*
		* ************************************************************************************************************************
		* AID command list and mappings
		* ************************************************************************************************************************
		*/
		samsung,aid_tx_cmds_revA = [
			39 01 00 00 00 00 05 B2 00 00 03 B3 /*  0 samsung_brightness_aor_97.03 5  */
			39 01 00 00 00 00 05 B2 00 00 03 AC /*  1 samsung_brightness_aor_96.31 6  */
			39 01 00 00 00 00 05 B2 00 00 03 A5 /*  2 samsung_brightness_aor_95.59 7  */
			39 01 00 00 00 00 05 B2 00 00 03 9F /*  3 samsung_brightness_aor_94.98 8  */
			39 01 00 00 00 00 05 B2 00 00 03 98 /*  4 samsung_brightness_aor_94.26 9  */
			39 01 00 00 00 00 05 B2 00 00 03 91 /*  5 samsung_brightness_aor_93.55 10 */
			39 01 00 00 00 00 05 B2 00 00 03 8B /*  6 samsung_brightness_aor_92.93 11 */
			39 01 00 00 00 00 05 B2 00 00 03 84 /*  7 samsung_brightness_aor_92.21 12 */
			39 01 00 00 00 00 05 B2 00 00 03 7F /*  8 samsung_brightness_aor_91.70 13 */
			39 01 00 00 00 00 05 B2 00 00 03 76 /*  9 samsung_brightness_aor_90.78 14 */
			39 01 00 00 00 00 05 B2 00 00 03 6F /* 10 samsung_brightness_aor_90.06 15 */
			39 01 00 00 00 00 05 B2 00 00 03 69 /* 11 samsung_brightness_aor_89.45 16 */
			39 01 00 00 00 00 05 B2 00 00 03 60 /* 12 samsung_brightness_aor_88.52 17 */
			39 01 00 00 00 00 05 B2 00 00 03 55 /* 13 samsung_brightness_aor_87.40 19 */
			39 01 00 00 00 00 05 B2 00 00 03 4E /* 14 samsung_brightness_aor_86.68 20 */
			39 01 00 00 00 00 05 B2 00 00 03 45 /* 15 samsung_brightness_aor_85.76 21 */
			39 01 00 00 00 00 05 B2 00 00 03 3C /* 16 samsung_brightness_aor_84.84 22 */
			39 01 00 00 00 00 05 B2 00 00 03 2D /* 17 samsung_brightness_aor_83.30 24 */
			39 01 00 00 00 00 05 B2 00 00 03 22 /* 18 samsung_brightness_aor_82.17 25 */
			39 01 00 00 00 00 05 B2 00 00 03 12 /* 19 samsung_brightness_aor_80.53 27 */
			39 01 00 00 00 00 05 B2 00 00 03 02 /* 20 samsung_brightness_aor_78.89 29 */
			39 01 00 00 00 00 05 B2 00 00 02 F8 /* 21 samsung_brightness_aor_77.87 30 */
			39 01 00 00 00 00 05 B2 00 00 02 E8 /* 22 samsung_brightness_aor_76.23 32 */
			39 01 00 00 00 00 05 B2 00 00 02 D8 /* 23 samsung_brightness_aor_74.59 34 */
			39 01 00 00 00 00 05 B2 00 00 02 C5 /* 24 samsung_brightness_aor_72.64 37 */
			39 01 00 00 00 00 05 B2 00 00 02 B5 /* 25 samsung_brightness_aor_71.00 39 */
			39 01 00 00 00 00 05 B2 00 00 02 A5 /* 26 samsung_brightness_aor_69.36 41 */
			39 01 00 00 00 00 05 B2 00 00 02 8D /* 27 samsung_brightness_aor_66.91 44 */
			39 01 00 00 00 00 05 B2 00 00 02 76 /* 28 samsung_brightness_aor_64.55 47 */
			39 01 00 00 00 00 05 B2 00 00 02 60 /* 29 samsung_brightness_aor_62.30 50 */
			39 01 00 00 00 00 05 B2 00 00 02 50 /* 30 samsung_brightness_aor_60.66 53 */
			39 01 00 00 00 00 05 B2 00 00 02 30 /* 31 samsung_brightness_aor_57.38 56 */
			39 01 00 00 00 00 05 B2 00 00 02 12 /* 32 samsung_brightness_aor_54.30 60 */
			39 01 00 00 00 00 05 B2 00 00 01 F4 /* 33 samsung_brightness_aor_51.23 64 */
			39 01 00 00 00 00 05 B2 00 00 01 D2 /* 34 samsung_brightness_aor_47.75 68~134 */
			39 01 00 00 00 00 05 B2 00 00 01 C3 /* 35 samsung_brightness_aor_46.21 143 */
			39 01 00 00 00 00 05 B2 00 00 01 9C /* 36 samsung_brightness_aor_42.21 152 */
			39 01 00 00 00 00 05 B2 00 00 01 74 /* 37 samsung_brightness_aor_38.11 162 */
			39 01 00 00 00 00 05 B2 00 00 01 4F /* 38 samsung_brightness_aor_34.32 172 */
			39 01 00 00 00 00 05 B2 00 00 01 22 /* 39 samsung_brightness_aor_29.71 183 */
			39 01 00 00 00 00 05 B2 00 00 00 F0 /* 40 samsung_brightness_aor_24.59 195 */
			39 01 00 00 00 00 05 B2 00 00 00 BF /* 41 samsung_brightness_aor_19.57 207 */
			39 01 00 00 00 00 05 B2 00 00 00 88 /* 42 samsung_brightness_aor_13.93  220 */
			39 01 00 00 00 00 05 B2 00 00 00 52 /* 43 samsung_brightness_aor_8.40  234 */
			39 01 00 00 00 00 05 B2 00 00 00 0A /* 44 samsung_brightness_aor_1.02  249~360 */
		];

		samsung,aid_subdivision_tx_cmds_revA = [
			39 01 00 00 00 00 05 B2 00 00 03 B3  /*   0 */
			39 01 00 00 00 00 05 B2 00 00 03 B1  /*   1 */
			39 01 00 00 00 00 05 B2 00 00 03 AF  /*   2 */
			39 01 00 00 00 00 05 B2 00 00 03 AD  /*   3 */
			39 01 00 00 00 00 05 B2 00 00 03 AC  /*   4 */
			39 01 00 00 00 00 05 B2 00 00 03 AA  /*   5 */
			39 01 00 00 00 00 05 B2 00 00 03 A8  /*   6 */
			39 01 00 00 00 00 05 B2 00 00 03 A6  /*   7 */
			39 01 00 00 00 00 05 B2 00 00 03 A5  /*   8 */
			39 01 00 00 00 00 05 B2 00 00 03 A3  /*   9 */
			39 01 00 00 00 00 05 B2 00 00 03 A2  /*  10 */
			39 01 00 00 00 00 05 B2 00 00 03 A0  /*  11 */
			39 01 00 00 00 00 05 B2 00 00 03 9F  /*  12 */
			39 01 00 00 00 00 05 B2 00 00 03 9D  /*  13 */
			39 01 00 00 00 00 05 B2 00 00 03 9B  /*  14 */
			39 01 00 00 00 00 05 B2 00 00 03 99  /*  15 */
			39 01 00 00 00 00 05 B2 00 00 03 98  /*  16 */
			39 01 00 00 00 00 05 B2 00 00 03 96  /*  17 */
			39 01 00 00 00 00 05 B2 00 00 03 94  /*  18 */
			39 01 00 00 00 00 05 B2 00 00 03 92  /*  19 */
			39 01 00 00 00 00 05 B2 00 00 03 91  /*  20 */
			39 01 00 00 00 00 05 B2 00 00 03 8F  /*  21 */
			39 01 00 00 00 00 05 B2 00 00 03 8E  /*  22 */
			39 01 00 00 00 00 05 B2 00 00 03 8D  /*  23 */
			39 01 00 00 00 00 05 B2 00 00 03 8B  /*  24 */
			39 01 00 00 00 00 05 B2 00 00 03 89  /*  25 */
			39 01 00 00 00 00 05 B2 00 00 03 87  /*  26 */
			39 01 00 00 00 00 05 B2 00 00 03 85  /*  27 */
			39 01 00 00 00 00 05 B2 00 00 03 84  /*  28 */
			39 01 00 00 00 00 05 B2 00 00 03 82  /*  29 */
			39 01 00 00 00 00 05 B2 00 00 03 81  /*  30 */
			39 01 00 00 00 00 05 B2 00 00 03 80  /*  31 */
			39 01 00 00 00 00 05 B2 00 00 03 7F  /*  32 */
			39 01 00 00 00 00 05 B2 00 00 03 7D  /*  33 */
			39 01 00 00 00 00 05 B2 00 00 03 7B  /*  34 */
			39 01 00 00 00 00 05 B2 00 00 03 78  /*  35 */
			39 01 00 00 00 00 05 B2 00 00 03 76  /*  36 */
			39 01 00 00 00 00 05 B2 00 00 03 74  /*  37 */
			39 01 00 00 00 00 05 B2 00 00 03 72  /*  38 */
			39 01 00 00 00 00 05 B2 00 00 03 71  /*  39 */
			39 01 00 00 00 00 05 B2 00 00 03 6F  /*  40 */
			39 01 00 00 00 00 05 B2 00 00 03 6C  /*  41 */
			39 01 00 00 00 00 05 B2 00 00 03 69  /*  42 */
			39 01 00 00 00 00 05 B2 00 00 03 65  /*  43 */
			39 01 00 00 00 00 05 B2 00 00 03 60  /*  44 */
			39 01 00 00 00 00 05 B2 00 00 03 5A  /*  45 */
			39 01 00 00 00 00 05 B2 00 00 03 55  /*  46 */
			39 01 00 00 00 00 05 B2 00 00 03 52  /*  47 */
			39 01 00 00 00 00 05 B2 00 00 03 4E  /*  48 */
			39 01 00 00 00 00 05 B2 00 00 03 4A  /*  49 */
			39 01 00 00 00 00 05 B2 00 00 03 45  /*  50 */
			39 01 00 00 00 00 05 B2 00 00 03 41  /*  51 */
			39 01 00 00 00 00 05 B2 00 00 03 3C  /*  52 */
			39 01 00 00 00 00 05 B2 00 00 03 35  /*  53 */
			39 01 00 00 00 00 05 B2 00 00 03 2D  /*  54 */
			39 01 00 00 00 00 05 B2 00 00 03 28  /*  55 */
			39 01 00 00 00 00 05 B2 00 00 03 22  /*  56 */
			39 01 00 00 00 00 05 B2 00 00 03 1A  /*  57 */
			39 01 00 00 00 00 05 B2 00 00 03 12  /*  58 */
			39 01 00 00 00 00 05 B2 00 00 03 0A  /*  59 */
			39 01 00 00 00 00 05 B2 00 00 03 02  /*  60 */
			39 01 00 00 00 00 05 B2 00 00 02 FD  /*  61 */
			39 01 00 00 00 00 05 B2 00 00 02 F8  /*  62 */
			39 01 00 00 00 00 05 B2 00 00 02 F0  /*  63 */
			39 01 00 00 00 00 05 B2 00 00 02 E8  /*  64 */
			39 01 00 00 00 00 05 B2 00 00 02 E0  /*  65 */
			39 01 00 00 00 00 05 B2 00 00 02 D8  /*  66 */
			39 01 00 00 00 00 05 B2 00 00 02 CF  /*  67 */
			39 01 00 00 00 00 05 B2 00 00 02 C5  /*  68 */
			39 01 00 00 00 00 05 B2 00 00 02 BD  /*  69 */
			39 01 00 00 00 00 05 B2 00 00 02 B5  /*  70 */
			39 01 00 00 00 00 05 B2 00 00 02 AD  /*  71 */
			39 01 00 00 00 00 05 B2 00 00 02 A5  /*  72 */
			39 01 00 00 00 00 05 B2 00 00 02 99  /*  73 */
			39 01 00 00 00 00 05 B2 00 00 02 8D  /*  74 */
			39 01 00 00 00 00 05 B2 00 00 02 82  /*  75 */
			39 01 00 00 00 00 05 B2 00 00 02 76  /*  76 */
			39 01 00 00 00 00 05 B2 00 00 02 6B  /*  77 */
			39 01 00 00 00 00 05 B2 00 00 02 60  /*  78 */
			39 01 00 00 00 00 05 B2 00 00 02 58  /*  79 */
			39 01 00 00 00 00 05 B2 00 00 02 50  /*  80 */
			39 01 00 00 00 00 05 B2 00 00 02 40  /*  81 */
			39 01 00 00 00 00 05 B2 00 00 02 30  /*  82 */
			39 01 00 00 00 00 05 B2 00 00 02 21  /*  83 */
			39 01 00 00 00 00 05 B2 00 00 02 12  /*  84 */
			39 01 00 00 00 00 05 B2 00 00 02 03  /*  85 */
			39 01 00 00 00 00 05 B2 00 00 01 F4  /*  86 */
			39 01 00 00 00 00 05 B2 00 00 01 E3  /*  87 */
			39 01 00 00 00 00 05 B2 00 00 01 D2  /*  88 */
			39 01 00 00 00 00 05 B2 00 00 01 E0  /*  89 */
			39 01 00 00 00 00 05 B2 00 00 01 D2  /*  90 */
			39 01 00 00 00 00 05 B2 00 00 01 E3  /*  91 */
			39 01 00 00 00 00 05 B2 00 00 01 D2  /*  92 */
			39 01 00 00 00 00 05 B2 00 00 01 E2  /*  93 */
			39 01 00 00 00 00 05 B2 00 00 01 D2  /*  94 */
			39 01 00 00 00 00 05 B2 00 00 01 E1  /*  95 */
			39 01 00 00 00 00 05 B2 00 00 01 D2  /*  96 */
			39 01 00 00 00 00 05 B2 00 00 01 E2  /*  97 */
			39 01 00 00 00 00 05 B2 00 00 01 D2  /*  98 */
			39 01 00 00 00 00 05 B2 00 00 01 DF  /*  99 */
			39 01 00 00 00 00 05 B2 00 00 01 D2  /* 100 */
			39 01 00 00 00 00 05 B2 00 00 01 E3  /* 101 */
			39 01 00 00 00 00 05 B2 00 00 01 D2  /* 102 */
			39 01 00 00 00 00 05 B2 00 00 01 E0  /* 103 */
			39 01 00 00 00 00 05 B2 00 00 01 D2  /* 104 */
			39 01 00 00 00 00 05 B2 00 00 01 E3  /* 105 */
			39 01 00 00 00 00 05 B2 00 00 01 D2  /* 106 */
			39 01 00 00 00 00 05 B2 00 00 01 E0  /* 107 */
			39 01 00 00 00 00 05 B2 00 00 01 D2  /* 108 */
			39 01 00 00 00 00 05 B2 00 00 01 E6  /* 109 */
			39 01 00 00 00 00 05 B2 00 00 01 DC  /* 110 */
			39 01 00 00 00 00 05 B2 00 00 01 D2  /* 111 */
			39 01 00 00 00 00 05 B2 00 00 01 CD  /* 112 */
			39 01 00 00 00 00 05 B2 00 00 01 C8  /* 113 */
			39 01 00 00 00 00 05 B2 00 00 01 C3  /* 114 */
			39 01 00 00 00 00 05 B2 00 00 01 B6  /* 115 */
			39 01 00 00 00 00 05 B2 00 00 01 A9  /* 116 */
			39 01 00 00 00 00 05 B2 00 00 01 9C  /* 117 */
			39 01 00 00 00 00 05 B2 00 00 01 8F  /* 118 */
			39 01 00 00 00 00 05 B2 00 00 01 81  /* 119 */
			39 01 00 00 00 00 05 B2 00 00 01 74  /* 120 */
			39 01 00 00 00 00 05 B2 00 00 01 6B  /* 121 */
			39 01 00 00 00 00 05 B2 00 00 01 62  /* 122 */
			39 01 00 00 00 00 05 B2 00 00 01 58  /* 123 */
			39 01 00 00 00 00 05 B2 00 00 01 4F  /* 124 */
			39 01 00 00 00 00 05 B2 00 00 01 44  /* 125 */
			39 01 00 00 00 00 05 B2 00 00 01 39  /* 126 */
			39 01 00 00 00 00 05 B2 00 00 01 2D  /* 127 */
			39 01 00 00 00 00 05 B2 00 00 01 22  /* 128 */
			39 01 00 00 00 00 05 B2 00 00 01 1D  /* 129 */
			39 01 00 00 00 00 05 B2 00 00 01 19  /* 130 */
			39 01 00 00 00 00 05 B2 00 00 01 14  /* 131 */
			39 01 00 00 00 00 05 B2 00 00 01 10  /* 132 */
			39 01 00 00 00 00 05 B2 00 00 01 0B  /* 133 */
			39 01 00 00 00 00 05 B2 00 00 01 07  /* 134 */
			39 01 00 00 00 00 05 B2 00 00 01 02  /* 135 */
			39 01 00 00 00 00 05 B2 00 00 00 FE  /* 136 */
			39 01 00 00 00 00 05 B2 00 00 00 F9  /* 137 */
			39 01 00 00 00 00 05 B2 00 00 00 F5  /* 138 */
			39 01 00 00 00 00 05 B2 00 00 00 F0  /* 139 */
			39 01 00 00 00 00 05 B2 00 00 00 EC  /* 140 */
			39 01 00 00 00 00 05 B2 00 00 00 E7  /* 141 */
			39 01 00 00 00 00 05 B2 00 00 00 E3  /* 142 */
			39 01 00 00 00 00 05 B2 00 00 00 DE  /* 143 */
			39 01 00 00 00 00 05 B2 00 00 00 DA  /* 144 */
			39 01 00 00 00 00 05 B2 00 00 00 D5  /* 145 */
			39 01 00 00 00 00 05 B2 00 00 00 D1  /* 146 */
			39 01 00 00 00 00 05 B2 00 00 00 CC  /* 147 */
			39 01 00 00 00 00 05 B2 00 00 00 C8  /* 148 */
			39 01 00 00 00 00 05 B2 00 00 00 C3  /* 149 */
			39 01 00 00 00 00 05 B2 00 00 00 BF  /* 150 */
			39 01 00 00 00 00 05 B2 00 00 00 BA  /* 151 */
			39 01 00 00 00 00 05 B2 00 00 00 B5  /* 152 */
			39 01 00 00 00 00 05 B2 00 00 00 B0  /* 153 */
			39 01 00 00 00 00 05 B2 00 00 00 AB  /* 154 */
			39 01 00 00 00 00 05 B2 00 00 00 A6  /* 155 */
			39 01 00 00 00 00 05 B2 00 00 00 A1  /* 156 */
			39 01 00 00 00 00 05 B2 00 00 00 9C  /* 157 */
			39 01 00 00 00 00 05 B2 00 00 00 97  /* 158 */
			39 01 00 00 00 00 05 B2 00 00 00 92  /* 159 */
			39 01 00 00 00 00 05 B2 00 00 00 8D  /* 160 */
			39 01 00 00 00 00 05 B2 00 00 00 88  /* 161 */
			39 01 00 00 00 00 05 B2 00 00 00 83  /* 162 */
			39 01 00 00 00 00 05 B2 00 00 00 7E  /* 163 */
			39 01 00 00 00 00 05 B2 00 00 00 79  /* 164 */
			39 01 00 00 00 00 05 B2 00 00 00 74  /* 165 */
			39 01 00 00 00 00 05 B2 00 00 00 6F  /* 166 */
			39 01 00 00 00 00 05 B2 00 00 00 6A  /* 167 */
			39 01 00 00 00 00 05 B2 00 00 00 66  /* 168 */
			39 01 00 00 00 00 05 B2 00 00 00 61  /* 169 */
			39 01 00 00 00 00 05 B2 00 00 00 5C  /* 170 */
			39 01 00 00 00 00 05 B2 00 00 00 57  /* 171 */
			39 01 00 00 00 00 05 B2 00 00 00 52  /* 172 */
			39 01 00 00 00 00 05 B2 00 00 00 4B  /* 173 */
			39 01 00 00 00 00 05 B2 00 00 00 45  /* 174 */
			39 01 00 00 00 00 05 B2 00 00 00 3E  /* 175 */
			39 01 00 00 00 00 05 B2 00 00 00 38  /* 176 */
			39 01 00 00 00 00 05 B2 00 00 00 31  /* 177 */
			39 01 00 00 00 00 05 B2 00 00 00 2B  /* 178 */
			39 01 00 00 00 00 05 B2 00 00 00 24  /* 179 */
			39 01 00 00 00 00 05 B2 00 00 00 1E  /* 180 */
			39 01 00 00 00 00 05 B2 00 00 00 17  /* 181 */
			39 01 00 00 00 00 05 B2 00 00 00 10  /* 182 */
			39 01 00 00 00 00 05 B2 00 00 00 0A  /* 183 */
			39 01 00 00 00 00 05 B2 00 00 00 3F  /* 184 */
			39 01 00 00 00 00 05 B2 00 00 00 3A  /* 185 */
			39 01 00 00 00 00 05 B2 00 00 00 34  /* 186 */
			39 01 00 00 00 00 05 B2 00 00 00 2F  /* 187 */
			39 01 00 00 00 00 05 B2 00 00 00 2A  /* 188 */
			39 01 00 00 00 00 05 B2 00 00 00 24  /* 189 */
			39 01 00 00 00 00 05 B2 00 00 00 1F  /* 190 */
			39 01 00 00 00 00 05 B2 00 00 00 1A  /* 191 */
			39 01 00 00 00 00 05 B2 00 00 00 15  /* 192 */
			39 01 00 00 00 00 05 B2 00 00 00 0F  /* 193 */
			39 01 00 00 00 00 05 B2 00 00 00 0A  /* 194 */
			39 01 00 00 00 00 05 B2 00 00 00 3F  /* 195 */
			39 01 00 00 00 00 05 B2 00 00 00 3A  /* 196 */
			39 01 00 00 00 00 05 B2 00 00 00 36  /* 197 */
			39 01 00 00 00 00 05 B2 00 00 00 31  /* 198 */
			39 01 00 00 00 00 05 B2 00 00 00 2C  /* 199 */
			39 01 00 00 00 00 05 B2 00 00 00 27  /* 200 */
			39 01 00 00 00 00 05 B2 00 00 00 22  /* 201 */
			39 01 00 00 00 00 05 B2 00 00 00 1D  /* 202 */
			39 01 00 00 00 00 05 B2 00 00 00 19  /* 203 */
			39 01 00 00 00 00 05 B2 00 00 00 14  /* 204 */
			39 01 00 00 00 00 05 B2 00 00 00 0F  /* 205 */
			39 01 00 00 00 00 05 B2 00 00 00 0A  /* 206 */
			39 01 00 00 00 00 05 B2 00 00 00 3F  /* 207 */
			39 01 00 00 00 00 05 B2 00 00 00 3A  /* 208 */
			39 01 00 00 00 00 05 B2 00 00 00 35  /* 209 */
			39 01 00 00 00 00 05 B2 00 00 00 31  /* 210 */
			39 01 00 00 00 00 05 B2 00 00 00 2C  /* 211 */
			39 01 00 00 00 00 05 B2 00 00 00 27  /* 212 */
			39 01 00 00 00 00 05 B2 00 00 00 22  /* 213 */
			39 01 00 00 00 00 05 B2 00 00 00 1D  /* 214 */
			39 01 00 00 00 00 05 B2 00 00 00 18  /* 215 */
			39 01 00 00 00 00 05 B2 00 00 00 14  /* 216 */
			39 01 00 00 00 00 05 B2 00 00 00 0F  /* 217 */
			39 01 00 00 00 00 05 B2 00 00 00 0A  /* 218 */
			39 01 00 00 00 00 05 B2 00 00 00 36  /* 219 */
			39 01 00 00 00 00 05 B2 00 00 00 32  /* 220 */
			39 01 00 00 00 00 05 B2 00 00 00 2E  /* 221 */
			39 01 00 00 00 00 05 B2 00 00 00 29  /* 222 */
			39 01 00 00 00 00 05 B2 00 00 00 25  /* 223 */
			39 01 00 00 00 00 05 B2 00 00 00 20  /* 224 */
			39 01 00 00 00 00 05 B2 00 00 00 1C  /* 225 */
			39 01 00 00 00 00 05 B2 00 00 00 17  /* 226 */
			39 01 00 00 00 00 05 B2 00 00 00 13  /* 227 */
			39 01 00 00 00 00 05 B2 00 00 00 0E  /* 228 */
			39 01 00 00 00 00 05 B2 00 00 00 0A  /* 229 */
			39 01 00 00 00 00 05 B2 00 00 00 37  /* 230 */
			39 01 00 00 00 00 05 B2 00 00 00 33  /* 231 */
			39 01 00 00 00 00 05 B2 00 00 00 2F  /* 232 */
			39 01 00 00 00 00 05 B2 00 00 00 2B  /* 233 */
			39 01 00 00 00 00 05 B2 00 00 00 27  /* 234 */
			39 01 00 00 00 00 05 B2 00 00 00 23  /* 235 */
			39 01 00 00 00 00 05 B2 00 00 00 1F  /* 236 */
			39 01 00 00 00 00 05 B2 00 00 00 1A  /* 237 */
			39 01 00 00 00 00 05 B2 00 00 00 16  /* 238 */
			39 01 00 00 00 00 05 B2 00 00 00 12  /* 239 */
			39 01 00 00 00 00 05 B2 00 00 00 0E  /* 240 */
			39 01 00 00 00 00 05 B2 00 00 00 0A  /* 241 */
			39 01 00 00 00 00 05 B2 00 00 00 4D  /* 242 */
			39 01 00 00 00 00 05 B2 00 00 00 47  /* 243 */
			39 01 00 00 00 00 05 B2 00 00 00 42  /* 244 */
			39 01 00 00 00 00 05 B2 00 00 00 3C  /* 245 */
			39 01 00 00 00 00 05 B2 00 00 00 37  /* 246 */
			39 01 00 00 00 00 05 B2 00 00 00 31  /* 247 */
			39 01 00 00 00 00 05 B2 00 00 00 2B  /* 248 */
			39 01 00 00 00 00 05 B2 00 00 00 26  /* 249 */
			39 01 00 00 00 00 05 B2 00 00 00 20  /* 250 */
			39 01 00 00 00 00 05 B2 00 00 00 1B  /* 251 */
			39 01 00 00 00 00 05 B2 00 00 00 15  /* 252 */
			39 01 00 00 00 00 05 B2 00 00 00 10  /* 253 */
			39 01 00 00 00 00 05 B2 00 00 00 0A  /* 254 */
			39 01 00 00 00 00 05 B2 00 00 00 0A  /* 255 */
		];
			/* bl_level, Index in AID command list */
		samsung,aid_map_table_revA = <
			5	0		6	1		7	2		8	3		9	4
			10	5		11	6		12	7		13	8		14	9
			15	10		16	11		17	12		19	13		20	14
			21	15		22	16		24	17		25	18		27	19
			29	20		30	21		32	22		34	23		37	24
			39	25		41	26		44	27		47	28		50	29
			53	30		56	31		60	32		64	33		68	34
			72	34		77	34		82	34		87	34		93	34
			98	34		105	34		111	34		119	34		126	34
			134	34		143	35		152	36		162	37		172	38
			183	39		195	40		207	41		220	42		234	43
			249	44		265	44		282	44		300	44		316	44
			333	44		360	44
		>;

		//========================================
		// ACL command list and mappings (REV. A)
		//========================================
		samsung,acl_on_tx_cmds_revA  = [
			39 01 00 00 00 00 06 B5 0A 7F 0A 12 27 	/* 1st para :32 Frame Avg , 2nd para : 50% start point , 4th para : 15 % ACL */
			39 01 00 00 00 00 02 55 02				/* ACL ON */
		];
		samsung,acl_off_tx_cmds_revA = [
			39 01 00 00 00 00 06 B5 08 7F 0A 00 27 	/* 1st para :16 Frame Avg , 2nd para : 50% start point , 4th para : Don't care */
			39 01 00 00 00 00 02 55 00				/* ACL OFF */
		];

		/*
		 * ************************************************************************************************************************
		 * ELVSS command list and mappings
		 * ************************************************************************************************************************
		 */
		samsung,elvss_tx_cmds_revA = [
			39 01 00 00 00 00 03 B6 CC 87 /* 0    5~20 nit */
			39 01 00 00 00 00 03 B6 CC 89 /* 1    21 nit */
			39 01 00 00 00 00 03 B6 CC 8B /* 2    22 nit */
			39 01 00 00 00 00 03 B6 CC 8D /* 3    24 nit */
			39 01 00 00 00 00 03 B6 CC 8F /* 4    25 nit */
			39 01 00 00 00 00 03 B6 CC 91 /* 5    27 nit */
			39 01 00 00 00 00 03 B6 CC 93 /* 6    29 nit */
			39 01 00 00 00 00 03 B6 CC 95 /* 7    30~77 nit */
			39 01 00 00 00 00 03 B6 CC 94 /* 8    82~105 nit */
			39 01 00 00 00 00 03 B6 CC 93 /* 9    111 nit */
			39 01 00 00 00 00 03 B6 CC 93 /* 10   119 nit */
			39 01 00 00 00 00 03 B6 CC 93 /* 11   126 nit */
			39 01 00 00 00 00 03 B6 CC 92 /* 12   134 nit */
			39 01 00 00 00 00 03 B6 CC 92 /* 13   143 nit */
			39 01 00 00 00 00 03 B6 CC 92 /* 14   152 nit */
			39 01 00 00 00 00 03 B6 CC 92 /* 15   162 nit */
			39 01 00 00 00 00 03 B6 CC 91 /* 16   172 nit */
			39 01 00 00 00 00 03 B6 CC 91 /* 17   183 nit */
			39 01 00 00 00 00 03 B6 CC 91 /* 18   195 nit */
			39 01 00 00 00 00 03 B6 CC 90 /* 19   207 nit */
			39 01 00 00 00 00 03 B6 CC 90 /* 20   220 nit */
			39 01 00 00 00 00 03 B6 CC 8F /* 21   234 nit */
			39 01 00 00 00 00 03 B6 CC 8F /* 22   249 nit */
			39 01 00 00 00 00 03 B6 CC 8D /* 23   265 nit */
			39 01 00 00 00 00 03 B6 CC 8C /* 24   282 nit */
			39 01 00 00 00 00 03 B6 CC 8B /* 25   300 nit */
			39 01 00 00 00 00 03 B6 CC 8A /* 26   316 nit */
			39 01 00 00 00 00 03 B6 CC 89 /* 27   333 nit */
			39 01 00 00 00 00 03 B6 CC 87 /* 28   360 nit */
		];

		/* bl_level, Index in elvss command list */
		samsung,elvss_map_table_revA = <
					5	0		6	0		7	0		8	0		9	0
					10	0		11	0		12	0		13	0		14	0
					15	0		16	0		17	0		19	0		20	0
					21	1		22	2		24	3		25	4		27	5
					29	6		30	7		32	7		34	7		37	7
					39	7		41	7		44	7		47	7		50	7
					53	7		56	7		60	7		64	7		68	7
					72	7		77	7		82	8		87	8		93	8
					98	8		105	8		111	9		119	10		126	11
					134	12		143	13		152	14		162	15		172	16
					183	17		195	18		207	19		220	20		234	21
					249	22		265	23		282	24		300	25		316	26
					333	27		360	28
		>;

		/*
		* ************************************************************************************************************************
		* candela to index mappings
		* ************************************************************************************************************************
		*/
		samsung,candela_map_table_revA = <
		/*<idx>	  <from>  <till> <candella> */
				0		0		0		5
				1		1		4		6
				2		5		8		7
				3		9		12		8
				4		13		16		9
				5		17		20		10
				6		21		24		11
				7		25		28		12
				8		29		32		13
				9		33		36		14
				10		37		40		15
				11		41		42		16
				12		43		44		17
				13		45		46		19
				14		47		48		20
				15		49		50		21
				16		51		52		22
				17		53		54		24
				18		55		56		25
				19		57		58		27
				20		59		60		29
				21		61		62		30
				22		63		64		32
				23		65		66		34
				24		67		68		37
				25		69		70		39
				26		71		72		41
				27		73		74		44
				28		75		76		47
				29		77		78		50
				30		79		80		53
				31		81		82		56
				32		83		84		60
				33		85		86		64
				34		87		88		68
				35		89		90		72
				36		91		92		77
				37		93		94		82
				38		95		96		87
				39		97		98		93
				40		99		100		98
				41		101		102		105
				42		103		104		111
				43		105		106		119
				44		107		108		126
				45		109		111		134
				46		112		114		143
				47		115		117		152
				48		118		120		162
				49		121		124		172
				50		125		128		183
				51		129		139		195
				52		140		150		207
				53		151		161		220
				54		162		172		234
				55		173		183		249
				56		184		194		265
				57		195		206		282
				58		207		218		300
				59		219		229		316
				60		230		241		333
				61		242		255		360
		>;
		
		samsung,hbm_candela_map_table_revA = <
				/* <idx> <from> <till> <candela> <auto_brightness> */
				0		256		365		500		6
		>;
	};
};