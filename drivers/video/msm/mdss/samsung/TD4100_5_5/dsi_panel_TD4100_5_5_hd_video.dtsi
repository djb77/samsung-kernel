/* Copyright (c) 2013-14, Samsung Electronics Corporation. All rights reserved.
 *
 * This program is free software; you can redistribute it and/or modify
 * it under the terms of the GNU General Public License version 2 and
 * only version 2 as published by the Free Software Foundation.
 *
 * This program is distributed in the hope that it will be useful,
 * but WITHOUT ANY WARRANTY; without even the implied warranty of
 * MERCHANTABILITY or FITNESS FOR A PARTICULAR PURPOSE.  See the
 * GNU General Public License for more details.
 */

/*---------------------------------------------------------------------------
 * This file is autogenerated file using gcdb parser. Please do not edit it.
 * Update input XML file to add a new entry or update variable in this file
 * VERSION = "1.0"
 *---------------------------------------------------------------------------*/
&mdss_mdp {
	ss_dsi_panel_TD4100_5_5_HD: ss_dsi_panel_TD4100_5_5_HD {
		qcom,mdss-dsi-panel-name = "ss_dsi_panel_TD4100_5_5_HD";
		qcom,mdss-dsi-panel-controller = <&mdss_dsi0>;
		qcom,mdss-dsi-panel-width = <720>;
		qcom,mdss-dsi-panel-height = <1280>;
		qcom,mdss-dsi-bpp = <24>;
		qcom,mdss-dsi-panel-destination = "display_1";
		qcom,mdss-dsi-panel-timings = [B9 2A 1C 00 54 58 22 2E 23 03 04 00];
		qcom,mdss-dsi-panel-timings-phy-v2 = [	/* MSM8953 */
			21 1E 06 07 04 03 04 a0				/* Data 0 */
			21 1E 06 07 04 03 04 a0				/* Data 1 */
			21 1E 06 07 04 03 04 a0				/* Data 2 */
			21 1E 06 07 04 03 04 a0				/* Data 3 */
			21 15 06 07 04 03 04 a0				/* Clk lane */
		];
		qcom,mdss-dsi-on-command = [
			/* Initializing Sequence(1)*/
			39 01 00 00 00 00 02 B0 04			/* Manufacturer command access project */
			39 00 00 00 00 00 04 B3 10 00 06 	/* Interface setting */
			39 00 00 00 00 00 08 B6				/* DSI control */
				32 43 80 00 00 07 86
			39 00 00 00 00 00 07 BA				/* Backlight control 3 */
				07 87 3A 0A 2D 88
			39 00 00 00 00 00 04 BB 00 B4 A0	/* Sunlight readability enhancement */
			39 00 00 00 00 00 04 BC 00 B4 A0	/* Sunlight readbility enhancement */
			39 00 00 00 00 00 04 BD 00 B4 A0	/* Sunlight readbility enhancement */
			39 00 00 00 00 00 02 BE 04			/* External clock setting */
			39 00 00 00 00 00 12 C0				/* Display setting 4 */
				00 00 00 00
				00 00 00 00
				00 00 00 00
				00 00 00 00
				00
			39 00 00 00 00 00 23 C1				/* Display setting 1 */
				04 48 01 00
				33 08 11 00
				11 00 73 23
				23 11 00 00
				00 00 00 00
				00 00 00 00
				00 00 DF 00
				30 00 01 00
				00 00
			39 00 00 00 00 00 14 C2				/* Display setting 2 */
				00 F0 05 00
				0A 04 08 00
				24 19 00 00
				00 00 00 00
				00 01 00
			39 00 00 00 00 00 40 C3				/* Display setting 3 */
				51 15 11 51
				10 00 00 00
				00 00 00 00
				00 00 00 00
				00 00 00 00
				01 01 03 28
				00 01 01 01
				00 00 00 00
				00 00 00 00
				00 00 00 00
				00 00 00 00
				00 00 00 00
				67 01 00 00
				00 00 67 01
				00 00 00 00
				40 20 01
			39 00 00 00 00 00 29 C4				/* Source timing setting and SOUT equalize setting */
				70 01 00 00
				00 00 00 00
				00 00 00 00
				00 00 00 00
				00 00 00 00
				00 00 00 00
				00 00 00 00
				00 00 00 00
				00 00 00 00
				00 00 01 01

			/* Initializing Sequence(2)*/
			39 00 00 00 00 00 0B C5				/* Crosshair */
				08 00 00 00
				00 70 00 00
				2D 41
			39 00 00 00 00 00 22 C6				/* Panel timing setting */
				C2 14 89 00
				00 14 89 00
				00 00 00 00
				00 00 00 00
				00 00 00 00
				00 00 00 00
				00 00 00 00
				00 00 00 C2
				C2
			39 00 00 00 00 00 2F C7				/* Gamma setting common set */
				00 0A 14 21
				2D 37 4F 61
				71 7F 33 40
				4E 64 6E 7D
				90 A0 B0 00
				0A 14 21 2D
				37 4F 61 71
				7F 33 40 4E
				64 6E 7D 90
				A0 B0 00 97
				00 97 00 97
				00 97
			39 00 00 00 00 00 38 C8				/* Digital gamma setting 1 */
				00 00 00 00
				00 FC 00 00
				00 00 00 FC
				00 00 00 00
				00 FC 00 00
				00 00 00 FC
				00 00 00 00
				00 FC 00 00
				00 00 00 FC
				00 00 00 00
				00 FC 00 00
				00 00 00 FC
				00 00 00 00
				00 FC 00
			39 00 00 00 00 00 14 C9				/* Digital gamma setting 2 */
				00 00 00 00
				00 FC 00 00
				00 00 00 FC
				00 00 00 00
				00 FC 00
			39 00 00 00 00 00 2C CA				/* Color enhancement */
				1D FC DC EE 
				00 E6 DB D8 
				00 C9 EE F3 
				00 08 06 00
				00 08 F3 05 
				00 02 00 00
				00 00 00 00
				00 00 00 00
				00 00 00 00
				00 00 00 00
				00 00 00
			39 00 00 00 00 00 2E CC				/* Panel interface control */
				00 00 00 00
				D2 72 12 16
				1A 1E D0 70
				42 46 00 00
				00 00 00 00
				00 00 00 00
				00 00 00 00
				00 00 44 40
				70 D0 1C 18
				14 10 72 D2
				00 00 00 00
				00
			/* Initializing Sequence(3)*/
			39 00 00 00 00 00 14 CD				/* Touch control */
				03 06 69 01
				00 00 00 00
				00 00 00 00
				00 00 00 00
				01 00 00
			39 00 00 00 00 00 19 CE				/* Backlight control 4 */
				7D 40 48 56
				67 78 88 98
				A7 B5 C3 D1
				DE E9 F2 FA
				FF 04 00 01
				04 45 00 00
			39 00 00 00 00 00 03 CF 48 10		/* Panel synchronous output */
			39 00 00 00 00 00 13 D0				/* Power setting for CHGP */
				11 04 59 D9
				03 10 10 40
				19 08 99 00
				00 00 00 00
				00 00
			39 00 00 00 00 00 02 D1 04			/* Touch period and source drive mode select */
			39 00 00 00 00 00 1C D3				/* Power setting for internal power */
				BB 3B 33 3B
				44 3B 44 3B
				00 00 EC 9B
				8B 23 22 B3
				B3 3B BB 4F
				D0 3C 10 12
				10 00 10
			39 00 00 00 00 00 19 D4				/* Temperature sensor */
				80 04 04 33
				00 04 00 00
				00 00 00 00
				00 00 00 00
				00 00 0A 90
				05 00 64 94
			39 00 00 00 00 00 02 D6 41			/* Sequencer test control */

			39 00 00 00 00 00 25 D7				/* Timing control for power on sequencer test mode */
				F6 FF 03 05
				43 24 80 1F
				C7 1F 1B 00
				0F 01 20 08
				80 3F 00 78
				00 40 24 15
				00 33 02 C0
				AF CB 60 30
				FC 00 3F 00
			39 00 00 00 00 00 09 D8				/* Temperature sensor read */
				00 00 00 00
				00 00 00 00
			39 00 00 00 00 00 05 DD				/* Outline sharpening control */
				30 06 23 65

			/* CABC Mode control Function */
			39 00 00 00 00 00 02 53 0C
			39 00 00 00 00 00 02 55 00
			39 01 00 00 00 00 02 5E 30 /*CABC Min off*/

			/* Display on Sequence(4) */
			05 01 00 00 00 00 02 11 00
		];
		qcom,mdss-dsi-off-command = [
			05 01 00 00 00 00 02 28 00	/* no wait */
			05 01 00 00 50 00 02 10 00	/* wait 80ms(0x50) */
		];
		//qcom,mdss-dsi-post-panel-on-command = ;

		//qcom,cmd-sync-wait-broadcast = ;
		//qcom,mdss-dsi-fbc-enable = ;
		//qcom,mdss-dsi-fbc-slice-height = ;
		//qcom,mdss-dsi-fbc-2d-pred-mode = ;
		//qcom,mdss-dsi-fbc-ver2-mode = ;
		//qcom,mdss-dsi-fbc-bpp = ;
		//qcom,mdss-dsi-fbc-packing = ;
		//qcom,mdss-dsi-fbc-quant-error = ;
		//qcom,mdss-dsi-fbc-bias = ;
		//qcom,mdss-dsi-fbc-pat-mode = ;
		//qcom,mdss-dsi-fbc-vlc-mode = ;
		//qcom,mdss-dsi-fbc-bflc-mode = ;
		//qcom,mdss-dsi-fbc-h-line-budget = ;
		//qcom,mdss-dsi-fbc-budget-ctrl = ;
		//qcom,mdss-dsi-fbc-block-budget = ;
		//qcom,mdss-dsi-fbc-lossless-threshold = ;
		//qcom,mdss-dsi-fbc-lossy-threshold = ;
		//qcom,mdss-dsi-fbc-rgb-threshold = ;
		//qcom,mdss-dsi-fbc-lossy-mode-idx = ;
		//qcom,mdss-dsi-fbc-max-pred-err = ;
		qcom,mdss-dsi-h-back-porch = <158>;
		qcom,mdss-dsi-h-front-porch = <252>;
		qcom,mdss-dsi-h-pulse-width = <4>;
		qcom,mdss-dsi-h-sync-skew = <0>;
		qcom,mdss-dsi-v-back-porch = <125>;
		qcom,mdss-dsi-v-front-porch = <127>;
		qcom,mdss-dsi-v-pulse-width = <127>;
		qcom,mdss-dsi-h-left-border = <0>;
		qcom,mdss-dsi-h-right-border = <0>;
		qcom,mdss-dsi-v-top-border = <0>;
		qcom,mdss-dsi-v-bottom-border = <0>;
		qcom,mdss-dsi-underflow-color = <0xff>;
		qcom,mdss-dsi-border-color = <0>;
		//qcom,mdss-dsi-pan-enable-dynamic-fps = ;
		//qcom,mdss-dsi-pan-fps-update = ;
		//qcom,min-refresh-rate = ;
		//qcom,max-refresh-rate = ;
		qcom,mdss-dsi-bl-pmic-control-type = "bl_ctrl_dcs";
		//qcom,mdss-dsi-bl-pwm-pmi = ;
		//qcom,mdss-dsi-bl-pmic-bank-select = ;
		//qcom,mdss-dsi-bl-pmic-pwm-frequency = ;
		//qcom,mdss-dsi-pwm-gpio = ;
		qcom,mdss-dsi-bl-min-level = <1>;
		qcom,mdss-dsi-bl-max-level = <256>;
		qcom,mdss-brightness-max-level = <256>;
		//qcom,mdss-dsi-interleave-mode = ;
		qcom,mdss-dsi-panel-type = "dsi_video_mode";
		//qcom,5v-boost-gpio = ;
		//qcom,mdss-dsi-te-check-enable = ;
		//qcom,mdss-dsi-te-using-te-pin = ;
		//qcom,mdss-dsi-te-pin-select = ;
		//qcom,mdss-dsi-te-dcs-command = ;
		//qcom,mdss-dsi-wr-mem-start = ;
		//qcom,mdss-dsi-wr-mem-continue = ;
		qcom,mdss-dsi-h-sync-pulse = <0>;
		qcom,mdss-dsi-hfp-power-mode;
		//qcom,mdss-dsi-hbp-power-mode;
		//qcom,mdss-dsi-hsa-power-mode;
		//qcom,mdss-dsi-last-line-interleave = ;
		qcom,mdss-dsi-bllp-eof-power-mode;
		qcom,mdss-dsi-bllp-power-mode;
		qcom,mdss-dsi-traffic-mode = "burst_mode";
		qcom,mdss-dsi-pixel-packing = "loose";
		qcom,mdss-dsi-virtual-channel-id = <0>;
		qcom,mdss-dsi-color-order = <0>;
		qcom,mdss-dsi-lane-0-state;
		qcom,mdss-dsi-lane-1-state;
		qcom,mdss-dsi-lane-2-state;
		qcom,mdss-dsi-lane-3-state;
		qcom,mdss-dsi-t-clk-post = <0x0C>;
		qcom,mdss-dsi-t-clk-pre = <0x28>;
		qcom,mdss-dsi-stream = <0>;
		qcom,mdss-dsi-mdp-trigger = "none";
		qcom,mdss-dsi-dma-trigger = "trigger_sw";
		qcom,mdss-dsi-panel-framerate = <60>;
		//qcom,mdss-dsi-panel-clockrate = <510000000>;
		//qcom,mdss-mdp-transfer-time-us = ;
		qcom,mdss-dsi-on-command-state = "dsi_lp_mode"; /* TD4100 : CLK & DATA should be LP11 for 80ms after reset. So we send init_cmds before TG enable */
		qcom,mdss-dsi-off-command-state = "dsi_hs_mode";
		//qcom,mdss-dsi-post-mode-switch-on-command-state = ;
		qcom,mdss-pan-physical-width-dimension = <69>;
		qcom,mdss-pan-physical-height-dimension = <122>;
		//qcom,mdss-dsi-panel-mode-gpio-state = ;
		//qcom,mdss-tear-check-disable = ;
		//qcom,mdss-tear-check-sync-cfg-height = ;
		//qcom,mdss-tear-check-sync-init-val = ;
		//qcom,mdss-tear-check-sync-threshold-start = ;
		//qcom,mdss-tear-check-sync-threshold-continue = ;
		//qcom,mdss-tear-check-start-pos = ;
		//qcom,mdss-tear-check-rd-ptr-trigger-intr = ;
		//qcom,mdss-tear-check-frame-rate = ;
		qcom,mdss-dsi-reset-sequence = <0 1>, <1 1>;
		//qcom,partial-update-enabled = ;
		//qcom,mdss-dsi-horizontal-line-idle = ;
		//qcom,partial-update-roi-merge = ;
		//qcom,dcs-cmd-by-left = ;
		qcom,mdss-dsi-lp11-init;
		qcom,mdss-dsi-init-delay-us = <100>;
		qcom,mdss-dsi-rx-eot-ignore;
		qcom,mdss-dsi-tx-eot-append;
		//qcom,ulps-enabled = ;
		//qcom,suspend-ulps-enabled = ;
		//qcom,panel-roi-alignment = ;
		//qcom,esd-check-enabled;
		//qcom,mdss-dsi-panel-status-command = ;
		//qcom,mdss-dsi-panel-status-command-mode = ;
		//qcom,mdss-dsi-panel-status-check-mode= ;
		//qcom,mdss-dsi-panel-status-read-length = ;
		//qcom,mdss-dsi-panel-status-valid-params = ;
		//qcom,mdss-dsi-panel-status-value = ;
		//qcom,mdss-dsi-panel-max-error-count = ;
		//qcom,dynamic-mode-switch-enabled = ;
		//qcom,dynamic-mode-switch-type = ;
		//qcom,mdss-dsi-post-mode-switch-on-command = ;
		//qcom,video-to-cmd-mode-switch-commands = ;
		//qcom,cmd-to-video-mode-switch-commands = ;
		//qcom,mdss-dsi-panel-orientation = ;
		//qcom,panel-ack-disabled = ;
		//qcom,mdss-dsi-force-clock-lane-hs; /* TD4100 : CLK & DATA should be LP11 for 80ms after reset.  samsung,dsi_force_clock_lane_hs is enabled*/
		//qcom,compression-mode = ;
		//qcom,panel-supply-entries = ;
		//qcom,config-select = ;
		//qcom,lm-split = ;
		//qcom,split-mode = ;
		//qcom,mdss-dsc-encoders = ;
		//qcom,mdss-dsc-slice-height = ;
		//qcom,mdss-dsc-slice-width = ;
		//qcom,mdss-dsc-slice-per-pkt = ;
		//qcom,mdss-dsc-bit-per-component = ;
		//qcom,mdss-dsc-bit-per-pixel = ;
		//qcom,mdss-dsc-block-prediction-enable = ;
		//qcom,mdss-dsc-config-by-manufacture-cmd = ;
		//qcom,dba-panel = ;
		//qcom,bridge-name = ;
		//qcom,adjust-timer-wakeup-ms = ;
		//qcom,mdss-dsi-display-timings = ;
		//qcom,mdss-dsi-timing-default = ;
		//qcom,mdss-dsi-timing-switch-command = ;
		//qcom,mdss-dsi-timing-switch-command-state  = ;

/*
 * ************************************************************************************************************************************
 *
 *
 *			Below  parameters are samsung dependent thigs
 *
 *
 * ************************************************************************************************************************************
 */
 		samsung,panel-vendor = "BOE";
		samsung,tft-common-support;
		samsung,enter_hbm_lux = <20000>;
		samsung,support_mdnie_lite;
		samsung,dsi_force_clock_lane_hs;  /* TD4100 : CLK & DATA should be LP11 for 80ms after reset. */

		/* To use device_resume & device_suspend for optimizing display on time */
		samsung,reduce_display_on_time;
		samsung,wait_after_reset_delay = <80>; /* Flash loading time */
		samsung,wait_after_sleep_out_delay = <90>; /* More than 5frame 16.6 * 5 = 83ms+margin 7ms*/

		samsung,level1_key_enable_tx_cmds_revA = [
			39 01 00 00 00 00 02 B0 04
		];
		samsung,level1_key_disable_tx_cmds_revA = [
			39 01 00 00 00 00 02 B0 04
		];

		samsung,packet_size_tx_cmds_revA = [
			37 01 00 00 00 00 02 07 00
		];

		samsung,display_on_tx_cmds_revA = [
			05 01 00 00 00 00 02 29 00
		];

		samsung,display_off_tx_cmds_revA = [05 01 00 00 00 00 02 28 00];

		/*
		 * First parameters can be changed
		 * by function of samsung_nv_read()
		 * because of that means offset of
		 * read position
		 */
		samsung,reg_read_pos_tx_cmds_revA = [
			15 01 00 00 00 00 02 B0 00
		];

		samsung,mtp_read_sysfs_rx_cmds_revA = [06 01 00 00 00 00 01 00 00 00];
		samsung,manufacture_id0_rx_cmds_revA = [06 01 00 00 00 00 01 da 01 00];
		samsung,manufacture_id1_rx_cmds_revA = [06 01 00 00 00 00 01 db 01 00];
		samsung,manufacture_id2_rx_cmds_revA = [06 01 00 00 00 00 01 dc 01 00];

		samsung,tft_pwm_tx_cmds_revA=[
			39 01 00 00 00 00 02 51 FF/*First command should be PWM duty change command */
		];
		samsung,cabc_on_tx_cmds_revA = [
			39 01 00 00 00 00 02 55 01
		];
		samsung,cabc_off_tx_cmds_revA = [
			39 01 00 00 00 00 02 55 00
		];
		/*
		* ************************************************************************************************************************
		* Scaled level to index mappings
		* ************************************************************************************************************************
		*/
		samsung,candela_map_table_revA = <
		/*<idx>	  <from>  <till> <scaled_level> */
			0	0	1	0
			1	2	2	2
			2	3	3	3
			3	4	5	5	/* MIN 5 cd */
			4	6	6	10
			5	7	7	12
			6	8	8	15
			7	9	9	17
			8	10	10	20	/* DIM 20 CD */
			9	11	12	22
			10	13	14	24
			11	15	15	27
			12	16	17	29
			13	18	19	31
			14	20	20	33
			15	21	22	36
			16	23	23	38
			17	24	25	40
			18	26	27	42
			19	28	28	45
			20	29	30	47
			21	31	32	49
			22	33	33	51
			23	34	35	54
			24	36	37	56
			25	38	38	58
			26	39	40	60
			27	41	41	63
			28	42	43	65
			29	44	44	67
			29	45	45	69
			30	46	46	71
			31	47	48	74
			32	49	49	76
			32	50	50	78
			33	51	51	80
			34	52	53	83
			35	54	54	85
			35	55	55	87
			36	56	56	89
			37	57	58	92
			38	59	59	94
			39	60	60	96
			39	61	61	98
			40	62	63	101
			41	64	64	103
			42	65	66	105
			43	67	68	107
			44	69	69	109
			45	70	71	112
			46	72	73	114
			47	74	74	116
			48	75	76	118
			49	77	78	121
			50	79	79	123
			51	80	81	125
			52	82	82	127
			53	83	84	130
			54	85	86	132
			55	87	87	134
			56	88	89	136
			57	90	91	139
			58	92	92	141
			59	93	94	143
			60	95	96	145
			61	97	97	148
			62	98	99	150
			63	100	100	152
			64	101	102	154
			65	103	104	156
			66	105	105	159
			67	106	107	161
			68	108	109	163
			69	110	110	165
			70	111	112	168
			71	113	114	170
			72	115	115	172
			73	116	117	174
			74	118	118	177
			75	119	120	179
			76	121	122	181
			77	123	123	183
			78	124	125	186
			79	126	127	188
			80	128	128	190
			81	129	129	192
			82	130	130	195
			83	131	131	197
			84	132	132	199
			85	133	133	202
			86	134	134	204
			87	135	135	206
			89	136	136	208
			90	137	137	211
			91	138	138	213
			92	139	139	215
			93	140	140	218
			94	141	141	220
			95	142	142	222
			96	143	143	225
			97	144	144	227
			98	145	145	229
			99	146	146	231
			100	147	147	234
			101	148	148	236
			102	149	149	238
			103	150	150	241
			104	151	151	243
			106	152	152	245
			107	153	153	248
			108	154	154	250
			109	155	155	252
			110	156	156	254
			111	157	157	257
			112	158	158	259
			113	159	159	261
			114	160	160	264
			115	161	161	266
			116	162	162	268
			117	163	163	271
			118	164	164	273
			119	165	165	275
			120	166	166	277
			121	167	167	280
			123	168	168	282
			124	169	169	284
			125	170	170	287
			126	171	171	289
			127	172	172	291
			128	173	173	294
			129	174	174	296
			130	175	175	298
			131	176	176	300
			132	177	177	303
			133	178	178	305
			134	179	179	307
			135	180	180	310
			136	181	181	312
			137	182	182	314
			138	183	183	317
			140	184	184	319
			141	185	185	321
			142	186	186	323
			143	187	187	326
			144	188	188	328
			145	189	189	330
			146	190	190	333
			147	191	191	335
			148	192	192	337
			149	193	193	340
			150	194	194	342
			151	195	195	344
			152	196	196	347
			153	197	197	349
			154	198	198	351
			155	199	199	353
			157	200	200	356
			158	201	201	358
			159	202	202	360
			160	203	203	363
			161	204	204	365
			162	205	205	367
			163	206	206	370
			164	207	208	372
			166	209	209	374
			167	210	210	376
			168	211	211	379
			169	212	212	381
			170	213	213	383
			171	214	214	386
			172	215	215	388
			174	216	216	390
			175	217	217	393
			176	218	218	395
			177	219	219	397
			178	220	220	399
			179	221	221	402
			180	222	222	404
			181	223	223	406
			182	224	224	409
			183	225	225	411
			184	226	226	413
			185	227	227	416
			186	228	228	418
			187	229	229	420
			188	230	230	422
			189	231	231	425
			191	232	232	427
			192	233	233	429
			193	234	234	432
			194	235	235	434
			195	236	236	436
			196	237	237	439
			197	238	238	441
			198	239	239	443
			199	240	240	445
			200	241	241	448
			201	242	242	450
			202	243	243	452
			203	244	244	455
			204	245	245	457
			205	246	246	459
			206	247	247	462
			208	248	248	464
			209	249	249	466
			210	250	250	468
			211	251	251	471
			212	252	252	473
			213	253	253	475
			214	254	254	478
			215	255	255	480	/* MAX 480 CD */
			255	256	256	550	/* outdoor max 550CD */
		>;
	};
};
