/* Copyright (c) 2013-2014, The Linux Foundation. All rights reserved.
 *
 * This program is free software; you can redistribute it and/or modify
 * it under the terms of the GNU General Public License version 2 and
 * only version 2 as published by the Free Software Foundation.
 *
 * This program is distributed in the hope that it will be useful,
 * but WITHOUT ANY WARRANTY; without even the implied warranty of
 * MERCHANTABILITY or FITNESS FOR A PARTICULAR PURPOSE.  See the
 * GNU General Public License for more details.
 */

/*---------------------------------------------------------------------------
 * This file is autogenerated file using gcdb parser. Please do not edit it.
 * Update input XML file to add a new entry or update variable in this file
 * VERSION = "1.0"
 *---------------------------------------------------------------------------*/
&mdss_mdp {
	ss_dsi_panel_S6E3FA3_AMS568HN31_FHD: ss_dsi_panel_S6E3FA3_AMS568HN31_FHD {
		qcom,mdss-dsi-panel-name = "ss_dsi_panel_S6E3FA3_AMS568HN31_FHD";
		qcom,mdss-dsi-panel-controller = <&mdss_dsi0>;
		qcom,mdss-dsi-panel-width = <1080>;
		qcom,mdss-dsi-panel-height = <1920>;
		qcom,mdss-dsi-bpp = <24>;
		qcom,mdss-dsi-panel-destination = "display_1";

		qcom,mdss-dsi-panel-timings = [E6 38 26 00 68 6E 2A 46 2C 03 04 00];
		qcom,mdss-dsi-panel-timings-8996 = [
			24 1F 08 09 05 03 04 a0
			24 1F 08 09 05 03 04 a0
			24 1F 08 09 05 03 04 a0
			24 1F 08 09 05 03 04 a0
			24 1B 08 09 05 03 04 a0];

		qcom,mdss-dsi-on-command= [
			05 01 00 00 14 00 02 11 00		/* Sleep out, wait 20ms(0x14) */

			/* TE Vsync On */
			29 01 00 00 00 00 02 35 00

			/* AVC setting */
			29 01 00 00 00 00 03 FC 5A 5A		/* TEST KEY Enable */
			29 01 00 00 00 00 02 B0 1E
			29 01 00 00 00 00 02 FD 94
			29 01 00 00 00 00 03 FC A5 A5

			/* PCD Setting */
			29 01 00 00 00 00 03 F0 5A 5A		/* TEST KEY Enable */
			29 01 00 00 00 00 02 CC 4C
			29 01 00 00 00 00 03 F0 A5 A5

			/* ERR_FG Setting */
			29 01 00 00 00 00 03 F0 5A 5A		/* TEST KEY Enable */
			29 01 00 00 00 00 02 ED 44
			29 01 00 00 00 00 03 F0 A5 A5

			/* TsHL Setting */
			29 01 00 00 00 00 03 F0 5A 5A		/* TEST KEY Enable */
			29 01 00 00 00 00 02 B0 10
			29 01 00 00 00 00 02 B6 7F
			29 01 00 00 00 00 03 F0 A5 A5

			/* Brightness condition set */
			29 01 00 00 00 00 03 F0 5A 5A		/* TEST KEY Enable */
			29 01 00 00 00 00 24 CA			/* 1) Gamma 2.2 Setting */
				01 00 01 00 01 00		/* V255 R,G,B */
				80 80 80			/* V203 R,G,B */
				80 80 80			/* V151 R,G,B */
				80 80 80			/* V87 R,G,B */
				80 80 80			/* V51 R,G,B */
				80 80 80			/* V35 R,G,B */
				80 80 80			/* V23 R,G,B */
				80 80 80			/* V11 R,G,B */
				80 80 80			/*  V3 R,G,B */
				00 00 00			/*  V0 R,G,B */
				00 00				/*  VT R,G,B */
			29 01 00 00 00 00 03 B2 00 C2		/* AID set : AOR 10% */
			29 01 00 00 00 00 03 B6 BC 0A		/* CAPS ELVSS Set(ACL ON : 0x8C) */
			29 01 00 00 00 00 03 F4 7B 1E		/* VINT Set */
			29 01 00 00 00 00 02 F7 03		/* Gamma, LTPS(AID) update */
			29 01 00 00 78 00 03 F0 A5 A5		/* TEST KEY Disable */

			/* Memory Access */
			05 01 00 00 00 00 02 2C 00
			05 01 00 00 00 00 02 3C 00
		];

		qcom,mdss-dsi-off-command=[
			05 01 00 00 0A 00 02 28 00	/* wait 10ms(0x0A) */
			05 01 00 00 96 00 02 10 00	/* wait 150ms(0x96) */
		];

		qcom,cont-splash-enabled;
		qcom,mdss-dsi-force-clk-lane-hs;
		/*qcom,cmd-sync-wait-broadcast;*/
		/*qcom,cmd-sync-wait-trigger;*/
		/*qcom,mdss-dsi-fbc-enable=*/
		/*qcom,mdss-dsi-fbc-bpp=*/
		/*qcom,mdss-dsi-fbc-packing=*/
		/*qcom,mdss-dsi-fbc-quant-error=*/
		/*qcom,mdss-dsi-fbc-bias=*/
		/*qcom,mdss-dsi-fbc-pat-mode=*/
		/*qcom,mdss-dsi-fbc-vlc-mode=*/
		/*qcom,mdss-dsi-fbc-bflc-mode=*/
		/*qcom,mdss-dsi-fbc-h-line-budget=*/
		/*qcom,mdss-dsi-fbc-budget-ctrl=*/
		/*qcom,mdss-dsi-fbc-block-budget=*/
		/*qcom,mdss-dsi-fbc-lossless-threshold=*/
		/*qcom,mdss-dsi-fbc-lossy-threshold=*/
		/*qcom,mdss-dsi-fbc-rgb-threshold=*/
		/*qcom,mdss-dsi-fbc-lossy-mode-idx=*/

		qcom,mdss-dsi-h-back-porch = <36>;
		qcom,mdss-dsi-h-front-porch = <160>;
		qcom,mdss-dsi-h-pulse-width = <12>;
		qcom,mdss-dsi-h-sync-skew = <0>;
		qcom,mdss-dsi-v-back-porch = <7>;
		qcom,mdss-dsi-v-front-porch = <7>;
		qcom,mdss-dsi-v-pulse-width = <2>;

		qcom,mdss-dsi-h-left-border = <0>;
		qcom,mdss-dsi-h-right-border = <0>;
		qcom,mdss-dsi-v-top-border = <0>;
		qcom,mdss-dsi-v-bottom-border = <0>;

		qcom,mdss-dsi-underflow-color = <0xFF>;
		qcom,mdss-dsi-border-color = <0>;

		/*qcom,mdss-dsi-pan-enable-dynamic-fps=*/
		/*qcom,mdss-dsi-pan-fps-update=*/

		qcom,mdss-dsi-bl-pmic-control-type = "bl_ctrl_dcs";
		/*qcom,mdss-dsi-bl-pmic-bank-select=*/
		/*qcom,mdss-dsi-bl-pmic-pwm-frequency=*/
		/*qcom,mdss-dsi-pwm-gpio=*/

		qcom,mdss-dsi-bl-min-level = <1>;
		qcom,mdss-dsi-bl-max-level = <365>;
		qcom,mdss-brightness-max-level = <365>;
		qcom,mdss-dsi-interleave-mode = <0>;
		qcom,mdss-dsi-panel-type = "dsi_cmd_mode";

		qcom,mdss-dsi-te-check-enable;
		qcom,mdss-dsi-te-using-te-pin;
		qcom,mdss-dsi-te-pin-select = <1>;

		qcom,mdss-dsi-te-dcs-command = <1>;
		qcom,mdss-dsi-wr-mem-start = <0x2C>;
		qcom,mdss-dsi-wr-mem-continue = <0x3C>;

		/* CMD mode panel doesn't need below stuff */
		qcom,mdss-dsi-h-sync-pulse= <0>;
		/*qcom,mdss-dsi-hfp-power-mode=*/
		/*qcom,mdss-dsi-hbp-power-mode=*/
		/*qcom,mdss-dsi-hsa-power-mode=*/
		/*qcom,mdss-dsi-last-line-interleave=*/
		qcom,mdss-dsi-bllp-eof-power-mode;
		qcom,mdss-dsi-bllp-power-mode;
		qcom,mdss-dsi-traffic-mode= "burst_mode";

		qcom,mdss-dsi-pixel-packing = "loose";

		qcom,mdss-dsi-virtual-channel-id = <0>;
		qcom,mdss-dsi-color-order = "rgb_swap_rgb";
		qcom,mdss-dsi-lane-0-state;
		qcom,mdss-dsi-lane-1-state;
		qcom,mdss-dsi-lane-2-state;
		qcom,mdss-dsi-lane-3-state;
		qcom,mdss-dsi-lane-map = "lane_map_0123";

		qcom,mdss-dsi-t-clk-pre = <0x30>;
		qcom,mdss-dsi-t-clk-post = <0x0D>;

		qcom,mdss-dsi-stream = <0>;
		qcom,mdss-dsi-mdp-trigger = "none";
		qcom,mdss-dsi-dma-trigger = "trigger_sw";
		qcom,mdss-dsi-panel-framerate = <60>;
		qcom,mdss-dsi-panel-clockrate = <850000000>;
		qcom,mdss-dsi-on-command-state = "dsi_lp_mode";
		qcom,mdss-dsi-off-command-state = "dsi_hs_mode";

		qcom,mdss-pan-physical-width-dimension = <69>;
		qcom,mdss-pan-physical-height-dimension = <122>;

		qcom,mdss-dsi-panel-mode-gpio-state = "invalid";

		qcom,mdss-dsi-reset-sequence = <1 20>, <0 20>, <1 20>;
		// S6E3FA3(LDI) does not support Partial-update
		/*qcom,partial-update-enabled;*/
		/*qcom,panel-roi-alignment=<8 8 1 1 1 1>;*/
		/*qcom,mdss-dsi-horizontal-line-idle*/

		qcom,mdss-dsi-lp11-init;
		qcom,mdss-dsi-init-delay-us = <1000>;

		qcom,mdss-dsi-rx-eot-ignore;
		qcom,mdss-dsi-tx-eot-append;

		/*qcom,ulps-enabled*/
		/*qcom,mdss-dsi-panel-status-command=*/
		/*qcom,mdss-dsi-panel-status-command-mode="dsi_lp_mode";*/
		qcom,esd-check-enabled;
		qcom,mdss-dsi-panel-status-check-mode="reg_read_irq";
		qcom,mdss-dsi-panel-status-value = <1>;
		qcom,mdss-dsi-panel-status-irq-trigger1="rising";
		qcom,mdss-dsi-panel-status-read-length = <1>;
		/*qcom,dynamic-mode-switch-enabled*/
		/*qcom,video-to-cmd-mode-switch-commands=*/
		/*qcom,cmd-to-video-mode-switch-commands=*/
/*
 * ************************************************************************************************************************************
 *
 *
 *			Below  parameters are samsung dependent thigs
 *
 *
 * ************************************************************************************************************************************
 */
 		samsung,support_panel_max = <1>;
		samsung,hw-config = "single_dsi";
		samsung,support_mdnie_lite;

		//samsung,dsi-lp11-init;
		samsung,mdss-power-on-reset-delay-us = <3000>;
		/*samsung,osc-te-fitting-enable; */
		/*
		 * Index of te fitting command from
		 * "qcom,mdss-dsi-on-command" and
		 * "samsung,osc_te_fitting_tx_cmds_revA"
		 */
		samsung,osc-te-fitting-cmd-index = <16 03>;
		/* Check the duration of N-1 vsync */
		samsung,osc-te-fitting-sampling-rate = <5>;
		samsung,display_on_tx_cmds_revA = [05 01 00 00 32 00 02 29 00];
		samsung,display_off_tx_cmds_revA = [05 01 00 00 32 00 02 28 00];

		samsung,level1_key_enable_tx_cmds_revA = [
			29 01 00 00 00 00 03 F0 5A 5A
		];
		samsung,level1_key_disable_tx_cmds_revA = [
			29 01 00 00 00 00 03 F0 A5 A5
		];
		samsung,level2_key_enable_tx_cmds_revA = [
			29 00 00 00 00 00 03 F0 5A 5A
			29 01 00 00 00 00 03 FC 5A 5A
		];
		samsung,level2_key_disable_tx_cmds_revA = [
			29 00 00 00 00 00 03 F0 A5 A5
			29 01 00 00 00 00 03 FC A5 A5
		];

		samsung,packet_size_tx_cmds_revA = [
			37 01 00 00 00 00 02 07 00
		];

		/*
		 * First parameters can be changed
		 * by function of samsung_nv_read()
		 * because of that means offset of
		 * read position
		 */
		samsung,reg_read_pos_tx_cmds_revA = [
			15 01 00 00 00 00 02 B0 00
		];

		/*
		 * ************************************************************************************************************************
		 *	 06 01 00 00 00 00 01 c8 07 21
		 *	READ 0xC8 SIZE 0x07 OFFSET 0x21
		 * ************************************************************************************************************************
		 */
		samsung,smart_dimming_mtp_rx_cmds_revA = [ 06 01 00 00 00 00 01 c8 23 00];
		/* the last byte in all read commands will represent READ LENGH */
		samsung,manufacture_id0_rx_cmds_revA = [ 06 01 00 00 00 00 01 da 01 00];
		samsung,manufacture_id1_rx_cmds_revA = [ 06 01 00 00 00 00 01 db 01 00];
		samsung,manufacture_id2_rx_cmds_revA = [ 06 01 00 00 00 00 01 dc 01 00];

		samsung,manufacture_date_rx_cmds_revA = [ 06 01 00 00 00 00 01 c8 02 28];	/* read C8 41~42th , 40=0x28*/
		samsung,ddi_id_rx_cmds_revA = [ 06 01 00 00 00 00 01 d6 05 00];		/* read D6 1~5th */
		samsung,cell_id_rx_cmds_revA = [ 06 01 00 00 00 00 01 C8 0B 28];		/* read C8 41~51th, 40=0x28 */
		samsung,mtp_read_sysfs_rx_cmds_revA = [ 06 01 00 00 00 00 01 01 01 01];

		samsung,elvss_rx_cmds_revA = [ 06 01 00 00 00 00 01 B6 02 15];		/* read B6 22, 23th , 21=0x15*/
		samsung,mdnie_read_rx_cmds_revA	= [ 06 01 00 00 00 00 01 A1 04 00];

		samsung,ldi_debug0_rx_cmds_revA = [06 01 00 00 00 00 01 0A 01 00];
		samsung,ldi_debug1_rx_cmds_revA = [06 01 00 00 00 00 01 0E 01 00];
		samsung,ldi_debug2_rx_cmds_revA = [06 01 00 00 00 00 01 EA 08 00];

		/*
		 * ************************************************************************************************************************
		 *	 COMMON CMD LIST
		 * ************************************************************************************************************************
		 */

		samsung,elvss_lowtemp_tx_cmds_revA = [
			29 01 00 00 00 00 02 B8 19
		];	/* Low Temperature Command */

		samsung,elvss_lowtemp2_tx_cmds_revA = [
			29 01 00 00 00 00 02 B0 15
			29 01 00 00 00 00 02 B6 00
		];	/* Low Temperature Command: default */

		samsung,gamma_tx_cmds_revA = [
			29 01 00 00 00 00 24 CA	/* 1) Gamma 2.2 Setting */
				01 00 01 00 01 00	/* V255 R,G,B */
				80 80 80		/* V203 R,G,B */
				80 80 80		/* V151 R,G,B */
				80 80 80		/* V87 R,G,B */
				80 80 80		/* V51 R,G,B */
				80 80 80		/* V35 R,G,B */
				80 80 80		/* V23 R,G,B */
				80 80 80		/* V11 R,G,B */
				80 80 80		/*  V3 R,G,B */
				00 00 00		/*  V0 R,G,B */
				00 00			/*  VT R,G,B */
			29 01 00 00 00 00 02 00 00
			29 01 00 00 00 00 02 F7 03	/* Gamma, LTPS(AID) update */

			29 01 00 00 00 00 3C		/* dummy for single transmission more 100ns delay */
			00 00 00 00 00 00 00 00 00 00
			00 00 00 00 00 00 00 00 00 00
			00 00 00 00 00 00 00 00 00 00
			00 00 00 00 00 00 00 00 00 00
			00 00 00 00 00 00 00 00 00 00
			00 00 00 00 00 00 00 00 00 00

			29 01 00 00 00 00 02 F7 00
		];

		/*
		* ************************************************************************************************************************
		*  HBM
		* ************************************************************************************************************************
		*/

		samsung,hbm_rx_cmds_revA  = [ 06 01 00 00 00 00 01 B4 04 00];	/* read B4 1th~4th */
		samsung,hbm2_rx_cmds_revA = [ 06 01 00 00 00 00 01 B4 1D 04];	/* read B4 5th~33th */

		samsung,hbm_gamma_tx_cmds_revA = [
			29 01 00 00 00 00 24 CA
				01 00 01 00 01 00
				80 80 80
				80 80 80
				80 80 80
				80 80 80
				80 80 80
				80 80 80
				80 80 80
				80 80 80
				00 00 00
				00 00
			29 01 00 00 00 00 03 B2 00 C2		// AID set : AOR 10%
			29 01 00 00 00 00 02 F7 03
		];

		samsung,hbm_etc_tx_cmds_revA = [		// HBM interpolation: 465~578 + 600 nit
			29 01 00 00 00 00 03 B2 00 C2		// AID set : AOR 10%
			29 01 00 00 00 00 03 B6 BC 12		// HBM ELVSS (B6h : 2nd Para)
			29 01 00 00 00 00 02 B0 15		// Global para(21th)
			29 01 00 00 00 00 02 B6 00		// HBM ELVSS (B6h : 22nd Para)
			29 01 00 00 00 00 05 B5 50 99 14 0A	// ACL OPR 32 Frame Average, 60% StartPoint, 15% ACL
			29 01 00 00 00 00 02 55 02		// ACL ON
			29 01 00 00 00 00 03 F4 7B 1E		// VINT
			29 01 00 00 00 00 02 53 00		// HBM Off
			29 01 00 00 00 00 02 F7 03		// Gamma, LTPS(AID) update
		];

		samsung,hbm_off_tx_cmds_revA = [
			29 01 00 00 00 00 02 53 00		/* HBM Off */
		];

		/*
		 * ************************************************************************************************************************
		 * AID command list and mappings
		 * ************************************************************************************************************************
		 */
		/* bl_level, Index in acl command list */
		samsung,aid_tx_cmds_revA = [
			29 01 00 00 00 00 03 B2 70 7B	  /*   2 CD :  0 */
			29 01 00 00 00 00 03 B2 70 6C	  /*   3 CD :  1 */
			29 01 00 00 00 00 03 B2 70 5D	  /*   4 CD :  2 */
			29 01 00 00 00 00 03 B2 70 4F	  /*   5 CD :  3 */
			29 01 00 00 00 00 03 B2 70 3F	  /*   6 CD :  4 */
			29 01 00 00 00 00 03 B2 70 39	  /*   7 CD :  5 */
			29 01 00 00 00 00 03 B2 70 2B	  /*   8 CD :  6 */
			29 01 00 00 00 00 03 B2 70 1C	  /*   9 CD :  7 */
			29 01 00 00 00 00 03 B2 70 0D	  /*  10 CD :  8 */
			29 01 00 00 00 00 03 B2 70 07	  /*  11 CD :  9 */
			29 01 00 00 00 00 03 B2 60 F9	  /*  12 CD : 10 */
			29 01 00 00 00 00 03 B2 60 EB	  /*  13 CD : 11 */
			29 01 00 00 00 00 03 B2 60 DA	  /*  14 CD : 12 */
			29 01 00 00 00 00 03 B2 60 CB	  /*  15 CD : 13 */
			29 01 00 00 00 00 03 B2 60 BC	  /*  16 CD : 14 */
			29 01 00 00 00 00 03 B2 60 AB	  /*  17 CD : 15 */
			29 01 00 00 00 00 03 B2 60 8B	  /*  19 CD : 16 */
			29 01 00 00 00 00 03 B2 60 78	  /*  20 CD : 17 */
			29 01 00 00 00 00 03 B2 60 69	  /*  21 CD : 18 */
			29 01 00 00 00 00 03 B2 60 5B	  /*  22 CD : 19 */
			29 01 00 00 00 00 03 B2 60 3A	  /*  24 CD : 20 */
			29 01 00 00 00 00 03 B2 60 2C	  /*  25 CD : 21 */
			29 01 00 00 00 00 03 B2 60 0E	  /*  27 CD : 22 */
			29 01 00 00 00 00 03 B2 50 F6	  /*  29 CD : 23 */
			29 01 00 00 00 00 03 B2 50 DE	  /*  30 CD : 24 */
			29 01 00 00 00 00 03 B2 50 C8	  /*  32 CD : 25 */
			29 01 00 00 00 00 03 B2 50 AB	  /*  34 CD : 26 */
			29 01 00 00 00 00 03 B2 50 7E	  /*  37 CD : 27 */
			29 01 00 00 00 00 03 B2 50 5E	  /*  39 CD : 28 */
			29 01 00 00 00 00 03 B2 50 3C	  /*  41 CD : 29 */
			29 01 00 00 00 00 03 B2 50 0F	  /*  44 CD : 30 */
			29 01 00 00 00 00 03 B2 40 DF	  /*  47 CD : 31 */
			29 01 00 00 00 00 03 B2 40 AD	  /*  50 CD : 32 */
			29 01 00 00 00 00 03 B2 40 8A	  /*  53 CD : 33 */
			29 01 00 00 00 00 03 B2 40 54	  /*  56 CD : 34 */
			29 01 00 00 00 00 03 B2 40 18	  /*  60 CD : 35 */
			29 01 00 00 00 00 03 B2 30 D6	  /*  64 CD : 36 */
			29 01 00 00 00 00 03 B2 30 96	  /*  68 CD : 37 */
			29 01 00 00 00 00 03 B2 30 55	  /*  72 CD : 38 */
			29 01 00 00 00 00 03 B2 30 40	  /*  77 CD : 39 */
			29 01 00 00 00 00 03 B2 30 40	  /*  82 CD : 40 */
			29 01 00 00 00 00 03 B2 30 40	  /*  87 CD : 41 */
			29 01 00 00 00 00 03 B2 30 40	  /*  93 CD : 42 */
			29 01 00 00 00 00 03 B2 30 40	  /*  98 CD : 43 */
			29 01 00 00 00 00 03 B2 30 40	  /* 105 CD : 44 */
			29 01 00 00 00 00 03 B2 30 40	  /* 111 CD : 45 */
			29 01 00 00 00 00 03 B2 30 40	  /* 119 CD : 46 */
			29 01 00 00 00 00 03 B2 30 40	  /* 126 CD : 47 */
			29 01 00 00 00 00 03 B2 30 40	  /* 134 CD : 48 */
			29 01 00 00 00 00 03 B2 30 40	  /* 143 CD : 49 */
			29 01 00 00 00 00 03 B2 30 40	  /* 152 CD : 50 */
			29 01 00 00 00 00 03 B2 30 40	  /* 162 CD : 51 */
			29 01 00 00 00 00 03 B2 30 40	  /* 172 CD : 52 */
			29 01 00 00 00 00 03 B2 30 40	  /* 183 CD : 53 */
			29 01 00 00 00 00 03 B2 20 EF	  /* 195 CD : 54 */
			29 01 00 00 00 00 03 B2 20 9C	  /* 207 CD : 55 */
			29 01 00 00 00 00 03 B2 20 3A	  /* 220 CD : 56 */
			29 01 00 00 00 00 03 B2 10 CC	  /* 234 CD : 57 */
			29 01 00 00 00 00 03 B2 10 90	  /* 249 CD : 58 */
			29 01 00 00 00 00 03 B2 10 90	  /* 265 CD : 59 */
			29 01 00 00 00 00 03 B2 10 90	  /* 282 CD : 60 */
			29 01 00 00 00 00 03 B2 10 90	  /* 300 CD : 61 */
			29 01 00 00 00 00 03 B2 10 90	  /* 316 CD : 62 */
			29 01 00 00 00 00 03 B2 10 90	  /* 333 CD : 63 */
			29 01 00 00 00 00 03 B2 10 90	  /* 350 CD : 64 */
			29 01 00 00 00 00 03 B2 10 90	  /* 357 CD : 65 */
			29 01 00 00 00 00 03 B2 10 90	  /* 365 CD : 66 */
			29 01 00 00 00 00 03 B2 10 6D	  /* 372 CD : 67 */
			29 01 00 00 00 00 03 B2 10 3E	  /* 380 CD : 68 */
			29 01 00 00 00 00 03 B2 10 1D	  /* 387 CD : 69 */
			29 01 00 00 00 00 03 B2 00 EE	  /* 395 CD : 70 */
			29 01 00 00 00 00 03 B2 00 C2	  /* 403 CD : 71 */
			29 01 00 00 00 00 03 B2 00 C2	  /* 412 CD : 72 */
			29 01 00 00 00 00 03 B2 00 C2	  /* 420 CD : 73 */
		];

		samsung,aid_subdivision_tx_cmds_revA = [
			29 01 00 00 00 00 03 B2 70 7B  /*   0 */
			29 01 00 00 00 00 03 B2 70 79  /*   1 */
			29 01 00 00 00 00 03 B2 70 75  /*   2 */
			29 01 00 00 00 00 03 B2 70 73  /*   3 */
			29 01 00 00 00 00 03 B2 70 6F  /*   4 */
			29 01 00 00 00 00 03 B2 70 6D  /*   5 */
			29 01 00 00 00 00 03 B2 70 6C  /*   6 */
			29 01 00 00 00 00 03 B2 70 6B  /*   7 */
			29 01 00 00 00 00 03 B2 70 6A  /*   8 */
			29 01 00 00 00 00 03 B2 70 69  /*   9 */
			29 01 00 00 00 00 03 B2 70 62  /*  10 */
			29 01 00 00 00 00 03 B2 70 5F  /*  11 */
			29 01 00 00 00 00 03 B2 70 5E  /*  12 */
			29 01 00 00 00 00 03 B2 70 5D  /*  13 */
			29 01 00 00 00 00 03 B2 70 5C  /*  14 */
			29 01 00 00 00 00 03 B2 70 5B  /*  15 */
			29 01 00 00 00 00 03 B2 70 5A  /*  16 */
			29 01 00 00 00 00 03 B2 70 59  /*  17 */
			29 01 00 00 00 00 03 B2 70 53  /*  18 */
			29 01 00 00 00 00 03 B2 70 4F  /*  19 */
			29 01 00 00 00 00 03 B2 70 4E  /*  20 */
			29 01 00 00 00 00 03 B2 70 4D  /*  21 */
			29 01 00 00 00 00 03 B2 70 4C  /*  22 */
			29 01 00 00 00 00 03 B2 70 4B  /*  23 */
			29 01 00 00 00 00 03 B2 70 49  /*  24 */
			29 01 00 00 00 00 03 B2 70 46  /*  25 */
			29 01 00 00 00 00 03 B2 70 42  /*  26 */
			29 01 00 00 00 00 03 B2 70 3F  /*  27 */
			29 01 00 00 00 00 03 B2 70 3E  /*  28 */
			29 01 00 00 00 00 03 B2 70 3D  /*  29 */
			29 01 00 00 00 00 03 B2 70 3C  /*  30 */
			29 01 00 00 00 00 03 B2 70 3B  /*  31 */
			29 01 00 00 00 00 03 B2 70 3A  /*  32 */
			29 01 00 00 00 00 03 B2 70 3A  /*  33 */
			29 01 00 00 00 00 03 B2 70 39  /*  34 */
			29 01 00 00 00 00 03 B2 70 32  /*  35 */
			29 01 00 00 00 00 03 B2 70 2B  /*  36 */
			29 01 00 00 00 00 03 B2 70 24  /*  37 */
			29 01 00 00 00 00 03 B2 70 1C  /*  38 */
			29 01 00 00 00 00 03 B2 70 14  /*  39 */
			29 01 00 00 00 00 03 B2 70 0D  /*  40 */
			29 01 00 00 00 00 03 B2 70 0A  /*  41 */
			29 01 00 00 00 00 03 B2 70 07  /*  42 */
			29 01 00 00 00 00 03 B2 70 00  /*  43 */
			29 01 00 00 00 00 03 B2 60 F9  /*  44 */
			29 01 00 00 00 00 03 B2 60 F2  /*  45 */
			29 01 00 00 00 00 03 B2 60 EB  /*  46 */
			29 01 00 00 00 00 03 B2 60 E3  /*  47 */
			29 01 00 00 00 00 03 B2 60 DA  /*  48 */
			29 01 00 00 00 00 03 B2 60 D2  /*  49 */
			29 01 00 00 00 00 03 B2 60 CB  /*  50 */
			29 01 00 00 00 00 03 B2 60 C4  /*  51 */
			29 01 00 00 00 00 03 B2 60 BC  /*  52 */
			29 01 00 00 00 00 03 B2 60 B3  /*  53 */
			29 01 00 00 00 00 03 B2 60 AB  /*  54 */
			29 01 00 00 00 00 03 B2 60 9B  /*  55 */
			29 01 00 00 00 00 03 B2 60 8B  /*  56 */
			29 01 00 00 00 00 03 B2 60 78  /*  57 */
			29 01 00 00 00 00 03 B2 60 71  /*  58 */
			29 01 00 00 00 00 03 B2 60 69  /*  59 */
			29 01 00 00 00 00 03 B2 60 62  /*  60 */
			29 01 00 00 00 00 03 B2 60 5B  /*  61 */
			29 01 00 00 00 00 03 B2 60 4B  /*  62 */
			29 01 00 00 00 00 03 B2 60 3A  /*  63 */
			29 01 00 00 00 00 03 B2 60 33  /*  64 */
			29 01 00 00 00 00 03 B2 60 2C  /*  65 */
			29 01 00 00 00 00 03 B2 60 1D  /*  66 */
			29 01 00 00 00 00 03 B2 60 0E  /*  67 */
			29 01 00 00 00 00 03 B2 60 02  /*  68 */
			29 01 00 00 00 00 03 B2 50 F6  /*  69 */
			29 01 00 00 00 00 03 B2 50 DE  /*  70 */
			29 01 00 00 00 00 03 B2 50 D3  /*  71 */
			29 01 00 00 00 00 03 B2 50 C8  /*  72 */
			29 01 00 00 00 00 03 B2 50 BA  /*  73 */
			29 01 00 00 00 00 03 B2 50 AB  /*  74 */
			29 01 00 00 00 00 03 B2 50 95  /*  75 */
			29 01 00 00 00 00 03 B2 50 7E  /*  76 */
			29 01 00 00 00 00 03 B2 50 6E  /*  77 */
			29 01 00 00 00 00 03 B2 50 5E  /*  78 */
			29 01 00 00 00 00 03 B2 50 4D  /*  79 */
			29 01 00 00 00 00 03 B2 50 3C  /*  80 */
			29 01 00 00 00 00 03 B2 50 25  /*  81 */
			29 01 00 00 00 00 03 B2 50 0F  /*  82 */
			29 01 00 00 00 00 03 B2 40 F7  /*  83 */
			29 01 00 00 00 00 03 B2 40 DF  /*  84 */
			29 01 00 00 00 00 03 B2 40 C6  /*  85 */
			29 01 00 00 00 00 03 B2 40 AD  /*  86 */
			29 01 00 00 00 00 03 B2 40 9B  /*  87 */
			29 01 00 00 00 00 03 B2 40 8A  /*  88 */
			29 01 00 00 00 00 03 B2 40 6F  /*  89 */
			29 01 00 00 00 00 03 B2 40 54  /*  90 */
			29 01 00 00 00 00 03 B2 40 36  /*  91 */
			29 01 00 00 00 00 03 B2 40 18  /*  92 */
			29 01 00 00 00 00 03 B2 30 F7  /*  93 */
			29 01 00 00 00 00 03 B2 30 D6  /*  94 */
			29 01 00 00 00 00 03 B2 30 B6  /*  95 */
			29 01 00 00 00 00 03 B2 30 96  /*  96 */
			29 01 00 00 00 00 03 B2 30 76  /*  97 */
			29 01 00 00 00 00 03 B2 30 55  /*  98 */
			29 01 00 00 00 00 03 B2 30 64  /*  99 */
			29 01 00 00 00 00 03 B2 30 40  /* 100 */
			29 01 00 00 00 00 03 B2 30 62  /* 101 */
			29 01 00 00 00 00 03 B2 30 40  /* 102 */
			29 01 00 00 00 00 03 B2 30 60  /* 103 */
			29 01 00 00 00 00 03 B2 30 40  /* 104 */
			29 01 00 00 00 00 03 B2 30 64  /* 105 */
			29 01 00 00 00 00 03 B2 30 40  /* 106 */
			29 01 00 00 00 00 03 B2 30 5C  /* 107 */
			29 01 00 00 00 00 03 B2 30 40  /* 108 */
			29 01 00 00 00 00 03 B2 30 65  /* 109 */
			29 01 00 00 00 00 03 B2 30 40  /* 110 */
			29 01 00 00 00 00 03 B2 30 5E  /* 111 */
			29 01 00 00 00 00 03 B2 30 40  /* 112 */
			29 01 00 00 00 00 03 B2 30 65  /* 113 */
			29 01 00 00 00 00 03 B2 30 40  /* 114 */
			29 01 00 00 00 00 03 B2 30 5F  /* 115 */
			29 01 00 00 00 00 03 B2 30 40  /* 116 */
			29 01 00 00 00 00 03 B2 30 61  /* 117 */
			29 01 00 00 00 00 03 B2 30 40  /* 118 */
			29 01 00 00 00 00 03 B2 30 63  /* 119 */
			29 01 00 00 00 00 03 B2 30 40  /* 120 */
			29 01 00 00 00 00 03 B2 30 61  /* 121 */
			29 01 00 00 00 00 03 B2 30 40  /* 122 */
			29 01 00 00 00 00 03 B2 30 62  /* 123 */
			29 01 00 00 00 00 03 B2 30 40  /* 124 */
			29 01 00 00 00 00 03 B2 30 60  /* 125 */
			29 01 00 00 00 00 03 B2 30 40  /* 126 */
			29 01 00 00 00 00 03 B2 30 61  /* 127 */
			29 01 00 00 00 00 03 B2 30 40  /* 128 */
			29 01 00 00 00 00 03 B2 30 34  /* 129 */
			29 01 00 00 00 00 03 B2 30 29  /* 130 */
			29 01 00 00 00 00 03 B2 30 1D  /* 131 */
			29 01 00 00 00 00 03 B2 30 12  /* 132 */
			29 01 00 00 00 00 03 B2 30 06  /* 133 */
			29 01 00 00 00 00 03 B2 20 FB  /* 134 */
			29 01 00 00 00 00 03 B2 20 EF  /* 135 */
			29 01 00 00 00 00 03 B2 20 E3  /* 136 */
			29 01 00 00 00 00 03 B2 20 D7  /* 137 */
			29 01 00 00 00 00 03 B2 20 CB  /* 138 */
			29 01 00 00 00 00 03 B2 20 C0  /* 139 */
			29 01 00 00 00 00 03 B2 20 B4  /* 140 */
			29 01 00 00 00 00 03 B2 20 A8  /* 141 */
			29 01 00 00 00 00 03 B2 20 9C  /* 142 */
			29 01 00 00 00 00 03 B2 20 8E  /* 143 */
			29 01 00 00 00 00 03 B2 20 80  /* 144 */
			29 01 00 00 00 00 03 B2 20 72  /* 145 */
			29 01 00 00 00 00 03 B2 20 64  /* 146 */
			29 01 00 00 00 00 03 B2 20 56  /* 147 */
			29 01 00 00 00 00 03 B2 20 48  /* 148 */
			29 01 00 00 00 00 03 B2 20 3A  /* 149 */
			29 01 00 00 00 00 03 B2 20 2C  /* 150 */
			29 01 00 00 00 00 03 B2 20 1E  /* 151 */
			29 01 00 00 00 00 03 B2 20 11  /* 152 */
			29 01 00 00 00 00 03 B2 20 03  /* 153 */
			29 01 00 00 00 00 03 B2 10 F5  /* 154 */
			29 01 00 00 00 00 03 B2 10 E7  /* 155 */
			29 01 00 00 00 00 03 B2 10 DA  /* 156 */
			29 01 00 00 00 00 03 B2 10 CC  /* 157 */
			29 01 00 00 00 00 03 B2 10 E1  /* 158 */
			29 01 00 00 00 00 03 B2 10 D5  /* 159 */
			29 01 00 00 00 00 03 B2 10 CA  /* 160 */
			29 01 00 00 00 00 03 B2 10 BE  /* 161 */
			29 01 00 00 00 00 03 B2 10 B3  /* 162 */
			29 01 00 00 00 00 03 B2 10 A7  /* 163 */
			29 01 00 00 00 00 03 B2 10 9C  /* 164 */
			29 01 00 00 00 00 03 B2 10 90  /* 165 */
			29 01 00 00 00 00 03 B2 10 E2  /* 166 */
			29 01 00 00 00 00 03 B2 10 D8  /* 167 */
			29 01 00 00 00 00 03 B2 10 CE  /* 168 */
			29 01 00 00 00 00 03 B2 10 C4  /* 169 */
			29 01 00 00 00 00 03 B2 10 B9  /* 170 */
			29 01 00 00 00 00 03 B2 10 AF  /* 171 */
			29 01 00 00 00 00 03 B2 10 A5  /* 172 */
			29 01 00 00 00 00 03 B2 10 9A  /* 173 */
			29 01 00 00 00 00 03 B2 10 90  /* 174 */
			29 01 00 00 00 00 03 B2 10 E2  /* 175 */
			29 01 00 00 00 00 03 B2 10 D8  /* 176 */
			29 01 00 00 00 00 03 B2 10 CE  /* 177 */
			29 01 00 00 00 00 03 B2 10 C3  /* 178 */
			29 01 00 00 00 00 03 B2 10 B9  /* 179 */
			29 01 00 00 00 00 03 B2 10 AF  /* 180 */
			29 01 00 00 00 00 03 B2 10 A5  /* 181 */
			29 01 00 00 00 00 03 B2 10 9A  /* 182 */
			29 01 00 00 00 00 03 B2 10 90  /* 183 */
			29 01 00 00 00 00 03 B2 10 E3  /* 184 */
			29 01 00 00 00 00 03 B2 10 DA  /* 185 */
			29 01 00 00 00 00 03 B2 10 D1  /* 186 */
			29 01 00 00 00 00 03 B2 10 C7  /* 187 */
			29 01 00 00 00 00 03 B2 10 BE  /* 188 */
			29 01 00 00 00 00 03 B2 10 B5  /* 189 */
			29 01 00 00 00 00 03 B2 10 AC  /* 190 */
			29 01 00 00 00 00 03 B2 10 A2  /* 191 */
			29 01 00 00 00 00 03 B2 10 99  /* 192 */
			29 01 00 00 00 00 03 B2 10 90  /* 193 */
			29 01 00 00 00 00 03 B2 10 D4  /* 194 */
			29 01 00 00 00 00 03 B2 10 CA  /* 195 */
			29 01 00 00 00 00 03 B2 10 C1  /* 196 */
			29 01 00 00 00 00 03 B2 10 B7  /* 197 */
			29 01 00 00 00 00 03 B2 10 AD  /* 198 */
			29 01 00 00 00 00 03 B2 10 A3  /* 199 */
			29 01 00 00 00 00 03 B2 10 9A  /* 200 */
			29 01 00 00 00 00 03 B2 10 90  /* 201 */
			29 01 00 00 00 00 03 B2 10 D6  /* 202 */
			29 01 00 00 00 00 03 B2 10 CD  /* 203 */
			29 01 00 00 00 00 03 B2 10 C4  /* 204 */
			29 01 00 00 00 00 03 B2 10 BC  /* 205 */
			29 01 00 00 00 00 03 B2 10 B3  /* 206 */
			29 01 00 00 00 00 03 B2 10 AA  /* 207 */
			29 01 00 00 00 00 03 B2 10 A1  /* 208 */
			29 01 00 00 00 00 03 B2 10 99  /* 209 */
			29 01 00 00 00 00 03 B2 10 90  /* 210 */
			29 01 00 00 00 00 03 B2 10 D2  /* 211 */
			29 01 00 00 00 00 03 B2 10 CA  /* 212 */
			29 01 00 00 00 00 03 B2 10 C2  /* 213 */
			29 01 00 00 00 00 03 B2 10 B9  /* 214 */
			29 01 00 00 00 00 03 B2 10 B1  /* 215 */
			29 01 00 00 00 00 03 B2 10 A9  /* 216 */
			29 01 00 00 00 00 03 B2 10 A1  /* 217 */
			29 01 00 00 00 00 03 B2 10 98  /* 218 */
			29 01 00 00 00 00 03 B2 10 90  /* 219 */
			29 01 00 00 00 00 03 B2 10 A7  /* 220 */
			29 01 00 00 00 00 03 B2 10 9F  /* 221 */
			29 01 00 00 00 00 03 B2 10 98  /* 222 */
			29 01 00 00 00 00 03 B2 10 90  /* 223 */
			29 01 00 00 00 00 03 B2 10 A9  /* 224 */
			29 01 00 00 00 00 03 B2 10 A1  /* 225 */
			29 01 00 00 00 00 03 B2 10 98  /* 226 */
			29 01 00 00 00 00 03 B2 10 90  /* 227 */
			29 01 00 00 00 00 03 B2 10 84  /* 228 */
			29 01 00 00 00 00 03 B2 10 79  /* 229 */
			29 01 00 00 00 00 03 B2 10 6D  /* 230 */
			29 01 00 00 00 00 03 B2 10 61  /* 231 */
			29 01 00 00 00 00 03 B2 10 56  /* 232 */
			29 01 00 00 00 00 03 B2 10 4A  /* 233 */
			29 01 00 00 00 00 03 B2 10 3E  /* 234 */
			29 01 00 00 00 00 03 B2 10 36  /* 235 */
			29 01 00 00 00 00 03 B2 10 2D  /* 236 */
			29 01 00 00 00 00 03 B2 10 25  /* 237 */
			29 01 00 00 00 00 03 B2 10 1D  /* 238 */
			29 01 00 00 00 00 03 B2 10 11  /* 239 */
			29 01 00 00 00 00 03 B2 10 06  /* 240 */
			29 01 00 00 00 00 03 B2 00 FA  /* 241 */
			29 01 00 00 00 00 03 B2 00 EE  /* 242 */
			29 01 00 00 00 00 03 B2 00 DC  /* 243 */
			29 01 00 00 00 00 03 B2 00 D3  /* 244 */
			29 01 00 00 00 00 03 B2 00 CB  /* 245 */
			29 01 00 00 00 00 03 B2 00 C2  /* 246 */
			29 01 00 00 00 00 03 B2 00 DF  /* 247 */
			29 01 00 00 00 00 03 B2 00 D5  /* 248 */
			29 01 00 00 00 00 03 B2 00 CC  /* 249 */
			29 01 00 00 00 00 03 B2 00 C2  /* 250 */
			29 01 00 00 00 00 03 B2 00 DB  /* 251 */
			29 01 00 00 00 00 03 B2 00 D3  /* 252 */
			29 01 00 00 00 00 03 B2 00 CA  /* 253 */
			29 01 00 00 00 00 03 B2 00 C2  /* 254 */
			29 01 00 00 00 00 03 B2 00 C2  /* 255 */
		];

		/* bl_level, Index in acl command list */
		samsung,aid_map_table_revA = <
			2	0		3	1		4	2		5	3		6	4
			7	5		8	6		9	7		10	8		11	9
			12	10		13	11		14	12		15	13		16	14
			17	15		19	16		20	17		21	18		22	19
			24	20		25	21		27	22		29	23		30	24
			32	25		34	26		37	27		39	28		41	29
			44	30		47	31		50	32		53	33		56	34
			60	35		64	36		68	37		72	38		77	39
			82	40		87	41		93	42		98	43		105	44
			111	45		119	46		126	47		134	48		143	49
			152	50		162	51		172	52		183	53		195	54
			207	55		220	56		234	57		249	58		265	59
			282	60		300	61		316	62		333	63		350	64
			357	65		365	66		372	67		380	68		387	69
			395	70		403	71		412	72		420	73
		>;

		/*
		 * ************************************************************************************************************************
		 * ACL command list and mappings
		 * ************************************************************************************************************************
		 */
		samsung,acl_on_tx_cmds_revA = [
			29 01 00 00 00 00 05 B5 50 7F 14 14	/* ACL 32Frame Averaging,50% StartPoint, 15% ACL */
			29 01 00 00 00 00 02 55 02		/* ACL 15%(default) ON */
		];

		samsung,acl_percent_tx_cmds_revA = [
			29 01 00 00 00 00 02 55 00	/* ACL OFF */
			29 01 00 00 00 00 02 55 01	/* ACL 15% */
			29 01 00 00 00 00 02 55 02	/* Default ACL 8% */
			29 01 00 00 00 00 02 55 03	/* ACL 20% */
		];

		samsung,acl_off_tx_cmds_revA = [
			29 01 00 00 00 00 02 B5 40	/* 16 Frame Avg. */
			29 01 00 00 00 00 02 55 00	/* ACL OFF */
		];

		/* bl_level , Index in acl command list */
		samsung,acl_map_table_revA =  <
			2	2		3	2		4	2		5	2		6	2
			7	2		8	2		9	2		10	2		11	2
			12	2		13	2		14	2		15	2		16	2
			17	2		19	2		20	2		21	2		22	2
			24	2		25	2		27	2		29	2		30	2
			32	2		34	2		37	2		39	2		41	2
			44	2		47	2		50	2		53	2		56	2
			60	2		64	2		68	2		72	2		77	2
			82	2		87	2		93	2		98	2		105	2
			111	2		119	2		126	2		134	2		143	2
			152	2		162	2		172	2		183	2		195	2
			207	2		220	2		234	2		249	2		265	2
			282	2		300	2		316	2		333	2		350	2
			357	2		365	2		372	2		380	2		387	2
			395	2		403	2		412	2		420	2
		>;

		/*
		 * ************************************************************************************************************************
		 * SMART ACL(ACL On) ELVSS command list and mappings
		 * ************************************************************************************************************************
		 */
		samsung,smart_acl_elvss_tx_cmds_revA = [
			29 01 00 00 00 00 03 B6 AC 0E  /*2~15 nit :  0 */
			29 01 00 00 00 00 03 B6 AC 10  /*  16 nit :  1 */
			29 01 00 00 00 00 03 B6 AC 12  /*  17 nit :  2 */
			29 01 00 00 00 00 03 B6 AC 15  /*  19 nit :  3 */
			29 01 00 00 00 00 03 B6 AC 18  /*20~34nit :  4 */
			29 01 00 00 00 00 03 B6 AC 17  /*  37 nit :  5 */
			29 01 00 00 00 00 03 B6 AC 17  /*  39 nit :  6 */
			29 01 00 00 00 00 03 B6 BC 17  /*  41 nit :  7 */
			29 01 00 00 00 00 03 B6 BC 17  /*44~72nit :  8 */
			29 01 00 00 00 00 03 B6 BC 16  /*  77 nit :  9 */
			29 01 00 00 00 00 03 B6 BC 16  /*  82 nit : 10 */
			29 01 00 00 00 00 03 B6 BC 15  /*  87 nit : 11 */
			29 01 00 00 00 00 03 B6 BC 15  /*  93 nit : 12 */
			29 01 00 00 00 00 03 B6 BC 15  /*  98 nit : 13 */
			29 01 00 00 00 00 03 B6 BC 15  /* 105 nit : 14 */
			29 01 00 00 00 00 03 B6 BC 14  /* 111 nit : 15 */
			29 01 00 00 00 00 03 B6 BC 14  /* 119 nit : 16 */
			29 01 00 00 00 00 03 B6 BC 14  /* 126 nit : 17 */
			29 01 00 00 00 00 03 B6 BC 13  /* 134 nit : 18 */
			29 01 00 00 00 00 03 B6 BC 13  /* 143 nit : 19 */
			29 01 00 00 00 00 03 B6 BC 13  /* 152 nit : 20 */
			29 01 00 00 00 00 03 B6 BC 12  /* 162~249 : 21 */
			29 01 00 00 00 00 03 B6 BC 11  /* 265 nit : 22 */
			29 01 00 00 00 00 03 B6 BC 10  /* 282 nit : 23 */
			29 01 00 00 00 00 03 B6 BC 0F  /* 300 nit : 24 */
			29 01 00 00 00 00 03 B6 BC 0E  /* 316 nit : 25 */
			29 01 00 00 00 00 03 B6 BC 0E  /* 333 nit : 26 */
			29 01 00 00 00 00 03 B6 BC 0D  /* 350 nit : 27 */
			29 01 00 00 00 00 03 B6 BC 0C  /* 357~380 : 28 */
			29 01 00 00 00 00 03 B6 BC 0B  /* 387~403 : 29 */
			29 01 00 00 00 00 03 B6 BC 0A  /* 412 nit : 30 */
			29 01 00 00 00 00 03 B6 BC 0A  /* 420 nit : 31 */
		];

		/* bl_level, Index in elvss command list */
		samsung,smart_acl_elvss_map_table_revA = <
			2	0		3	0		4	0		5	0		6	0
			7	0		8	0		9	0		10	0		11	0
			12	0		13	0		14	0		15	0		16	1
			17	2		19	3		20	4		21	4		22	4
			24	4		25	4		27	4		29	4		30	4
			32	4		34	4		37	5		39	6		41	7
			44	8		47	8		50	8		53	8		56	8
			60	8		64	8		68	8		72	8		77	9
			82	10		87	11		93	12		98	13		105	14
			111	15		119	16		126	17		134	18		143	19
			152	20		162	21		172	21		183	21		195	21
			207	21		220	21		234	21		249	21		265	22
			282	23		300	24		316	25		333	26		350	27
			357	28		365	28		372	28		380	28		387	29
			395	29		403	29		412	30		420	31
		>;

		/*
		 * ************************************************************************************************************************
		 * SMART VINT set command list and mappings
		 * ************************************************************************************************************************
		 */
		samsung,vint_tx_cmds_revA = [
			29 01 00 00 00 00 03 F4 7B 17 /* 2~ 5 nit :  0 */
			29 01 00 00 00 00 03 F4 7B 18 /*    6 nit :  1 */
			29 01 00 00 00 00 03 F4 7B 19 /*    7 nit :  2 */
			29 01 00 00 00 00 03 F4 7B 1A /*    8 nit :  3 */
			29 01 00 00 00 00 03 F4 7B 1B /*    9 nit :  4 */
			29 01 00 00 00 00 03 F4 7B 1C /*   10 nit :  5 */
			29 01 00 00 00 00 03 F4 7B 1D /*   11 nit :  6 */
			29 01 00 00 00 00 03 F4 7B 1E /* 12 nit ~ :  7 */
			29 01 00 00 00 00 03 F4 7B 1E /* 12 nit ~ :  8 */
			29 01 00 00 00 00 03 F4 7B 1E /* 12 nit ~ :  9 */
		];

		/* bl_level, Index in vint command list */
		samsung,vint_map_table_revA = <
			2	0		3	0		4	0		5	0		6	1
			7	2		8	3		9	4		10	5		11	6
			12	7		13	8		14	9		15	9		16	9
			17	9		19	9		20	9		21	9		22	9
			24	9		25	9		27	9		29	9		30	9
			32	9		34	9		37	9		39	9		41	9
			44	9		47	9		50	9		53	9		56	9
			60	9		64	9		68	9		72	9		77	9
			82	9		87	9		93	9		98	9		105	9
			111	9		119	9		126	9		134	9		143	9
			152	9		162	9		172	9		183	9		195	9
			207	9		220	9		234	9		249	9		265	9
			282	9		300	9		316	9		333	9		350	9
			357	9		365	9		372	9		380	9		387	9
			395	9		403	9		412	9		420	9
		>;

		/*
		 * ************************************************************************************************************************
		 * candela to index mappings
		 * ************************************************************************************************************************
		 */
		samsung,candela_map_table_revA = <
		/*<idx><PMSL range> <candella> *//*linear map*/
			0	0	0	2
			1	1	6	3
			2	7	13	4
			3	14	19	5
			4	20	27	6
			5	28	34	7
			6	35	36	8
			7	37	38	9
			8	39	40	10
			9	41	42	11
			10	43	44	12
			11	45	46	13
			12	47	48	14
			13	49	50	15
			14	51	52	16
			15	53	54	17
			16	55	56	19
			17	57	57	20 /* dimming*/
			18	58	59	21
			19	60	61	22
			20	62	63	24
			21	64	65	25
			22	66	67	27
			23	68	69	29
			24	70	70	30
			25	71	72	32
			26	73	74	34
			27	75	76	37
			28	77	78	39
			29	79	80	41
			30	81	82	44
			31	83	84	47
			32	85	86	50
			33	87	88	53
			34	89	90	56
			35	91	92	60
			36	93	94	64
			37	95	96	68
			38	97	98	72
			39	99	100	77
			40	101	102	82
			41	103	104	87
			42	105	106	93
			43	107	108	98
			44	109	110	105
			45	111	112	111
			46	113	114	119
			47	115	116	126
			48	117	118	134
			49	119	120	143
			50	121	122	152
			51	123	124	162
			52	125	126	172
			53	127	128	183
			54	129	135	195
			55	136	142	207
			56	143	149	220
			57	150	157	234
			58	158	165	249
			59	166	174	265
			60	175	183	282
			61	184	193	300
			62	194	201	316
			63	202	210	333
			64	211	219	350
			65	220	223	357
			66	224	227	365
			67	228	230	372
			68	231	234	380
			69	235	238	387
			70	239	242	395
			71	243	246	403
			72	247	250	412
			73	251	255	420
		>;

		samsung,hbm_candela_map_table_revA = <
			0	282	295	465	6
			1	296	309	488	7
			2	310	323	510	8
			3	324	336	533	9
			4	337	350	555	10
			5	351	364	578	11
			6	365	365	600	12
		>;
	};
};
