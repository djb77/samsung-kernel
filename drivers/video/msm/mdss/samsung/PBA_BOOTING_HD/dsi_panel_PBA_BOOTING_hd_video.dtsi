/* Copyright (c) 2013-2014, The Linux Foundation. All rights reserved.
 *
 * This program is free software; you can redistribute it and/or modify
 * it under the terms of the GNU General Public License version 2 and
 * only version 2 as published by the Free Software Foundation.
 *
 * This program is distributed in the hope that it will be useful,
 * but WITHOUT ANY WARRANTY; without even the implied warranty of
 * MERCHANTABILITY or FITNESS FOR A PARTICULAR PURPOSE.  See the
 * GNU General Public License for more details.
 */

/*---------------------------------------------------------------------------
 * This file is autogenerated file using gcdb parser. Please do not edit it.
 * Update input XML file to add a new entry or update variable in this file
 * VERSION = "1.0"
 *---------------------------------------------------------------------------

 */
&mdss_mdp {
	ss_dsi_panel_PBA_BOOTING_HD: ss_dsi_panel_PBA_BOOTING_HD {
		qcom,mdss-dsi-panel-name = "ss_dsi_panel_PBA_BOOTING_HD";

		qcom,mdss-dsi-panel-controller = <&mdss_dsi0>;
		qcom,mdss-dsi-panel-width = <1080>;
		qcom,mdss-dsi-panel-height = <1920>;
		qcom,mdss-dsi-bpp = <24>;
		qcom,mdss-dsi-panel-destination = "display_1";

		qcom,mdss-dsi-panel-timings = [94 29 21 00 3A 56 22 33 26 03 04 00];

		qcom,mdss-dsi-on-command = [
			39 01 00 00 78 00 02 11 00	/* sleep out.  It use last packet*/
		];
		qcom,mdss-dsi-off-command = [
			05 01 00 00 24 00 02 28 00			/* wait 40ms(0x24) */
			05 01 00 00 78 00 02 10 00			/* wait 120ms(0x78) */
		];

		qcom,cont-splash-enabled;
		/*qcom,cmd-sync-wait-broadcast = */
		/*qcom,cmd-sync-wait-trigger = */
		/*qcom,mdss-dsi-fbc-enable = */
		/*qcom,mdss-dsi-fbc-slice-height = */
		/*qcom,mdss-dsi-fbc-2d-pred-mode = */
		/*qcom,mdss-dsi-fbc-ver2-mode = */
		/*qcom,mdss-dsi-fbc-bpp = */
		/*qcom,mdss-dsi-fbc-packing = */
		/*qcom,mdss-dsi-fbc-quant-error = */
		/*qcom,mdss-dsi-fbc-bias = */
		/*qcom,mdss-dsi-fbc-pat-mode = */
		/*qcom,mdss-dsi-fbc-vlc-mode = */
		/*qcom,mdss-dsi-fbc-bflc-mode = */
		/*qcom,mdss-dsi-fbc-h-line-budget = */
		/*qcom,mdss-dsi-fbc-budget-ctrl = */
		/*qcom,mdss-dsi-fbc-block-budget = */
		/*qcom,mdss-dsi-fbc-lossless-threshold = */
		/*qcom,mdss-dsi-fbc-lossy-threshold = */
		/*qcom,mdss-dsi-fbc-rgb-threshold = */
		/*qcom,mdss-dsi-fbc-lossy-mode-idx = */
		/*qcom,mdss-dsi-fbc-max-pred-err = */
		qcom,mdss-dsi-h-back-porch = <32>;
		qcom,mdss-dsi-h-front-porch = <144>;
		qcom,mdss-dsi-h-pulse-width = <12>;
		qcom,mdss-dsi-h-sync-skew = <0>;
		qcom,mdss-dsi-v-back-porch = <3>;
		qcom,mdss-dsi-v-front-porch = <9>;
		qcom,mdss-dsi-v-pulse-width = <4>;
		qcom,mdss-dsi-h-left-border = <0>;
		qcom,mdss-dsi-h-right-border = <0>;
		qcom,mdss-dsi-v-top-border = <0>;
		qcom,mdss-dsi-v-bottom-border = <0>;
		qcom,mdss-dsi-underflow-color = <0xFF>;
		qcom,mdss-dsi-border-color = <0>;
		/*qcom,mdss-dsi-pan-enable-dynamic-fps = */
		/*qcom,mdss-dsi-pan-fps-update = */
		/*qcom,min-refresh-rate = */
		/*qcom,max-refresh-rate = */
		qcom,mdss-dsi-bl-pmic-control-type = "bl_ctrl_dcs";
		/*qcom,mdss-dsi-bl-pwm-pmi = */
		/*qcom,mdss-dsi-bl-pmic-bank-select = */
		/*qcom,mdss-dsi-bl-pmic-pwm-frequency = */
		/*qcom,mdss-dsi-pwm-gpio = */
		qcom,mdss-dsi-bl-min-level = <1>;
		qcom,mdss-dsi-bl-max-level = <255>;
		qcom,mdss-brightness-max-level = <255>;
		qcom,mdss-dsi-interleave-mode = <0>;
		qcom,mdss-dsi-panel-type = "dsi_video_mode";
		/*qcom,5v-boost-gpio = */
		/*qcom,mdss-dsi-te-check-enable = */
		/*qcom,mdss-dsi-te-using-te-pin = */
		/*qcom,mdss-dsi-te-pin-select = */
		/*qcom,mdss-dsi-te-dcs-command = */
		/*qcom,mdss-dsi-wr-mem-start = */
		/*qcom,mdss-dsi-wr-mem-continue = */
		qcom,mdss-dsi-h-sync-pulse = <0>;
		/*qcom,mdss-dsi-hfp-power-mode = */
		/*qcom,mdss-dsi-hbp-power-mode = */
		/*qcom,mdss-dsi-hsa-power-mode = */
		/*qcom,mdss-dsi-last-line-interleave = */
		qcom,mdss-dsi-bllp-eof-power-mode;
		qcom,mdss-dsi-bllp-power-mode;
		qcom,mdss-dsi-traffic-mode = "burst_mode";
		qcom,mdss-dsi-pixel-packing = "loose";
		qcom,mdss-dsi-virtual-channel-id = <0>;
		qcom,mdss-dsi-color-order = "rgb_swap_rgb";
		qcom,mdss-dsi-lane-0-state;
		qcom,mdss-dsi-lane-1-state;
		qcom,mdss-dsi-lane-2-state;
		qcom,mdss-dsi-lane-3-state;
		qcom,mdss-dsi-lane-map = "lane_map_0123";
		qcom,mdss-dsi-t-clk-pre = <0x34>;
		qcom,mdss-dsi-t-clk-post = <0x04>;
		qcom,mdss-dsi-stream = <0>;
		qcom,mdss-dsi-mdp-trigger = "none";
		qcom,mdss-dsi-dma-trigger = "trigger_sw";
		qcom,mdss-dsi-panel-framerate = <60>;
		qcom,mdss-dsi-panel-clockrate = <380000000>;
		qcom,mdss-dsi-on-command-state = "dsi_hs_mode";
		qcom,mdss-dsi-off-command-state = "dsi_hs_mode";
		qcom,mdss-pan-physical-width-dimension = <60>;
		qcom,mdss-pan-physical-height-dimension = <106>;
		qcom,mdss-dsi-panel-mode-gpio-state = "invalid";
		/*qcom,mdss-tear-check-disable; */
		/*qcom,mdss-tear-check-sync-cfg-height = */
		/*qcom,mdss-tear-check-sync-init-val = */
		/*qcom,mdss-tear-check-sync-threshold-start = */
		/*qcom,mdss-tear-check-sync-threshold-continue = */
		/*qcom,mdss-tear-check-start-pos = */
		/*qcom,mdss-tear-check-rd-ptr-trigger-intr = */
		/*qcom,mdss-tear-check-frame-rate = */
		qcom,mdss-dsi-reset-sequence = <1 10>, <0 10>, <1 10>;
		/*qcom,partial-update-enabled = */
		/*qcom,mdss-dsi-horizontal-line-idle = */
		/*qcom,partial-update-roi-merge = */
		/*qcom,dcs-cmd-by-left = */
		qcom,mdss-dsi-lp11-init;
		qcom,mdss-dsi-init-delay-us = <1000>;
		qcom,mdss-dsi-rx-eot-ignore;
		qcom,mdss-dsi-tx-eot-append;
		/*qcom,ulps-enabled = */
		/*qcom,suspend-ulps-enabled = */
		/*qcom,panel-roi-alignment = */
		/*qcom,esd-check-enabled = */
		/*qcom,mdss-dsi-panel-status-command = */
		/*qcom,mdss-dsi-panel-status-command-mode = */
		/*qcom,mdss-dsi-panel-status-check-mode = */
		/*qcom,mdss-dsi-panel-status-read-length = */
		/*qcom,mdss-dsi-panel-status-value = */
		/*qcom,mdss-dsi-panel-max-error-count = */
		/*qcom,dynamic-mode-switch-enabled = */
		/*qcom,video-to-cmd-mode-switch-commands = */
		/*qcom,cmd-to-video-mode-switch-commands = */
		/*qcom,mdss-dsi-panel-orientation = */
		/*qcom,panel-ack-disabled = */
		qcom,mdss-dsi-force-clock-lane-hs;


		/*
		* ************************************************************************************************************************
		* candela to index mappings
		* ************************************************************************************************************************
		*/
		samsung,candela_map_table_revA = <
		/*<idx>	  <from>  <till> <candella> */
			0	0	2	5
			1	2	2	6
			2	3	3	7
			3	4	4	8
			4	5	5	9
			5	6	6	10
			6	7	7	11
			7	8	8	12
			8	9	9	13
			9	10	10	14
			10	11	11	15
			11	12	12	16
			12	13	13	17
			13	14	14	19
			14	15	15	20
			15	16	16	21
			16	17	17	22
			17	18	18	24
			18	19	19	25
			19	20	20	27
			20	21	21	29
			21	22	22	30
			22	23	24	32
			23	25	26	34
			24	27	28	37
			25	29	29	39
			26	30	32	41
			27	33	34	44
			28	35	36	47
			29	37	38	50
			30	39	40	53
			31	41	43	56
			32	44	46	60
			33	47	49	64
			34	50	52	68
			35	53	56	72
			36	57	59	77
			37	60	63	82
			38	64	67	87
			39	68	71	93
			40	72	76	98
			41	77	80	105
			42	81	86	111
			43	87	91	119
			44	92	97	126
			45	98	104	134
			46	105	110	143
			47	111	118	152
			48	119	125	162
			49	126	133	172
			50	134	142	183
			51	143	150	195
			52	151	160	207
			53	161	170	220
			54	171	181	234
			55	182	193	249
			56	194	205	265
			57	206	218	282
			58	219	230	300
			59	231	242	316
			60	243	254	333
			61	255	255	360
		>;
	};
};
