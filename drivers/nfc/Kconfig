## drivers/video/fbdev/exynos/dual_dpu/Kconfig
```kconfig
config EXYNOS_DECON_8895
	bool "Samsung Exynos8895 Display system (DPP, DECON, MIPI, HDMI)"
	default y
	depends on FB

if EXYNOS_DECON_8895
config EXYNOS_DECON_FB
	bool "Samsung DECON Framebuffer driver"
	depends on EXYNOS_DECON_8895
	select MEDIA_EXYNOS
	default y
	help
	  Say Y here if you want support for the DECON in Samsung S5P SoCs.
	  This device produce image data to one of output interfaces.

config EXYNOS_DPP
	bool "Samsung Exynos Display Post Processor driver"
	depends on EXYNOS_DECON_8895
	default y

config EXYNOS_MIPI_DSIM
	bool "Samsung Exynos MIPI-DSI driver"
	depends on EXYNOS_DECON_8895
	default y
	help
	  Enable MIPI-DSI driver.

config EXYNOS_MIPI_DISPLAYPORT
	bool "Samsung Exynos DISPLAYPORT driver"
	depends on EXYNOS_DECON_8895
	default y
	help
	  Enable DISPLAYPORT driver.

config EXYNOS_ZEBU_EMUL_DISP
	bool "Zebu Emulator Display driver"
	depends on EXYNOS_DECON_8895
	default y

config FB_WINDOW_UPDATE
        bool "DECON window update mode"
        depends on EXYNOS_DECON_8895
        default n

config DECON_BLOCKING_MODE
	bool "DECON blocking mode"
        depends on EXYNOS_DECON_8895
        default y

config DECON_EVENT_LOG
	bool "Display sub-system event logger (DECON/DSIM/DPP)"
        depends on DEBUG_INFO && EXYNOS_DECON_8895
        default y

config DECON_HIBER
	bool "DECON hiber mode"
        depends on EXYNOS_DECON_8895
        default n

config SUPPORT_DOZE
	bool "Suppot Doze mode to aod service"
	depends on EXYNOS_DECON_8895
	default n

config SUPPORT_DSU
	bool "Support DSU(Multi Resolution)"
	depends on EXYNOS_DECON_8895
	default n

config SUPPORT_HMD
	bool "Support HMD(Head Mount Display - VR)"
	depends on EXYNOS_DECON_8895
	default n
	
config DECON_SELF_REFRESH
	bool "Support video emulation for daydream"
	depends on EXYNOS_DECON_8895
	default n

config DISPLAYPORT_ENG
	bool "Enable Displayport eng binary"
	default n

config LOGGING_BIGDATA_BUG
	bool "Logging extra information when decon bug"
	depends on EXYNOS_DECON_8895
	default y
endif
```

## drivers/video/fbdev/exynos/dual_panel/Kconfig
```kconfig
config EXYNOS_DECON_LCD
	depends on EXYNOS_DECON_8895
	bool "Select LCD panel driver"

config EXYNOS_DECON_MDNIE_LITE
	depends on EXYNOS_DECON_LCD
	tristate "Support MDNIE LITE"
	default n

config EXYNOS_DECON_LCD_SYSFS
	depends on EXYNOS_DECON_LCD
	tristate "Support LCD SYSFS"
	default y

config EXYNOS_DECON_LCD_SPI
	depends on EXYNOS_DECON_LCD
	tristate "Support LCD SPI"
	default n

config EXYNOS_DECON_LCD_COPR
	depends on EXYNOS_DECON_LCD
	tristate "Support COPR"
	default n

config EXYNOS_DECON_LCD_TUNING
	depends on EXYNOS_DECON_LCD
	tristate "Support LCD TUNING"
	default n

config PANEL_AID_DIMMING
	depends on EXYNOS_DECON_LCD
	tristate "Support AID Dimming"
	default n

config EXYNOS_DECON_LCD_S6E3HA2
	depends on EXYNOS_DECON_LCD && EXYNOS_MIPI_DSIM
	tristate "S6E3HA2 AMOLED LCD driver"
config EXYNOS_DECON_LCD_S6E3HF3
	depends on EXYNOS_DECON_LCD && EXYNOS_MIPI_DSIM
	tristate "S6E3HA3 AMOLED LCD DRIVER"
	default n

config EXYNOS_DECON_LCD_S6E3HF4
	depends on EXYNOS_DECON_LCD && EXYNOS_MIPI_DSIM
	tristate "S6E3HF4 AMOLED WQHD LCD driver(1440 x 2560)"
	default n

config EXYNOS_DECON_LCD_S6E3HA6
	depends on EXYNOS_DECON_LCD && EXYNOS_MIPI_DSIM
	tristate "S6E3HA6 AMOLED LCD DRIVER"

config ACTIVE_CLOCK
	depends on EXYNOS_DECON_LCD && EXYNOS_DECON_LCD_S6E3HA6
	tristate "Support DDI Active Clock Feature"
	default n

config PANEL_BACKLIGHT_PAC_3_0
	depends on EXYNOS_DECON_LCD
	tristate "Support baclight PAC 3.0"
	default n

config DISPLAY_USE_INFO
	depends on EXYNOS_DECON_LCD
	tristate "Support display use info logging"
	default n
```

## drivers/video/fbdev/exynos/panel/Kconfig
```kconfig
config EXYNOS_DECON_LCD
	depends on EXYNOS_DECON_8895
	bool "Select LCD panel driver"

config EXYNOS_DECON_MDNIE_LITE
	depends on EXYNOS_DECON_LCD
	tristate "Support MDNIE LITE"
	default n

config EXYNOS_DECON_LCD_SYSFS
	depends on EXYNOS_DECON_LCD
	tristate "Support LCD SYSFS"
	default y

config EXYNOS_DECON_LCD_SPI
	depends on EXYNOS_DECON_LCD
	tristate "Support LCD SPI"
	default n

config EXYNOS_DECON_LCD_COPR
	depends on EXYNOS_DECON_LCD
	tristate "Support COPR"
	default n

config EXYNOS_DECON_LCD_TUNING
	depends on EXYNOS_DECON_LCD
	tristate "Support LCD TUNING"
	default n

config PANEL_AID_DIMMING
	depends on EXYNOS_DECON_LCD
	tristate "Support AID Dimming"
	default n

config EXYNOS_DECON_LCD_S6E3HF4
	depends on EXYNOS_DECON_LCD && EXYNOS_MIPI_DSIM
	tristate "S6E3HF4 AMOLED WQHD LCD driver(1440 x 2560)"

config EXYNOS_DECON_LCD_S6E3HA6
	depends on EXYNOS_DECON_LCD && EXYNOS_MIPI_DSIM
	tristate "S6E3HA6 AMOLED LCD DRIVER"

config ACTIVE_CLOCK
	depends on EXYNOS_DECON_LCD && EXYNOS_DECON_LCD_S6E3HA6
	tristate "Support DDI Active Clock Feature"
	default n

config SUPPORT_POC_FLASH
	depends on EXYNOS_DECON_LCD && EXYNOS_DECON_LCD_S6E3HA6
	tristate "Support display poc flash"
	default n

config PANEL_POC_2_0
	depends on EXYNOS_DECON_LCD && SUPPORT_POC_FLASH
	tristate "Support display poc 2.0"
	default n

config POC_DREAM
	depends on EXYNOS_DECON_LCD && EXYNOS_DECON_LCD_S6E3HA6 && SUPPORT_POC_FLASH
	tristate "Support display poc dream"
	default n

config POC_DREAM2
	depends on EXYNOS_DECON_LCD && EXYNOS_DECON_LCD_S6E3HA6 && SUPPORT_POC_FLASH
	tristate "Support display poc dream2"
	default n

config SUPPORT_GRAM_CHECKSUM
	depends on EXYNOS_DECON_LCD && SEC_FACTORY
	tristate "Support GRAM Checksum"
	default n

config SUPPORT_PANEL_SPI_SHORT_TEST
	depends on EXYNOS_DECON_LCD && EXYNOS_DECON_LCD_SPI && SEC_FACTORY
	tristate "Support panel spi short test"
	default n

config PANEL_BACKLIGHT_PAC_3_0
	depends on EXYNOS_DECON_LCD
	tristate "Support baclight PAC 3.0"
	default n

config DISPLAY_USE_INFO
	depends on EXYNOS_DECON_LCD
	tristate "Support display use info logging"
	default n

config SUPPORT_HDR
	depends on EXYNOS_DECON_LCD
	tristate "Support HDR Param"
	default y
```

## drivers/video/msm/mdss/samsung/Kconfig
```kconfig
config SAMSUNG_DEBUG_DISPLAY
    bool "Add Samsung Debugging code"
    default n

config FB_MSM_MDSS_SAMSUNG
	depends on FB_MSM_MDSS
	bool "mdss config for samsung product"
	default n
	---help---
	Mdss config signature for samsung product

config DISPLAY_USE_INFO
	depends on FB_MSM_MDSS_SAMSUNG
	bool "Support display use info logging"
	default n

config SAMSUNG_12_8MHZ_ESC_CLOCK
    bool "12.8Mhz esc clock"
    default n
#
#	PANEL UNIQUE FEATURE
#
config DUAL_PANEL
	depends on FB_MSM_MDSS_SAMSUNG
	bool "dual paneloperation"
	default n
	---help---
	dual panel operation support

config PARTIAL_UPDATE
	depends on FB_MSM_MDSS_SAMSUNG
	bool "partial update operation"
	default n
	---help---
	partial update operation support

config CABC_FUNCTION
	depends on FB_MSM_MDSS_SAMSUNG
	bool "DDI cabc operation"
	default n
	---help---
	DDI cabc operation support

config SUPPORT_POC_FLASH
	depends on FB_MSM_MDSS_SAMSUNG
	bool "SUPPORT POC FLASH"
	default n
	---help---
	SUPPORT_POC_FLASH FOR DREAM2 ONLY

config SUPPORT_POC_2_0
	depends on FB_MSM_MDSS_SAMSUNG
	bool "SUPPORT POC_2_0"
	default n
	---help---
	POC_2_0 SUPPORT

config POC_33_COMPENSATION
	depends on FB_MSM_MDSS_SAMSUNG
	bool "POC 33 DEVICE COMPENSATION TO 64"
	default n
	---help---
	POC 33 DEVICE COMPENSATION TO 64

#
#	HOW TO MAKE DEF-CONFIG NAME FOR PANEL
#
#	PANEL_DDI-model_PANEL-model_RESOLUTION
#	PANEL_S6E3FA2    _AMS510CV01_FHD
#	PANEL_S6E3FA2_AMS510CV01_FHD
#
config PANEL_HX8279_TV101WUM_WUXGA
	depends on FB_MSM_MDSS_SAMSUNG
	bool "HIMAX HX8279 LDI"
	default n
	---help---
	HIMAX HX8279

config PANEL_HX8279_TV101WUM_1_WUXGA
	depends on FB_MSM_MDSS_SAMSUNG
	bool "HIMAX HX8279 LDI For T587P"
	default n
	---help---
	HIMAX HX8279 T587P

config PANEL_S6E3FA3_AMS598NJ01_FHD
	depends on FB_MSM_MDSS_SAMSUNG
	bool "LSI S6E3FA3 LDI"
	default n
	---help---
	LSI S6E3FA3 LDI 1080_1920 C10P

config PANEL_S6E3FA3_AMS559NK01_FHD
	depends on FB_MSM_MDSS_SAMSUNG
	bool "LSI S6E3FA3 LDI"
	default n
	---help---
	LSI S6E3FA3 LDI 1080_1920

config PANEL_S6E3FA7_AMS559NK01_FHD
	depends on FB_MSM_MDSS_SAMSUNG
	bool "LSI S6E3FA7 LDI"
	default n
	---help---
	LSI S6E3FA7 LDI 1080_2220

config PANEL_S6E3FA7_AMS604NL01_FHD
	depends on FB_MSM_MDSS_SAMSUNG
	bool "LSI S6E3FA7 LDI"
	default n
	---help---
	LSI S6E3FA7 LDI 1080_2220

config BLIC_ISL98608
	depends on FB_MSM_MDSS_SAMSUNG
	bool "BLIC ISL98608"
	default n
	---help---
	BLIC ISL98608

config PANEL_POWER_ISL98608
	depends on FB_MSM_MDSS_SAMSUNG
	bool "PANEL_POWER ISL98608"
	default n
	---help---
	PANEL_POWER ISL98608

config PANEL_S6D7AA0X11_TV080WXM_WXGA
	depends on FB_MSM_MDSS_SAMSUNG
	bool "PANEL_S6D7AA0X11_TV080WXM_WXGA"
	default n
	---help---
	S6D7AA0X11_TV080WXM

config PANEL_EA8061S_AMS498QV01_QHD
	depends on FB_MSM_MDSS_SAMSUNG
	bool "EA8061s Magna 5.0inch OCTA"
	default n
	---help---
	LSI EA8061s OCTA 540_960_5 J2 2018

config PANEL_TD4100_BV050HDM_HD
	depends on FB_MSM_MDSS_SAMSUNG
	bool "SYNAPTICS TD4100 LDI"
	default n
	---help---
	SYNAPTICS TD4100 LDI 720_1280 J3-POP

config PANEL_S6E8AA5X01_AMS561RA01_HD
	depends on FB_MSM_MDSS_SAMSUNG
	bool "PANEL_S6E8AA5X01_AMS561RA01_HD"
	default n
	---help---
	LSI S6E8AA5X01 LDI 720_1480 HD+ J6P

config PANEL_S6D7AT0_BS055HDM_HD
	depends on FB_MSM_MDSS_SAMSUNG
	bool "S6D7AT0 LDI"
	default n
	---help---
	S6D7AT0 LDI 720_1280 J5-2018 Temp

config PANEL_EA8061S_AMS498QV01_QHD
    depends on FB_MSM_MDSS_SAMSUNG
    bool "EA8061s Magna 5.0inch OCTA"
    default n
    ---help---
    LSI EA8061s OCTA 540_960_5 Android Go

config PANEL_TD4100_5_5_HD
	depends on FB_MSM_MDSS_SAMSUNG
	bool "SYNAPTICS TD4100 LDI"
	default n
	---help---
	SYNAPTICS TD4100 LDI 720_1280 IN_CELL

config PANEL_S6D7AT0B01_PM6003XB1_HDP
	depends on FB_MSM_MDSS_SAMSUNG
	bool "SAMSUNG S6D7AT0B01 LDI"
	default n
	---help---
	SAMSUNG S6D7AT0B01 LDI 720_1480 IN_CELL

config PANEL_S6D7AT0B01_BS060WKM_HDP
	depends on FB_MSM_MDSS_SAMSUNG
	bool "SAMSUNG S6D7AT0B01 LDI"
	default n
	---help---
	SAMSUNG S6D7AT0B01 LDI 720_1480 IN_CELL

config BLIC_ISL98611
	depends on FB_MSM_MDSS_SAMSUNG
	bool "BLIC ISL98611"
	default n
	---help---
	BLIC ISL98611

config BLIC_LM3632A
	depends on FB_MSM_MDSS_SAMSUNG
	bool "BLIC LM3632A"
	default n
	---help---
	BLIC LM3632A
	
config PANEL_HX83100A_C5001H3F_HD
	depends on FB_MSM_MDSS_SAMSUNG
	bool "HIMAX HX83100A LDI"
	default n
	---help---
	HIMAX HX83100A LDI 720_1280 IN_CELL

config PANEL_TD4100_BS050HDM_HD
	depends on FB_MSM_MDSS_SAMSUNG
	bool "SYNAPTICS TD4100 LDI"
	default n
	---help---
	SYNAPTICS TD4100 LDI 720_1280 IN_CELL
	
config PANEL_TD4100_C5001H3F_HD
	depends on FB_MSM_MDSS_SAMSUNG
	bool "SYNAPTICS TD4100 LDI"
	default n
	---help---
	SYNAPTICS TD4100 LDI 720_1280 IN_CELL
```

## drivers/vision/Kconfig
```kconfig
menuconfig VISION_SUPPORT
	bool "Vision Support"
	help
	  If you want to use hardware acceleration for vision
	  enable this option and other options below.

if VISION_SUPPORT

source "drivers/vision/iva/Kconfig"

source "drivers/vision/score/Kconfig"

endif # VISION_SUPPORT
```

## drivers/vision/iva/Kconfig
```kconfig
config EXYNOS_IVA
	bool "samsung IVA driver support"
	default n
	help
		Enable samsung iva driver
```

## drivers/vision/score/Kconfig
```kconfig
config EXYNOS_SCORE
       bool "SCORE driver"
       help
         This is a SCORE Driver
```

## drivers/vision/score/platform/Kconfig
```kconfig
config EXYNOS_SCORE_PLATFORM
	bool "Select Platform"
	select EXYNOS_SCORE_EXYNOS8895
	help
	  This is a selection of platform

config EXYNOS_SCORE_EXYNOS8895
	bool "Use Exynos8895 platform"
	depends on EXYNOS_SCORE_PLATFORM
	help
	  This is a exynos8895 platform
```

## drivers/vision/vision-core/Kconfig
```kconfig
config VISION_CORE
        bool "Vision Core"
        help
          This is a vision core
```

## drivers/vision/vpu/Kconfig
```kconfig
menuconfig EXYNOS_VPU
        bool "Exynos VPU(Vision Processing Unit) driver"
        select EXYNOS_VPU_PLATFORM
        select EXYNOS_VPU_INTERFACE
        select EXYNOS_VPU_ALLOCATOR
        help
          This is a vision processing unit

if EXYNOS_VPU

source "drivers/vision/vpu/platform/Kconfig"
source "drivers/vision/vpu/interface/Kconfig"
source "drivers/vision/vpu/resource/Kconfig"

endif
```

## drivers/vision/vpu/interface/Kconfig
```kconfig
config EXYNOS_VPU_INTERFACE
	bool "Select Interface"
	help
	  This is VPU interface

config EXYNOS_VPU_LOOPBACK
	bool "Use Loopback"
	depends on EXYNOS_VPU_INTERFACE
	help
	  This is loopback device

config EXYNOS_VPU_HARDWARE
	bool "Use Hardware"
	depends on EXYNOS_VPU_INTERFACE
	help
	  This is hardware device
```

## drivers/vision/vpu/interface/translator/Kconfig
```kconfig
config EXYNOS_VPU_TRANSLATOR
	bool "Select Translator"
	help
	  This is translator selection

config EXYNOS_VPU_TRANSLATOR_V21
	bool "Use V2.1"
	depends on EXYNOS_VPU_TRANSLATOR
	help
	  This is translator version 2.1
```

## drivers/vision/vpu/platform/Kconfig
```kconfig
config EXYNOS_VPU_PLATFORM
	bool "Select Platform"
	help
	  This is a selection of platform

config EXYNOS_VPU_EXYNOS8895
	bool "Use Exynos8895 platform"
	depends on EXYNOS_VPU_PLATFORM
	help
	  This is a exynos8895 platform
```
