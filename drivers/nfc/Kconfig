## drivers/soc/qcom/Kconfig.sec
```kconfig
comment "Samsung Debugging Feature"
menuconfig SEC_DEBUG
	bool "Samsung TN Ramdump Feature"
	default n
	help
	  Samsung TN Ramdump Feature.
	  Enables collection of ram dump.
	  Enables task history, debug level etc.
	  This feature is enabled in defconfig.

if SEC_DEBUG

config SEC_DEBUG_PRINTK_NOCACHE
	bool "Samsung non-cached kernel printk"
	default y
	help
	  Samsung non-cached kernel printk
	  This ensures that printk is never stale
	  which is a good feature when debugging without
	  hardware debuggers. If unsure, keep it turned on.

config SEC_DEBUG_SCHED_LOG
	bool "Samsung Scheduler Logging Feature"
	default n
	help
	  Samsung Scheduler Logging Feature for Debug use.
	  Enables task scheduling history.
	  Enables IRQ scheduling history.
	  This feature is enabled in defconfig.

config SEC_DEBUG_SEMAPHORE_LOG
	bool "Samsung Semaphore Logging Feature"
	default n
	help
	  Samsung Semaphore Logging Feature for Debug use.
	  Enables semaphore debugging statistics.
	  Enables logging.
	  This feature is enabled in defconfig.

config SEC_FILE_LEAK_DEBUG
	bool "Samsung File Leak Debugging Feature"
	default n
	help
	  Samsung File Leak Debugging Feature for Debug use.
	  Enables the forced panic mode when EMFILE Eror occurs.
	  This feature is enabled in defconfig.

config SEC_LOGGER_BUFFER_EXPANSION
	bool "Samsung Logger Buffer Expansion Feature"
	default n
	help
	  This is used to expand buffers of logger.
	  This feature is enabled in defconfig.

config SEC_DEBUG_IRQ_EXIT_LOG
	bool "Temporary Logging for IRQ delay"
	default n
	help
	  Verbose Logging for IRQ delay.
	  Helps indetification of irq enter and exit.
	  This is to track the current state of IRQ execution.
	  This is enabled in defconfig file.

config SEC_DEBUG_MSG_LOG
	bool "Message Log for ram dump debug"
	default n
	help
	  Verbose Logging for ram dump analysis.
	  Collects kernel debug log.
	  Log is collected in the no-cache area.
	  This feature is enabled in defconfig.

config SEC_DEBUG_SUMMARY
	bool "Debug summary"
        depends on SEC_DEBUG_SCHED_LOG
	default n
	help
	  Subsystems debug summary feature.
	  When enabled provides kernel logs, modem logs, RPM registers,
	  Schedule and IRQ logs at the time of crash along with the
	  reason for crash, which can be extracted as a html in RAM dump mode.

config SEC_DEBUG_DCVS_LOG
	bool "Temporary Logging for DCVS"
	default n
	help
	  DCVS Logging Feature for Debug use.
	  The ACPU clock rate changes will be logged as a part
	  of secdbg_log structure along with the CPU time stamp.
	  The previous frequency and the new frequency for both the CPU along
	  with the CPU time stamp will be logged.

config SEC_DEBUG_POWER_LOG
	bool "Temporary Logging for MSM POWER"
	default n
	help
	  POWER Logging Feature for Debug use.
	  The power and clock gating will be logged as a part
	  of secdbg_log structure along with the CPU time stamp.

config SEC_DEBUG_FUELGAUGE_LOG
	bool "Temporary Logging for FuelGauge"
	default n
	help
	 FuelGauge Logging Feature for Debug use.
	 The FuelGauge values are logged as a part
	 of secdbg_log structure along with the CPU time stamp.
	 The voltage and soc values along with the CPU time will be logged.

config SEC_DEBUG_LOW_LOG
	bool "Kernel Message Logging for Debug Level Low"
	default n
	help
	 Kernel Message Logging Feature for Debug use.
	 The Kernel Messages are logged using file I/O
	 when an exception occurs, when the debug level is low.
	 The file I/O is added in kernel driver level
	 so that kernel messages are logged on next reboot.

config SEC_DEBUG_MDM_FILE_INFO
	bool "MDM filename and line number in UPLOAD mode"
	default n
	help
	 This feature enables display of MDM info in upload mode.
	 This feature enabled SSR in debug level low.
	 Collects MDM ram dump and then calls panic.
	 UPLOAD mode has MDM dump info to show it on LCD.

config SEC_DEBUG_DOUBLE_FREE
	bool "Enable double free detection"
	default n
	help
	 Detect erraneous codes that frees a kmalloced node
	 twice. When kfree(p) is called, p is not freed right away.
	 Instead, it is pushed into a circular buffer. What it frees
	 is the oldest pointer that was pushed into the buffer.
	 If someone tries to free the same pointer p, *p
	 is read and checked for a magic code that is written
	 when it was first freed. If it matches, the whole
	 circular buffer is searched. Panic is be called when
	 the match is found.

config SEC_DEBUG_FORCE_ERROR
	bool "enable force error"
	default n
	help
	  This option enable to force error by sysfs

config SEC_DEBUG_SEC_WDOG_BITE
	bool "Samsung fore secure bite simulation"
	default n
	depends on SEC_DEBUG_FORCE_ERROR
	help
	  simulation for secure bite.
	  This feature is enabled in defconfig.

config SEC_LOG_LAST_KMSG
	bool "Enable /proc/last_kmsg support: if EMBEDDED"
	default n
	help
	  This option enables /proc/last_kmsg support.

config SEC_BSP
	bool "Samsung TN BSP Feature"
	default n
	depends on MSM_BOOT_STATS
	help
	  Samsung TN BSP Feature.

config SEC_DEBUG_NOCACHE_LOG_IN_LEVEL_LOW
	bool "Enable nocache logging in debug level LOW"
	default n
	help
	  Enable nocache logging in debug level LOW.

config SEC_DEBUG_APPS_CLK_LOGGING
	bool "Enable apps clk logging"
	default n
	help
	  Enable apps clk logging.

config SEC_MONITOR_BATTERY_REMOVAL
	bool "Enable monitering whether normal power sequence or not"
	default n
	help
	  Enable monitering Power off & battery removal.

config SEC_SSR_DEBUG_LEVEL_CHK
	bool "PERIPHERAL SECURE check"
	default n
	help
	  To check the authentication of peripheral image.

endif

config SKU_THEME
        bool "Enable SKU THEME"
        depends on SEC_BSP
        default n
        help
          This option is used to add sku theme Func.
          Say Y if you want to enable this feature.

menu "Samsung Factory Feature"
config SEC_FACTORY
	bool "when it comes to sec factory mode"
	default n
	select SEC_DEBUG_FORCE_ERROR
	select SEC_NAD
	help
	  It will support a sec factory mode

config SEC_NAD
	bool "Samsung TN NAD Feature"
	default n
	help
	  Samsung TN NAD Feature, support AT CMD for NAD 2.0
endmenu
```

## drivers/soc/samsung/Kconfig
```kconfig
# When adding new entries keep the list in alphabetical order

config DRV_SAMSUNG
	bool "samsung device dedicated drivers option"
	default y
	help
	  This is driver option for samsung sec_class
	  Say y here to enable samsung classes for drivers
	  Provide option of enabling sec class
	  Supports sec drivers key, touch, sec_debug etc

config SEC_INCELL
	bool "Incell data & function for Samsung"
	default n
	help
	  say y to enable incell data & function for Samsung.
```

## drivers/soc/samsung/acpm/Kconfig
```kconfig
#
# ACPM driver configuration
#

menuconfig EXYNOS_ACPM
	bool "ACPM driver support"
	default n
	help
	  Enable ACPM support

if EXYNOS_ACPM

config EXYNOS7570_ACPM
	bool "EXYNOS7570_ACPM support"
	default y
	depends on SOC_EXYNOS7570
	help
	  Enable ACPM support

config EXYNOS7270_ACPM
	bool "EXYNOS7270_ACPM support"
	default y
	depends on SOC_EXYNOS7270
	help
	  Enable ACPM support

config EXYNOS8895_ACPM
	bool "EXYNOS8895_ACPM support"
	default y
	depends on SOC_EXYNOS8895
	help
	  Enable ACPM support
endif
```

## drivers/soc/samsung/exynos-hdcp/Kconfig
```kconfig
#
# HDCP driver configuration
#

menuconfig EXYNOS_HDCP2
	bool "HDCP2 driver support"
	depends on PHY_EXYNOS_DISPLAYPORT
	default y
	help
	  Enable HDCP2 support

if EXYNOS_HDCP2

config HDCP2_EMULATION_MODE
	bool "HDCP2 emulation mode support"
	default n
	help
	  Enable HDCP2 emulation mode support

config HDCP2_SUPPORT_IIA
	bool "HDCP2 IIA protocol support"
	default n
	help
	  Enable HDCP2 IIA protocol support

endif
```

## drivers/staging/android/ion/exynos/Kconfig
```kconfig
config ION_EXYNOS_OF
	depends on OF && ION_EXYNOS
	bool "Setup ION with Device Tree"
	default n
```

## drivers/staging/samsung/Kconfig
```kconfig
# drivers/staging/samsung/Kconfig
#
# Copyright (c) 2010-2011 Samsung Electronics Co., Ltd.
#		http://www.samsung.com/
#
# Licensed under GPLv2

comment "Samsung TN Features"
config SEC_EXT
	bool "Samsung TN extension Feature"

config SEC_SYSFS
	bool "Samsung sec sysfs Feature"
	default y
	depends on SEC_EXT
	help
	  Samsung sysfs name 'sec' directory create.

config SEC_REBOOT
	bool "Samsung TM reboot extension Feature"
	default y
	depends on SEC_EXT
	help
	  Samsung TN reboot extension feature. Do additional work when reboot.

config SEC_MISC
        bool "Samsung TM Misc Feature"
        default n
        help
          Samsung TN Misc extension Feature. Do additional work when Misc.

config ARGOS
	bool "Throughput monitoring Feature"
	default n
	help
	  Check throughput and set appropriate system parameters(CPU freq, affinity, etc)

config SEC_DEBUG
	bool "Enable TN debugging feature"
	depends on EXYNOS_SNAPSHOT
	depends on SEC_REBOOT
	default y
	help
	  Samsung TN debugging feature.

config SEC_FACTORY
	bool "SAMSUNG Factory build option"
	default n
	help
	  Include some codes for Factory binary.

config SEC_HOTPLUG
	bool "Control cpu qos for samsung feature"
	default y
	depends on SENSORS_FP_LOCKSCREEN_MODE
	help
	  Request wakeup with big core for samsung fingerprint

comment "Samsung TN logging feature"
config SEC_AVC_LOG
	default n
	bool "Enable avc audit log support" if EMBEDDED
	depends on SEC_EXT
	help
	  This option enables additional log buffer for audit log.

config SEC_DEBUG_TSP_LOG
	default n
	bool "Enable tsp log support" if EMBEDDED
	depends on SEC_EXT
	help
	  This option enables additional log buffer for tsp log.

config SEC_DEBUG_LAST_KMSG
	default y
	bool "Enable /proc/last_kmsg support" if EMBEDDED
	depends on SEC_DEBUG
	help
	  This option enables /proc/last_kmsg support.

config SEC_FILE_LEAK_DEBUG
	bool "Panic when file leak detected"
	default n
	help
	  Panic when file leak detected.
comment "Samsung TN Power Management Options"
menuconfig SEC_PM
	bool "Samsung TN Power Management"
	default y
	help
	  Samsung TN Power Management.

config SEC_PM_DEBUG
	bool "Enable Samsung TN Power management debug support"
	default y
	depends on SEC_PM
	help
	  Enable Samsung TN Power management debug support.

config USER_RESET_DEBUG
	bool "USER RESET debug feature"
	default n
	help
	  This option enables debugging log for User Reset.
	  This option provides reset history log in user version.
	  This option enable proc/reset_reason support

comment "BSP Feature"
menuconfig SEC_BSP
	bool "Samsung TN BSP Feature"
	default n
	depends on SEC_EXT
	help
	  Samsung TN BSP Feature.

config SEC_INITCALL_DEBUG
	bool "Enable Samsung initcall debug support"
	default n
	depends on SEC_DEBUG && !SAMSUNG_PRODUCT_SHIP
	help
	  Enable Samsung initcall debug support.

comment "PARAM Feature"
config SEC_PARAM
	bool "Samsung TN Param Feature"
	default n
	depends on SEC_DEBUG
	help
	  Samsung TN Param Feature.

config CM_OFFSET
	int "Charging Mode Offset"
	default 0
	depends on SEC_PARAM
	help
	  set Charging Mode Offset when you enable SEC_PARAM.
```

## drivers/video/fbdev/exynos/Kconfig
```kconfig
if SOC_EXYNOS9810

source "drivers/video/fbdev/exynos/dpu_9810/Kconfig"
source "drivers/video/fbdev/exynos/panel/Kconfig"

endif # SOC_EXYNOS9810
```

## drivers/video/fbdev/exynos/decon_8890/panels/Kconfig
```kconfig
config EXYNOS_DECON_LCD
	depends on EXYNOS_DECON_8890
	bool "Select LCD panel driver"

config EXYNOS_DECON_MDNIE_LITE
	depends on EXYNOS_DECON_LCD
	tristate "Support MDNIE LITE"
	default n

config EXYNOS_DECON_LCD_SYSFS
	depends on EXYNOS_DECON_LCD
	tristate "Support LCD SYSFS"
	default y

config PANEL_AID_DIMMING
	depends on EXYNOS_DECON_LCD
	tristate "Support AID Dimming"
	default n

config EXYNOS_DECON_LCD_MCD
	depends on EXYNOS_DECON_LCD_SYSFS
	tristate "Support MCD"
	default n

config LCD_HMT
	depends on EXYNOS_DECON_LCD
	tristate "Support HMT display"
	default n

config LCD_ALPM
	depends on EXYNOS_DECON_LCD
	tristate "Support ALPM display"
	default n

config LCD_DOZE_MODE
	depends on EXYNOS_DECON_LCD
	tristate "Support DOZE MODE"
	default n

config LCD_HBM_INTERPOLATION
	depends on EXYNOS_DECON_LCD
	tristate "Support HBM brightness table"
	default n

config LCD_ESD_IDLE_MODE
	depends on EXYNOS_DECON_LCD
	tristate "Support HA3 PANEL FOR ESD"
	default n

config EXYNOS_DECON_LCD_S6E3HA2K
	depends on EXYNOS_DECON_LCD && EXYNOS_MIPI_DSI
	tristate "S6E3HA2K AMOLED WQHD LCD driver(1440 x 2560)"

config EXYNOS_DECON_LCD_S6E3HA3
	depends on EXYNOS_DECON_LCD && EXYNOS_MIPI_DSI
	tristate "S6E3HA3 AMOLED WQHD LCD driver(1440 x 2560)"

config EXYNOS_DECON_LCD_S6E3HF4
	depends on EXYNOS_DECON_LCD && EXYNOS_MIPI_DSI
	tristate "S6E3HF4 AMOLED WQHD LCD driver(1440 x 2560)"

config PANEL_S6E3HA2_DYNAMIC
	depends on EXYNOS_DECON_LCD && EXYNOS_MIPI_DSI
	tristate "S6E3HA2 AMOLED SUPPORT BOTE S6E3HA0 and S6E3HA2 (1440 x 2560)"

config PANEL_S6E3HF2_DYNAMIC
	depends on EXYNOS_DECON_LCD && EXYNOS_MIPI_DSI
	tristate "S6E3HF2 AMOLED SUPPORT BOTH WQHD and WQXGA RESOLUTION"

config PANEL_S6E3FA3_FHD
	depends on EXYNOS_DECON_LCD && EXYNOS_MIPI_DSI
	tristate "S6E3FA3 AMOLED SUPPORT FHD RESULOTION"

config PANEL_S6E3HF4_WQHD
	depends on EXYNOS_DECON_LCD && EXYNOS_MIPI_DSI
	tristate "S6E3HF4 AMOLED SUPPORT WQHD RESOLUTION"

config PANEL_S6E3FA2_FHD
	depends on EXYNOS_DECON_LCD && EXYNOS_MIPI_DSI
	tristate "S6E3FA2 AMOLED SUPPORT FHD RESULOTION"

config PANEL_S6E3HA3_DYNAMIC
	depends on EXYNOS_DECON_LCD && EXYNOS_MIPI_DSI
	tristate "S6E3HA3 AMOLED SUPPORT BOTH S6E3HA2/S6E3HA3/S6E3HF4 (1440 x 2560)"

config SUPPORT_CROSS_DOWNLOAD
	depends on EXYNOS_DECON_LCD && EXYNOS_MIPI_DSI
	tristate "PANEL SUPPORT CROSS DOWNLOAD"

config LCD_WEAKNESS_CCB
	depends on EXYNOS_DECON_LCD && EXYNOS_MIPI_DSI
	tristate "PANEL SUPPORT CCB"

config PANEL_DDI_SPI
	depends on EXYNOS_DECON_LCD && EXYNOS_MIPI_DSI
	tristate "DDI SPI"

config PANEL_DUALIZATION
	depends on PANEL_S6E3HF4_WQHD
	tristate "S6E3HF4 A2 PANEL DUALIZATION"

config LCD_BURNIN_CORRECTION
	depends on EXYNOS_DECON_LCD
	tristate "Support Burnin correction"
	default n
```

## drivers/video/fbdev/exynos/decon_8890_dual_dsi/panels/Kconfig
```kconfig
config EXYNOS_DECON_LCD
	depends on EXYNOS_DECON_DUAL_DSI
	bool "Select LCD panel driver"

config EXYNOS_DECON_MDNIE_LITE
	depends on EXYNOS_DECON_LCD
	tristate "Support MDNIE LITE"
	default n

config EXYNOS_DECON_LCD_SYSFS
	depends on EXYNOS_DECON_LCD
	tristate "Support LCD SYSFS"
	default y

config PANEL_AID_DIMMING
	depends on EXYNOS_DECON_LCD
	tristate "Support AID Dimming"
	default n

config EXYNOS_DECON_LCD_S6E3HA2K
	depends on EXYNOS_DECON_LCD && EXYNOS_MIPI_DSI
	tristate "S6E3HA2K AMOLED WQHD LCD driver(1440 x 2560)"

config EXYNOS_DECON_LCD_S6E3HA3
	depends on EXYNOS_DECON_LCD && EXYNOS_MIPI_DSI
	tristate "S6E3HA3 AMOLED WQHD LCD driver(1440 x 2560)"

config EXYNOS_DECON_LCD_S6E3HF4
	depends on EXYNOS_DECON_LCD && EXYNOS_MIPI_DSI
	tristate "S6E3HF4 AMOLED WQHD LCD driver(1440 x 2560)"

config PANEL_S6E3HA2_DYNAMIC
	depends on EXYNOS_DECON_LCD && EXYNOS_MIPI_DSI
	tristate "S6E3HA2 AMOLED SUPPORT BOTE S6E3HA0 and S6E3HA2 (1440 x 2560)"

config PANEL_S6E3HF2_DYNAMIC
	depends on EXYNOS_DECON_LCD && EXYNOS_MIPI_DSI
	tristate "S6E3HF2 AMOLED SUPPORT BOTH WQHD and WQXGA RESOLUTION"

config PANEL_S6E3FA3_FHD
	depends on EXYNOS_DECON_LCD && EXYNOS_MIPI_DSI
	tristate "S6E3FA3 AMOLED SUPPORT FHD RESULOTION"

config PANEL_S6E3HF4_WQHD
	depends on EXYNOS_DECON_LCD && EXYNOS_MIPI_DSI
	tristate "S6E3HF4 AMOLED SUPPORT WQHD RESOLUTION"
```
