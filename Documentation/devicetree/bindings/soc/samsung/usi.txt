## arch/arm64/Kconfig.debug
```kconfig
menu "Kernel hacking"

source "lib/Kconfig.debug"

config ARM64_PTDUMP
	bool "Export kernel pagetable layout to userspace via debugfs"
	depends on DEBUG_KERNEL
	select DEBUG_FS
        help
	  Say Y here if you want to show the kernel pagetable layout in a
	  debugfs file. This information is only useful for kernel developers
	  who are working in architecture specific areas of the kernel.
	  It is probably not a good idea to enable this feature in a production
	  kernel.

	  If in doubt, say N.

config PID_IN_CONTEXTIDR
	bool "Write the current PID to the CONTEXTIDR register"
	help
	  Enabling this option causes the kernel to write the current PID to
	  the CONTEXTIDR register, at the expense of some additional
	  instructions during context switch. Say Y here only if you are
	  planning to use hardware trace tools with this kernel.

config ARM64_RANDOMIZE_TEXT_OFFSET
	bool "Randomize TEXT_OFFSET at build time"
	help
	  Say Y here if you want the image load offset (AKA TEXT_OFFSET)
	  of the kernel to be randomized at build-time. When selected,
	  this option will cause TEXT_OFFSET to be randomized upon any
	  build of the kernel, and the offset will be reflected in the
	  text_offset field of the resulting Image. This can be used to
	  fuzz-test bootloaders which respect text_offset.

	  This option is intended for bootloader and/or kernel testing
	  only. Bootloaders must make no assumptions regarding the value
	  of TEXT_OFFSET and platforms must not require a specific
	  value.

config DEBUG_EXCEPTION_STACK
	bool "Preserve stack data when the exception happened"
	default n
	help
	  If this is set, kernel can preserve the specific size of stack data
	  when an exception occurs from EL1. This can help to fiqure out the
	  stack data before the exception happened.

config DEBUG_SET_MODULE_RONX
	bool "Set loadable kernel module data as NX and text as RO"
	depends on MODULES
	default y
	help
	  Is this is set, kernel module text and rodata will be made read-only.
	  This is to help catch accidental or malicious attempts to change the
	  kernel's executable code.

	  If in doubt, say Y.

config DEBUG_ALIGN_RODATA
	depends on DEBUG_RODATA
	bool "Align linker sections up to SECTION_SIZE"
	help
	  If this option is enabled, sections that may potentially be marked as
	  read only or non-executable will be aligned up to the section size of
	  the kernel. This prevents sections from being split into pages and
	  avoids a potential TLB penalty. The downside is an increase in
	  alignment and potentially wasted space. Turn on this option if
	  performance is more important than memory pressure.

	  If in doubt, say N.

comment "Samsung Rooting Restriction Feature"
config SEC_RESTRICT_ROOTING
       bool "Samsung Rooting Restriction Feature"
       depends on SAMSUNG_PRODUCT_SHIP
       default n
       help
         Restrict unauthorized executions with root permission.

config SEC_RESTRICT_SETUID
       bool "Restrict changing root privilege except allowed process"
       depends on SEC_RESTRICT_ROOTING
       default y
       help
         Say Y here if you want to restrict functions related setuid. Only allowed
	   process can chanage ROOT privilege. Saying N will not restrict changing
	     permission.

config SEC_RESTRICT_FORK
       bool "Restrict forking process except allowed process"
       depends on SEC_RESTRICT_ROOTING
       default y
       help
         Say Y here if you want to restrict function related fork. Process matched
	   special condition will be not forked. Saying N will not restrict forking
	     process.

config SEC_RESTRICT_ROOTING_LOG
       bool "Print restricted result to kernel log"
       depends on SEC_RESTRICT_ROOTING
       default n
       help
          Say Y here if you want to see result of restricting SETUID or FORK. It will
	     be displayed by kernel error log. Saying N will not be displayed anything.

source "drivers/hwtracing/coresight/Kconfig"

endmenu
```

## arch/arm64/Kconfig.platforms
```kconfig
menu "Platform selection"

config ARCH_BCM_IPROC
	bool "Broadcom iProc SoC Family"
	help
	  This enables support for Broadcom iProc based SoCs

config ARCH_BERLIN
	bool "Marvell Berlin SoC Family"
	select ARCH_REQUIRE_GPIOLIB
	select DW_APB_ICTL
	help
	  This enables support for Marvell Berlin SoC Family

config ARCH_EXYNOS
	bool
	help
	  This enables support for Samsung Exynos SoC family

config ARCH_EXYNOS7
	bool "ARMv8 based Samsung Exynos7"
	select ARCH_EXYNOS
	select COMMON_CLK_SAMSUNG
	select HAVE_S3C2410_WATCHDOG if WATCHDOG
	select HAVE_S3C_RTC if RTC_CLASS
	select PINCTRL
	select PINCTRL_EXYNOS

	help
	  This enables support for Samsung Exynos7 SoC family

config ARCH_LAYERSCAPE
	bool "ARMv8 based Freescale Layerscape SoC family"
	help
	  This enables support for the Freescale Layerscape SoC family.

config ARCH_HISI
	bool "Hisilicon SoC Family"
	help
	  This enables support for Hisilicon ARMv8 SoC family

config ARCH_MEDIATEK
	bool "Mediatek MT65xx & MT81xx ARMv8 SoC"
	select ARM_GIC
	select PINCTRL
	help
	  Support for Mediatek MT65xx & MT81xx ARMv8 SoCs

config ARCH_QCOM
	bool "Qualcomm Platforms"
	select PINCTRL
	help
	  This enables support for the ARMv8 based Qualcomm chipsets.

config ARCH_ROCKCHIP
	bool "Rockchip Platforms"
	select ARCH_HAS_RESET_CONTROLLER
	select ARCH_REQUIRE_GPIOLIB
	select PINCTRL
	select PINCTRL_ROCKCHIP
	help
	  This enables support for the ARMv8 based Rockchip chipsets,
	  like the RK3368.

config ARCH_SEATTLE
	bool "AMD Seattle SoC Family"
	help
	  This enables support for AMD Seattle SOC Family

config ARCH_STRATIX10
	bool "Altera's Stratix 10 SoCFPGA Family"
	help
	  This enables support for Altera's Stratix 10 SoCFPGA Family.

config ARCH_TEGRA
	bool "NVIDIA Tegra SoC Family"
	select ARCH_HAS_RESET_CONTROLLER
	select ARCH_REQUIRE_GPIOLIB
	select CLKDEV_LOOKUP
	select CLKSRC_MMIO
	select CLKSRC_OF
	select GENERIC_CLOCKEVENTS
	select HAVE_CLK
	select PINCTRL
	select RESET_CONTROLLER
	help
	  This enables support for the NVIDIA Tegra SoC family.

config ARCH_TEGRA_132_SOC
	bool "NVIDIA Tegra132 SoC"
	depends on ARCH_TEGRA
	select PINCTRL_TEGRA124
	select USB_ULPI if USB_PHY
	select USB_ULPI_VIEWPORT if USB_PHY
	help
	  Enable support for NVIDIA Tegra132 SoC, based on the Denver
	  ARMv8 CPU.  The Tegra132 SoC is similar to the Tegra124 SoC,
	  but contains an NVIDIA Denver CPU complex in place of
	  Tegra124's "4+1" Cortex-A15 CPU complex.

config ARCH_SPRD
	bool "Spreadtrum SoC platform"
	help
	  Support for Spreadtrum ARM based SoCs

config ARCH_THUNDER
	bool "Cavium Inc. Thunder SoC Family"
	help
	  This enables support for Cavium's Thunder Family of SoCs.

config ARCH_VEXPRESS
	bool "ARMv8 software model (Versatile Express)"
	select ARCH_REQUIRE_GPIOLIB
	select COMMON_CLK_VERSATILE
	select POWER_RESET_VEXPRESS
	select VEXPRESS_CONFIG
	help
	  This enables support for the ARMv8 software model (Versatile
	  Express).

config ARCH_XGENE
	bool "AppliedMicro X-Gene SOC Family"
	help
	  This enables support for AppliedMicro X-Gene SOC Family

config ARCH_ZYNQMP
	bool "Xilinx ZynqMP Family"
	help
	  This enables support for Xilinx ZynqMP Family

menu "Samsung Exynos"
config ARCH_EXYNOS
	bool

config SOC_EXYNOS8890
	bool "Samsung EXYNOS8890"
	select SOC_SAMSUNG
	select ARCH_EXYNOS
	select ARCH_HAS_CPUFREQ
	select HAVE_S3C2410_I2C if I2C
	select HAVE_S3C2410_WATCHDOG if WATCHDOG
	select HAVE_S3C_RTC if RTC_CLASS
	select ARCH_SUPPORTS_MSI
	select ARM_AMBA
	select CLKSRC_OF
	select USE_OF
	select COMMON_CLK_SAMSUNG
	select CLKSRC_EXYNOS_MCT
	select PINCTRL
	select SAMSUNG_DMADEV

config SOC_EXYNOS8895
	bool "Samsung EXYNOS8895"
	select SOC_SAMSUNG
	select ARCH_EXYNOS
	select ARCH_HAS_CPUFREQ
	select HAVE_S3C2410_I2C if I2C
	select HAVE_S3C2410_WATCHDOG if WATCHDOG
	select HAVE_S3C_RTC if RTC_CLASS
	select ARCH_SUPPORTS_MSI
	select ARM_AMBA
	select CLKSRC_OF
	select USE_OF
	select COMMON_CLK_SAMSUNG
	select CLKSRC_EXYNOS_MCT
	select PINCTRL
	select SAMSUNG_DMADEV

config SOC_EMULATOR8895
	bool "Samsung EMULATOR8895"

config ARCH_EXYNOS8
	bool "ARMv8 based Samsung Exynos8"
	select HAVE_ARM_SCU if SMP
	select HAVE_SMP
	help
	  Samsung EXYNOS8 (Mongoose/A53) SoC based systems

config ZONE_MOVABLE
	bool "Enable Zone Movable"
	default n

config ZONE_MOVABLE_SIZE_MBYTES
	int "ZONE_MOVABLE Size in MBytes"
	range 0 1024
	default 0
	depends on ZONE_MOVABLE
	help
	  Set Movable Zone size based on bits shift value. Movable Zone size
	  must be less than the highest populated zone.

endmenu

endmenu
```

## arch/arm64/Kconfig.sec
```kconfig
config SEC_A6PLTE_PROJECT
	depends on ARCH_SDM450
	default n
	bool "Samsung A6-Plus LTE Project"
	help
	  Support for Samsung A6-Plus LTE Project

config MACH_A6PLTE_EUR_OPEN
	depends on SEC_A6PLTE_PROJECT
	default n
	bool "Samsung A6-Plus LTE EUR OPEN"
	help
	  Support for Samsung A6-Plus LTE EUR OPEN device.

config MACH_A6PLTE_SEA_OPEN
	depends on SEC_A6PLTE_PROJECT
	default n
	bool "Samsung A6-Plus LTE SEA OPEN"
	help
	  Support for Samsung A6-Plus LTE SEA OPEN device.

config MACH_A6PLTE_LTN_OPEN
        depends on SEC_A6PLTE_PROJECT
        default n
        bool "Samsung A6-Plus LTE LTN OPEN"
        help
          Support for Samsung A6-Plus LTE LTN OPEN device.

config MACH_A6PLTE_CIS_SER
	depends on SEC_A6PLTE_PROJECT
	default n
	bool "Samsung A6-Plus LTE CIS SER"
	help
	  Support for Samsung A6-Plus LTE CIS SER device.

config MACH_A6PLTE_CHN_OPEN
	depends on SEC_A6PLTE_PROJECT
	default n
	bool "Samsung A6-Plus LTE CHN OPEN"
	help
	  Support for Samsung A6-Plus LTE CHN OPEN device.

config MACH_A6PLTE_KOR_KTT
	depends on SEC_A6PLTE_PROJECT
	default n
	bool "Samsung A6-Plus LTE KOR KTT"
	help
	  Support for Samsung A6-Plus LTE KOR KTT device.

config SEC_GTAXLQLTE_USA_SPR
	bool "Enable Support for Samsung GTAXLQ LTE USA SPR device."
	depends on ARCH_MSM8953
	help
	  This enables support for Samsung GTAXLQ LTE USA SPR device.

config SEC_J7POPLTE_USA_VZW
	bool "Enable Support for Samsung J7POP LTE USA VZW device."
	depends on ARCH_MSM8953
	help
	  This enables support for Samsung J7POP LTE USA VZW device.
	  
config SEC_J7POPLTE_USA_SPR
	bool "Enable Support for Samsung J7POP LTE USA SPR device."
	depends on ARCH_MSM8953
	help
	  This enables support for Samsung J7POP LTE USA SPR device.
	  
config SEC_J7POPLTE_USA_USC
	bool "Enable Support for Samsung J7POP LTE USA USC device."
	depends on ARCH_MSM8953
	help
	  This enables support for Samsung J7POP LTE USA USC device.

config SEC_J8PLTE_PROJECT
	depends on ARCH_SDM450
	default n
	bool "Samsung J8-Plus LTE Project"
	help
	  Support for Samsung J8-Plus LTE Project

config MACH_J8PLTE_CIS_SER
	depends on SEC_J8PLTE_PROJECT
	default n
	bool "Samsung J8-Plus LTE CIS SER"
	help
	  Support for Samsung J8-Plus LTE CIS SER device.


config MACH_J8PLTE_EUR_OPEN
	depends on SEC_J8PLTE_PROJECT
	default n
	bool "Samsung J8-Plus LTE EUR OPEN"
	help
	  Support for Samsung J8-Plus LTE EUR OPEN device.

config MACH_J8PLTE_SEA_OPEN
	depends on SEC_J8PLTE_PROJECT
	default n
	bool "Samsung J8-Plus LTE SEA OPEN"
	help
	  Support for Samsung J8-Plus LTE SEA OPEN device.
	  
config MACH_J8PLTE_CHN_OPEN
	depends on SEC_J8PLTE_PROJECT
	default n
	bool "Samsung J8-Plus LTE CHN OPEN"
	help
	  Support for Samsung J8-Plus LTE CHN OPEN device.

config MACH_J8PLTE_KOR_KTT
	depends on SEC_J8PLTE_PROJECT
	default n
	bool "Samsung J8-Plus LTE KOR KTT"
	help
	  Support for Samsung J8-Plus LTE KOR KTT device.

config MACH_J8PLTE_LTN_OPEN
        depends on SEC_J8PLTE_PROJECT
        default n
        bool "Samsung J8-Plus LTE LTN OPEN"
        help
          Support for Samsung J8-Plus LTE LTN OPEN device.

config SEC_GTA2XLLTE_PROJECT
	depends on ARCH_SDM450
	default n
	bool "Samsung Tab A2 XL LTE Project"
	help
	  Support for Samsung Tab A2 XL LTE Project

config MACH_GTA2XLLTE_CHN_OPEN
	depends on SEC_GTA2XLLTE_PROJECT
	default n
	bool "Samsung Tab A2 XL LTE CHN OPEN"
	help
	  Support for Samsung Tab A2 XL LTE CHN OPEN device.

config MACH_GTA2XLLTE_EUR_OPEN
	depends on SEC_GTA2XLLTE_PROJECT
	default n
	bool "Samsung Tab A2 XL LTE EUR OPEN"
	help
	  Support for Samsung Tab A2 XL LTE EUR OPEN device.

config MACH_GTA2XLLTE_USA_SPR
	depends on SEC_GTA2XLLTE_PROJECT
	default n
	bool "Samsung Tab A2 XL LTE USA SPR"
	help
	  Support for Samsung Tab A2 XL LTE USA SPR device.

config MACH_GTA2XLLTE_USA_VZW
	depends on SEC_GTA2XLLTE_PROJECT
	default n
	bool "Samsung Tab A2 XL LTE USA VZW"
	help
	  Support for Samsung Tab A2 XL LTE USA VZW device.
	  
config MACH_GTA2XLLTE_MEA_OPEN
	depends on SEC_GTA2XLLTE_PROJECT
	default n
	bool "Samsung Tab A2 XL LTE MEA OPEN"
	help
	  Support for Samsung Tab A2 XL LTE MEA OPEN device.
	  
config MACH_GTA2XLLTE_MEA_TUR
	depends on SEC_GTA2XLLTE_PROJECT
	default n
	bool "Samsung Tab A2 XL LTE MEA TUR"
	help
  	  Support for Samsung Tab A2 XL LTE MEA TUR device.

config MACH_GTA2XLLTE_KOR_OPEN
	depends on SEC_GTA2XLLTE_PROJECT
	default n
	bool "Samsung Tab A2 XL LTE KOR OPEN"
	help
	  Support for Samsung Tab A2 XL LTE KOR OPEN device.
	  
config MACH_GTA2XLLTE_CAN_SINGLE
	depends on SEC_GTA2XLLTE_PROJECT
	default n
	bool "Samsung Tab A2 XL LTE CAN SINGLE"
	help
	  Support for Samsung Tab A2 XL LTE CAN SINGLE device.
	
config SEC_GTA2XLWIFI_PROJECT
        depends on ARCH_SDM450
        default n
        bool "Samsung Tab A2 XL WIFI Project"
        help
          Support for Samsung Tab A2 XL WIFI Project

config MACH_GTA2XLWIFI_EUR_OPEN
        depends on SEC_GTA2XLWIFI_PROJECT
        default n
        bool "Samsung Tab A2 XL WIFI EUR OPEN"
        help
          Support for Samsung Tab A2 XL WIFI EUR OPEN device.

config MACH_J6PLTE_CIS_SER
	depends on SEC_J6PLTE_PROJECT
	default n
	bool "Samsung J6-Plus LTE CIS SER"
	help
	  Support for Samsung J6-Plus LTE CIS SER device.
```

## arch/arm64/configs/dmverity_defconfig
```kconfig
#
# Contact: haeil.hyun <haeil.hyun@samsung.com> for more info
#

# define for DM-VERITY

CONFIG_DM_VERITY=y
```
