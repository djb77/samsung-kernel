## arch/arm64/configs/msm8953_sec_c5prolte_chn_defconfig
```kconfig
# msm8953_sec_c5prolte_chn_defconfig

#
# BSP
#
CONFIG_SEC_MSM8953_PROJECT=y
CONFIG_SEC_C5PROLTE_CHN=y

# GPIO EXPANDER
CONFIG_GPIO_PCAL6416A=y

#
# Display
#
CONFIG_PANEL_S6E3FA3_AMS520MV01_FHD=y
CONFIG_FB_MSM_MDSS_SAMSUNG=y

# BATTERY & Charger
CONFIG_SAMSUNG_LPM_MODE=y
CONFIG_BATTERY_SAMSUNG=y
CONFIG_AFC_CHARGER_MODE=y
CONFIG_PREVENT_SOC_JUMP=y
CONFIG_CHARGER_SM5705=y
CONFIG_FUELGAUGE_SM5705=y
CONFIG_SEC_MPP_SHARE=y
# CONFIG_SW_SELF_DISCHARGING=y
CONFIG_BATTERY_SWELLING=y
CONFIG_MULTI_CHARGING=y
CONFIG_STEP_CHARGING=y
CONFIG_CHARGER_DA9155=y
CONFIG_CHARGER_BQ25898S=y
CONFIG_USE_TEMP_COMPENSATION=n
# CONFIG_SEC_MPP_SHARE_LOW_TEMP_WA is not set
CONFIG_BATTERY_SAMSUNG_V2=y
CONFIG_BATTERY_NOTIFIER=y
CONFIG_CHANGE_VBUS_VOLTAGE=y
#
# InputDevice
#
#CONFIG_TOUCHSCREEN_MELFAS_MMS449=y
#CONFIG_TOUCHSCREEN_DUMP_MODE=y
CONFIG_SECURE_TOUCH=y
#CONFIG_KEYBOARD_ABOV_TOUCH_18XX is not set
CONFIG_KEYBOARD_ABOV_TOUCH_16XX=y
CONFIG_TOUCHSCREEN_ZINITIX_ZT75XX=y
#CONFIG_KEYBOARD_ABOV_TOUCH_T316=y

CONFIG_MFD_SM5705=y
CONFIG_SM5705_SUPPORT_GAMEPAD=y

# Finger print sensor
CONFIG_SENSORS_FINGERPRINT=y
CONFIG_SENSORS_FINGERPRINT_SYSFS=y
CONFIG_SENSORS_ET510=y
CONFIG_SENSORS_FP_SPI_NUMBER=4
CONFIG_SENSORS_FP_SPI_GPIO_START=12
CONFIG_SENSORS_FP_SPI_GPIO_END=15

#
# Sensor
#

CONFIG_SENSORS_SSP=y
CONFIG_SENSORS_SSP_STM32f=y
CONFIG_SENSORS_SSP_TMD3725=y
CONFIG_SENSORS_SSP_6AXIS=y
CONFIG_SENSORS_SSP_AK09916=y
CONFIG_SENSORS_SSP_ATUC128L5HAR=y
#CONFIG_SENSORS_CORE=y
CONFIG_IIO_BUFFER=y
CONFIG_IIO=y
CONFIG_IIO_KFIFO_BUF=y
CONFIG_IIO_TRIGGER=y

#HALL IC
#CONFIG_SENSORS_HALL=y
# CONFIG_CERTIFY_HALL is not set

#
# MUIC
#
CONFIG_USE_MUIC=y
CONFIG_MUIC_NOTIFIER=y
CONFIG_MUIC_UNIVERSAL=y
CONFIG_MUIC_UNIVERSAL_SM5705=y
CONFIG_MUIC_UNIVERSAL_SM5705_AFC=y
# CONFIG_MUIC_SM5705_AFC_18W_TA_SUPPORT is not set
CONFIG_MUIC_PINCTRL=y
CONFIG_USB_HOST_NOTIFY=y
CONFIG_MUIC_SUPPORT_RUSTPROOF=y
CONFIG_MUIC_HV=y
# CONFIG_MUIC_SM5705_SWITCH_CONTROL_GPIO is not set
CONFIG_MUIC_SM570X_SWITCH_CONTROL_GPIO = y
CONFIG_SERIAL_FACTORY_UART_HS=y

#
# CCIC
#
CONFIG_CCIC_NOTIFIER=y
# CONFIG_CCIC_S2MM003 is not set
CONFIG_CCIC_S2MM005=y
# CONFIG_CCIC_ALTERNATE_MODE is not set
CONFIG_SEC_EXT=y
CONFIG_SEC_SYSFS=y
CONFIG_MUIC_SUPPORT_CCIC=y
CONFIG_USB_TYPEC_MANAGER_NOTIFIER=y
CONFIG_CCIC_LPM_ENABLE=y
CONFIG_USB_NOTIFY_PROC_LOG=y
# CONFIG_DUAL_ROLE_USB_INTF is not set
CONFIG_USB_HOST_NOTIFY=y
CONFIG_USB_EXTERNAL_NOTIFY=y
CONFIG_USB_DEBUG_DETAILED_LOG=y
CONFIG_CCIC_S2MM005_PD_DISABLE=y

#
# MOTOR
#
CONFIG_MSM_VIBRATOR=y
# CONFIG_DC_MOTOR_PMIC is not set

#
# NFC ESE
#
CONFIG_SAMSUNG_NFC=y
CONFIG_NFC_PN547=y
CONFIG_NFC_PN547_ESE_SUPPORT=y
CONFIG_ESE_SECURE=y
CONFIG_ESE_SECURE_SPI_PORT=1
CONFIG_ESE_SPI_GPIO_START=0
CONFIG_ESE_SPI_GPIO_END=3

#CAMERA
CONFIG_S5K3P8SX=y
CONFIG_S5K3P8SX_AK7372=y
CONFIG_MSM_FRONT_EEPROM=y
CONFIG_GET_REAR_MODULE_ID=y

#FLASH
CONFIG_LEDS_SM5705=y
CONFIG_DUAL_LEDS_FLASH=y
#
# Audio
#
CONFIG_SND_SOC_MSM8X16_RT5665=y
# CONFIG_SND_SOC_MSM8X16 is not set
CONFIG_SND_SOC_MSM8X16_CS47L15=y
CONFIG_AUDIO_SPEAKER_OUT_NXP_AMP_ENABLE=y
CONFIG_MFD_MADERA=y
CONFIG_MFD_MADERA_SPI=y
CONFIG_MFD_CS47L15=y
CONFIG_MADERA_IRQ=y
CONFIG_MADERA_IRQ_CS47L15=y
CONFIG_GPIO_MADERA=y
CONFIG_SWITCH_MADERA=y
CONFIG_REGULATOR_MADERA_LDO1=y
CONFIG_REGULATOR_MADERA_MICSUPP=y
CONFIG_SND_SOC_MADERA=y
#CONFIG_SEC_EARJACK_35_USB_SWITCH=y

# Earjack
#CONFIG_SAMSUNG_JACK=y

# undefine hbtp
CONFIG_INPUT_HBTP_INPUT=n

#Power off Alarm
CONFIG_RTC_AUTO_PWRON=y

# Service LED
CONFIG_LEDS_SM5705_RGB=y

# MMC
CONFIG_SEC_HYBRID_TRAY=y
CONFIG_MMC_CQ_HCI=y

# Scheduler
# CONFIG_SEC_ADAPTIVE_LOAD_TRACKING is not set

# SDP and DLP
CONFIG_SDP=y
CONFIG_DLP=y

# SSWAP
CONFIG_SWAP=y
CONFIG_FRONTSWAP=y
CONFIG_ZSMALLOC=y
CONFIG_ZSMALLOC_STAT=y
CONFIG_ZSMALLOC_OBJ_SEQ=n
CONFIG_PGTABLE_MAPPING=y
CONFIG_ZSWAP=y
CONFIG_ZSWAP_COMPACTION=y
CONFIG_ZSWAP_ENABLE_WRITEBACK=n
CONFIG_ZPOOL=y
CONFIG_DIRECT_RECLAIM_FILE_PAGES_ONLY=y
CONFIG_INCREASE_MAXIMUM_SWAPPINESS=y
CONFIG_FIX_INACTIVE_RATIO=y
CONFIG_TIGHT_PGDAT_BALANCE=y
CONFIG_VNSWAP=y
CONFIG_SWAP_ENABLE_READAHEAD=n

#CPU WEAR LEVELING
CONFIG_SS_THERMAL_CPU_WEAR_LEVEL=y

#BarTender
CONFIG_CPUSETS=y
CONFIG_FAIR_GROUP_SCHED=y 
CONFIG_CFS_BANDWIDTH=y 

# WLAN
CONFIG_WLAN_FEATURE_11W=n
```
