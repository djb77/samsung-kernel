## arch/arm/configs/msm8937_sec_j3poplte_usa_lra_defconfig
```kconfig
CONFIG_SEC_MSM8917_PROJECT=y
CONFIG_SEC_J3POPLTE_PROJECT=y
CONFIG_MACH_J3POPLTE_USA_LRA=y

CONFIG_DRV_SAMSUNG=y

#INPUT MODULES
CONFIG_SEC_INCELL=y
CONFIG_TOUCHSCREEN_SYNAPTICS_INCELL=y
CONFIG_KEYBOARD_TC3XXK=y

#MUIC
CONFIG_USE_MUIC=y
CONFIG_MUIC_NOTIFIER=y
CONFIG_MUIC_UNIVERSAL=y
CONFIG_MUIC_UNIVERSAL_SM5703=y
CONFIG_MUIC_UART_SWITCH=y
# CONFIG_MUIC_SUPPORT_EARJACK is not set
# CONFIG_MUIC_UNIVERSAL_SM5705 is not set
# CONFIG_MUIC_UNIVERSAL_SM5705_AFC is not set
CONFIG_MUIC_PINCTRL=y
CONFIG_MUIC_SUPPORT_RUSTPROOF=y
CONFIG_MFD_SM5703=y

#USB Host
CONFIG_USB_HOST_NOTIFY=y
CONFIG_VBUS_NOTIFIER=y

# BATTERY & CHARGER
CONFIG_SAMSUNG_LPM_MODE=y
CONFIG_BATTERY_SAMSUNG=y
CONFIG_PREVENT_SOC_JUMP=y
CONFIG_CHARGER_SM5703=y
CONFIG_FUELGAUGE_SM5703=y
CONFIG_BATTERY_SWELLING=y
CONFIG_SEC_MPP_SHARE=y
CONFIG_CHARGER_SM5703_DUALPATH=y

CONFIG_SYSFS=y
CONFIG_INPUT=y
CONFIG_INPUT_MISC=y
CONFIG_INPUT_GPIO=y
CONFIG_INPUT_POLLDEV=y

#SENSORS
CONFIG_SENSORS=y
CONFIG_SENSORS_CORE=y
CONFIG_SENSORS_CM36672P=y
CONFIG_ST_LSM6DS3=y
CONFIG_ST_LSM6DS3_SPI=y
CONFIG_SENSORS_YAS537=y

#NFC

#HALL IC
# CONFIG_SENSORS_HALL is not set

#CAMERA
CONFIG_IMX241=y
CONFIG_SR259=y
CONFIG_ACTIVE_FLASH=y

#AUDIO
CONFIG_SAMSUNG_JACK=y
# CONFIG_SLIMBUS is not set
# CONFIG_SLIMBUS_MSM_NGD is not set
# CONFIG_SOUNDWIRE is not set

#FLASH
CONFIG_FLASHLIGHT=y
CONFIG_SM_FLASH_LED=y
CONFIG_FLED_SM5703=y

#DISPLAY
CONFIG_PANEL_TD4100_BV050HDM_HD=y

# MOTOR
CONFIG_MSM_VIBRATOR=y
CONFIG_REGULATOR_SM5703=y
CONFIG_SM5703_VIBRATOR=y

#SVC LEDS
CONFIG_LEDS_KTD2026=y

#Power off Alarm
# CONFIG_RTC_AUTO_PWRON is not set

# Legacy alarm dev
# CONFIG_ANDROID_INTF_ALARM_DEV is not set

CONFIG_NR_CPUS=4

# SSWAP
CONFIG_SWAP=y
CONFIG_FRONTSWAP=y
CONFIG_ZSMALLOC=y
CONFIG_ZSMALLOC_STAT=y
CONFIG_ZSMALLOC_OBJ_SEQ=n
CONFIG_PGTABLE_MAPPING=y
CONFIG_ZSWAP=y
CONFIG_ZSWAP_COMPACTION=y
CONFIG_ZSWAP_ENABLE_WRITEBACK=n
CONFIG_ZSWAP_SAME_PAGE_SHARING=y
CONFIG_ZPOOL=y
CONFIG_DIRECT_RECLAIM_FILE_PAGES_ONLY=y
CONFIG_INCREASE_MAXIMUM_SWAPPINESS=y
CONFIG_FIX_INACTIVE_RATIO=y
CONFIG_TIGHT_PGDAT_BALANCE=y
CONFIG_VNSWAP=y
CONFIG_SWAP_ENABLE_READAHEAD=n

# MMAP READAROUND
CONFIG_MMAP_READAROUND_LIMIT=16

CONFIG_BALANCE_ANON_FILE_RECLAIM=y

# KNOX SDP and DLP
CONFIG_SDP=y
CONFIG_DLP=y

# EPDG
CONFIG_NET_CORE=y
CONFIG_NET_SCH_PRIO=y
CONFIG_NET_SCHED=y   #depends on CONFIG_NET  which is enabled by default.. coz not seeing in the config file
CONFIG_NET_CLS_BASIC=y # required if basic is being used as a filter. depends on CONFIG_NET_CLS so enabling it by default
CONFIG_NET_CLS=y
CONFIG_NET_CLS_ACT=y # for enabling the action target.
CONFIG_NET_ACT_MIRRED=y  # for enabling the mirred target for redirecting the packet between the devices.
CONFIG_NET_EMATCH=y   #basic uses extended matches so this has to be present
CONFIG_NET_SCH_INGRESS=y # classifier for ingress packet
```

## arch/arm/configs/msm8937_sec_j3y17qlte_swa_open_defconfig
```kconfig
CONFIG_SEC_MSM8917_PROJECT=y
CONFIG_SEC_J3Y17QLTE_PROJECT=y
CONFIG_MACH_J3Y17QLTE_SWA_OPEN=y

CONFIG_DRV_SAMSUNG=y

CONFIG_3G_DDR_SUPPORT=y

#INPUT MODULES
CONFIG_SEC_INCELL=y
CONFIG_TOUCHSCREEN_SYNAPTICS_INCELL=y
CONFIG_KEYBOARD_TC300K=y
# CONFIG_TOUCHKEY_GRIP is not set

#MUIC
CONFIG_USE_MUIC=y
CONFIG_MUIC_NOTIFIER=y
CONFIG_MUIC_UNIVERSAL=y
CONFIG_MUIC_UNIVERSAL_SM5703=y
CONFIG_MUIC_UART_SWITCH=y
# CONFIG_MUIC_UNIVERSAL_SM5705 is not set
# CONFIG_MUIC_UNIVERSAL_SM5705_AFC is not set
CONFIG_MUIC_PINCTRL=y
CONFIG_MUIC_SUPPORT_RUSTPROOF=y
CONFIG_MFD_SM5703=y
CONFIG_REGULATOR_SM5703=y

#USB NNOTIFY
CONFIG_USB_HOST_NOTIFY=y
CONFIG_VBUS_NOTIFIER=y

# BATTERY & CHARGER
CONFIG_SAMSUNG_LPM_MODE=y
CONFIG_BATTERY_SAMSUNG=y
CONFIG_BATTERY_SAMSUNG_V2=y
CONFIG_PREVENT_SOC_JUMP=y
CONFIG_CHARGER_SM5703=y
CONFIG_FUELGAUGE_SM5703=y
CONFIG_BATTERY_SWELLING=y
CONFIG_SEC_MPP_SHARE=y
CONFIG_CHARGER_SM5703_DUALPATH=y
CONFIG_INBATVOLT_FG=y
CONFIG_DISABLE_SAFETY_TIMER=y

CONFIG_SYSFS=y
CONFIG_INPUT=y
CONFIG_INPUT_MISC=y
CONFIG_INPUT_GPIO=y
CONFIG_INPUT_POLLDEV=y

#SENSORS
CONFIG_SENSORS=y
CONFIG_SENSORS_CORE=y
CONFIG_SENSORS_K2HH=y
#CONFIG_SENSORS_STK3013=y
CONFIG_SENSORS_GP2AP070S=y

# Fingerprint sensor
CONFIG_SENSORS_FINGERPRINT=y
CONFIG_SENSORS_ET5XX=y
CONFIG_SENSORS_FP_SPI_NUMBER=7
CONFIG_SENSORS_FP_SPI_GPIO_START=85
CONFIG_SENSORS_FP_SPI_GPIO_END=88


#NFC

#MMC
CONFIG_SEC_HYBRID_TRAY=y
#HALL IC
#CONFIG_SENSORS_HALL=y

#CAMERA
CONFIG_S5K3L2XX=y
CONFIG_S5K5E3YX=y
CONFIG_ACTIVE_FLASH=y
CONFIG_MSM_FRONT_OTP=y

#AUDIO
CONFIG_SAMSUNG_JACK=y
# CONFIG_SLIMBUS is not set
# CONFIG_SLIMBUS_MSM_NGD is not set
# CONFIG_SOUNDWIRE is not set
# CONFIG_MSM_ULTRASOUND is not set

#FLASH
CONFIG_FLASHLIGHT=y
CONFIG_SM_FLASH_LED=y
CONFIG_FLED_SM5703=y
CONFIG_LEDS_KTD2692=y
CONFIG_FRONT_FLASH=y
CONFIG_LEDS_KTD2692_FOR_FRONT=y

#EEPROM
CONFIG_GET_REAR_MODULE_ID=y

#DISPLAY
CONFIG_PANEL_HX83100A_C5001H3F_HD=y
CONFIG_PANEL_TD4100_BS050HDM_HD=y

# MOTOR
CONFIG_MSM_VIBRATOR=y

#SVC LEDS
CONFIG_LEDS_KTD2026=y

#Power off Alarm
# CONFIG_RTC_AUTO_PWRON is not set

CONFIG_NR_CPUS=4

# NFC
CONFIG_SAMSUNG_NFC=y
CONFIG_SEC_NFC=y

# MMAP READAROUND
CONFIG_MMAP_READAROUND_LIMIT=32

# SSWAP
CONFIG_SWAP=y
CONFIG_FRONTSWAP=y
CONFIG_ZSMALLOC=y
CONFIG_ZSMALLOC_STAT=y
CONFIG_ZSMALLOC_OBJ_SEQ=n
CONFIG_PGTABLE_MAPPING=y
CONFIG_ZSWAP=y
CONFIG_ZSWAP_COMPACTION=y
CONFIG_ZSWAP_ENABLE_WRITEBACK=n
CONFIG_ZPOOL=y
CONFIG_DIRECT_RECLAIM_FILE_PAGES_ONLY=y
CONFIG_INCREASE_MAXIMUM_SWAPPINESS=y
CONFIG_FIX_INACTIVE_RATIO=y
CONFIG_TIGHT_PGDAT_BALANCE=y
CONFIG_VNSWAP=y
CONFIG_SWAP_ENABLE_READAHEAD=n

# KNOX SDP and DLP
CONFIG_SDP=y
CONFIG_DLP=y
```

## arch/arm/configs/msm8937_sec_on5qlte_chn_defconfig
```kconfig
CONFIG_SEC_MSM8917_PROJECT=y
CONFIG_SEC_ON5QLTE_PROJECT=y
CONFIG_MACH_ON5QLTE_CHN_OPEN=y

CONFIG_DRV_SAMSUNG=y

#INPUT MODULES
CONFIG_KEYBOARD_ABOV_TOUCH_16XX=y
CONFIG_KEYBOARD_MELFAS_MHS204=y
CONFIG_TOUCHSCREEN_HIMAX_I2C=y
CONFIG_SEC_INCELL=y
CONFIG_TOUCHSCREEN_SYNAPTICS_DSX_TEST_REPORTING_v26=y

#MUIC
CONFIG_USE_MUIC=y
CONFIG_MUIC_NOTIFIER=y
CONFIG_MUIC_S2MU005=y
CONFIG_MFD_S2MU005=y
CONFIG_MUIC_UART_SWITCH=y

# BATTERY & CHARGER
CONFIG_SAMSUNG_LPM_MODE=y
CONFIG_BATTERY_SAMSUNG=y
CONFIG_PREVENT_SOC_JUMP=y
CONFIG_SW_SELF_DISCHARGING=y
CONFIG_CHARGER_S2MU005=y
CONFIG_FUELGAUGE_S2MU005=y
CONFIG_BATTERY_SWELLING=y
CONFIG_SEC_MPP_SHARE=y

CONFIG_SYSFS=y
CONFIG_INPUT=y
CONFIG_INPUT_MISC=y
CONFIG_INPUT_GPIO=y
CONFIG_INPUT_POLLDEV=y

#SENSORS
CONFIG_SENSORS=y
CONFIG_SENSORS_CORE=y
CONFIG_SENSORS_K2HH=y
CONFIG_SENSORS_STK3013=y

#NFC

#MMC
CONFIG_SEC_HYBRID_TRAY=y
#HALL IC
CONFIG_SENSORS_HALL=y

#CAMERA
CONFIG_IMX135=y
CONFIG_S5K5E3YX=y

#AUDIO
CONFIG_SAMSUNG_JACK=y
# CONFIG_SLIMBUS is not set
# CONFIG_SLIMBUS_MSM_NGD is not set
# CONFIG_SOUNDWIRE is not set

#FLASH
# CONFIG_FLASHLIGHT is not set
# CONFIG_SM_FLASH_LED is not set
# CONFIG_LEDS_S2MU005 is not set
# CONFIG_LEDS_S2MU005_FLASH is not set

#DISPLAY
CONFIG_PANEL_HX83100A_C5001H3F_HD=y
CONFIG_BLIC_ISL98611=y
CONFIG_PANEL_TD4100_C5001H3F_HD=y

# MOTOR
CONFIG_MSM_VIBRATOR=y

#SVC LEDS
CONFIG_LEDS_KTD2026=y

#Power off Alarm
CONFIG_RTC_AUTO_PWRON=y

# Legacy alarm dev
CONFIG_ANDROID_INTF_ALARM_DEV=y

CONFIG_NR_CPUS=4
```

## arch/arm/configs/msm8937_sec_on5xllte_chn_defconfig
```kconfig
CONFIG_SEC_MSM8917_PROJECT=y
CONFIG_SEC_ON5XLLTE_PROJECT=y
CONFIG_MACH_ON5XLLTE_CHN_OPEN=y

CONFIG_DRV_SAMSUNG=y

#INPUT MODULES
CONFIG_KEYBOARD_ABOV_TOUCH_16XX=y
CONFIG_KEYBOARD_MELFAS_MHS204=y
CONFIG_SEC_INCELL=y
CONFIG_TOUCHSCREEN_SYNAPTICS_INCELL=y

#MUIC
CONFIG_USE_MUIC=y
CONFIG_MUIC_NOTIFIER=y
CONFIG_MUIC_S2MU005=y
CONFIG_MFD_S2MU005=y
CONFIG_MUIC_UART_SWITCH=y

#USB NNOTIFY
CONFIG_USB_HOST_NOTIFY=y
CONFIG_VBUS_NOTIFIER=y

# BATTERY & CHARGER
CONFIG_SAMSUNG_LPM_MODE=y
CONFIG_BATTERY_SAMSUNG=y
CONFIG_PREVENT_SOC_JUMP=y
CONFIG_SW_SELF_DISCHARGING=y
CONFIG_CHARGER_S2MU005=y
CONFIG_FUELGAUGE_S2MU005=y
CONFIG_BATTERY_SWELLING=y
CONFIG_SEC_MPP_SHARE=y

CONFIG_SYSFS=y
CONFIG_INPUT=y
CONFIG_INPUT_MISC=y
CONFIG_INPUT_GPIO=y
CONFIG_INPUT_POLLDEV=y

#SENSORS
CONFIG_SENSORS=y
CONFIG_SENSORS_CORE=y
CONFIG_SENSORS_K2HH=y
CONFIG_SENSORS_STK3013=y

#NFC

#MMC
CONFIG_SEC_HYBRID_TRAY=y
#HALL IC
#CONFIG_SENSORS_HALL=y

#CAMERA
CONFIG_IMX258=y
CONFIG_S5K5E3YX=y

#AUDIO
CONFIG_SAMSUNG_JACK=y
# CONFIG_SLIMBUS is not set
# CONFIG_SLIMBUS_MSM_NGD is not set
# CONFIG_SOUNDWIRE is not set
CONFIG_SW_100K_TO_GND=y

#FLASH
CONFIG_FLASHLIGHT=y
CONFIG_LEDS_S2MU005=y
CONFIG_LEDS_S2MU005_FLASH=y

#EEPROM
CONFIG_GET_REAR_MODULE_ID=y

#DISPLAY
CONFIG_PANEL_HX83100A_C5001H3F_HD=y
CONFIG_BLIC_ISL98611=y
CONFIG_PANEL_TD4100_C5001H3F_HD=y

# MOTOR
CONFIG_MSM_VIBRATOR=y

#SVC LEDS
CONFIG_LEDS_KTD2026=y

#Power off Alarm
CONFIG_RTC_AUTO_PWRON=y

# Legacy alarm dev
CONFIG_ANDROID_INTF_ALARM_DEV=y

CONFIG_NR_CPUS=4

# MMAP READAROUND
CONFIG_MMAP_READAROUND_LIMIT=32

# SSWAP
CONFIG_SWAP=y
CONFIG_FRONTSWAP=y
CONFIG_ZSMALLOC=y
CONFIG_ZSMALLOC_STAT=y
CONFIG_ZSMALLOC_OBJ_SEQ=n
CONFIG_PGTABLE_MAPPING=y
CONFIG_ZSWAP=y
CONFIG_ZSWAP_COMPACTION=y
CONFIG_ZSWAP_ENABLE_WRITEBACK=n
CONFIG_ZPOOL=y
CONFIG_DIRECT_RECLAIM_FILE_PAGES_ONLY=y
CONFIG_INCREASE_MAXIMUM_SWAPPINESS=y
CONFIG_FIX_INACTIVE_RATIO=y
CONFIG_TIGHT_PGDAT_BALANCE=y
CONFIG_VNSWAP=y
CONFIG_SWAP_ENABLE_READAHEAD=n

# KNOX SDP and DLP
CONFIG_SDP=y
CONFIG_DLP=y
```

## arch/arm/configs/msm8937_sec_userdebug_defconfig
```kconfig
CONFIG_IKCONFIG=y
CONFIG_IKCONFIG_PROC=y

CONFIG_FTRACE=y

# Rooting Prevention
# CONFIG_SEC_RESTRICT_ROOTING is not set
# CONFIG_SEC_RESTRICT_SETUID is not set
# CONFIG_SEC_RESTRICT_FORK is not set
# CONFIG_SEC_RESTRICT_ROOTING_LOG is not set
```

## arch/arm/configs/msm8953_sec_eng_defconfig
```kconfig
CONFIG_CGROUP_DEBUG=y
CONFIG_ARCH_MSMCOBALT=y
CONFIG_NETFILTER_XT_TARGET_HARDIDLETIMER=y
CONFIG_NETFILTER_XT_TARGET_SECMARK=y
CONFIG_REGULATOR_STUB=y
CONFIG_REGULATOR_PROXY_CONSUMER=y
CONFIG_REGULATOR_MEM_ACC=y
CONFIG_MSM_VIDC_GOVERNORS=y
CONFIG_FB_MSM_MDSS_XLOG_DEBUG=y
CONFIG_MSM_AVTIMER=y
CONFIG_CP_ACCESS64=y
#CONFIG_MSM_CPUSS_DUMP is not set
CONFIG_MSM_COMMON_LOG=y
CONFIG_MSM_DDR_HEALTH=y
# CONFIG_MSM_FORCE_WDOG_BITE_ON_PANIC is not set
CONFIG_MSM_DCC=y
CONFIG_MSM_PIL_MSS_QDSP6V5=y
CONFIG_MSM_SYSMON_GLINK_COMM=y
CONFIG_CORESIGHT_ETMV4=y
CONFIG_MSM_TZ_LOG=y
CONFIG_LOG_BUF_MAGIC=y
CONFIG_DYNAMIC_DEBUG=y
CONFIG_DEBUG_OBJECTS=y
CONFIG_DEBUG_OBJECTS_FREE=y
CONFIG_DEBUG_OBJECTS_TIMERS=y
CONFIG_DEBUG_OBJECTS_WORK=y
CONFIG_DEBUG_OBJECTS_RCU_HEAD=y
CONFIG_DEBUG_OBJECTS_PERCPU_COUNTER=y
CONFIG_DEBUG_KMEMLEAK=y
CONFIG_DEBUG_KMEMLEAK_DEFAULT_OFF=y
CONFIG_DEBUG_STACK_USAGE=y
CONFIG_DEBUG_MEMORY_INIT=y
CONFIG_LOCKUP_DETECTOR=y
CONFIG_BOOTPARAM_SOFTLOCKUP_PANIC=y
# CONFIG_DETECT_HUNG_TASK is not set
CONFIG_DEBUG_SPINLOCK=y
CONFIG_DEBUG_MUTEXES=y
CONFIG_DEBUG_ATOMIC_SLEEP=y
CONFIG_DEBUG_LIST=y
CONFIG_FAULT_INJECTION=y
CONFIG_FAIL_PAGE_ALLOC=y
CONFIG_UFS_FAULT_INJECTION=y
CONFIG_FAULT_INJECTION_DEBUG_FS=y
CONFIG_FAULT_INJECTION_STACKTRACE_FILTER=y
CONFIG_BLK_DEV_IO_TRACE=y
CONFIG_LSM_MMAP_MIN_ADDR=4096
CONFIG_HW_RANDOM_MSM_LEGACY=y
CONFIG_SLUB_DEBUG=y
CONFIG_SLUB_DEBUG_ON=y
CONFIG_PAGE_OWNER=y
CONFIG_PM_DEBUG=y
CONFIG_SUSPEND_TIME=y
CONFIG_IOMMU_DEBUG_TRACKING=y
CONFIG_IRQSOFF_TRACER=y
CONFIG_PREEMPT_TRACER=y
CONFIG_PANIC_ON_DATA_CORRUPTION=y
CONFIG_ARM64_PTDUMP=y
#CONFIG_FREE_PAGES_RDONLY is not set
#CONFIG_KERNEL_TEXT_RDONLY is not set
CONFIG_SLABINFO=y
CONFIG_DEBUG_PAGEALLOC=y
CONFIG_SLUB_DEBUG_PANIC_ON=y

#
# TIMA RKP
#
# CONFIG_RKP_KDP is not set
# CONFIG_RKP_NS_PROT is not set
```

## arch/arm/configs/msm8953_sec_userdebug_defconfig
```kconfig
CONFIG_IKCONFIG=y
CONFIG_IKCONFIG_PROC=y

CONFIG_DYNAMIC_DEBUG=y

#
# DS5 Streamline v22
#
CONFIG_HW_PERF_EVENTS=y
CONFIG_PROFILING=y
CONFIG_PERF_EVENTS=y
CONFIG_FTRACE=y
CONFIG_HIGH_RES_TIMERS=y
CONFIG_HW_PERF_EVENTS=y
CONFIG_LOCAL_TIMERS=y
CONFIG_LOCAL_TIMERS=y
CONFIG_GATOR=m
CONFIG_BLK_DEV_IO_TRACE=y
```
