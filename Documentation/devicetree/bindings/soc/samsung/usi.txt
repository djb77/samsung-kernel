## Documentation/devicetree/bindings/soc/samsung/usi.txt
```
* EXYNOS - USI(Universal Serial Interface) devicetree making guide

The USI can operate as UART, HSI2C and SPI.
So the configuration for one specific function
should be needed with SYSREG(System Registers).

To configure USI port as one specific function,
function string(ex, "spi" or "hsi2c0" or "hsi2c1" or "spi" or "uart" or
"hsi2c0_hsi2c1" or "uart_hsi2c1")
should be declared in "usi_mode" property in board devicetree file.

Becuase USI configuration can differ from board schematic.

* Required SoC Specific Properties:

 - compatible: should be one of the following.
   - samsung,exynos-usi: for exynos7, exynos8 platforms.

 - reg: physical base address of the SYSREG for specific USI port
	and length of memory mapped region.

* Required Board Specific Properties:
 - usi_mode: function string for one specific IP operation.
             hsi2c0: for HSI2C0
             hsi2c1: for HSI2C1
             spi: for SPI
             uart: for UART
             hsi2c0_hsi2c1: for HSI2C0 and HSI2C1
             uart_hsi2c1: for UART(without hardware flow control) and HSI2C1

   In case of HSI2C function of USI,
   hsi2c0 and hsi2c1 should be declared in according to board schemetic.
   If shemetic describes USI pin as "XUSI##_SDA0" and XUSI##_SCL0",
   we need to use "hsi2c0" for usi_mode.
   If shemetic describes USI pin as "XUSI##_SDA1" and XUSI##_SCL1",
   we need to use "hsi2c1" for usi_mode.
   If shemetic describes USI pin as "XUSI##_SDA0" and XUSI##_SCL0",
   and there is also "XUSI##_SDA1" and XUSI##_SCL1",
   we need to use "hsi2c0_hsi2c1" for usi_mode.

* Exsamples:

 - SoC Specific Portion

	/* USI_0 */
	usi_0: usi@10421000 {
		       compatible = "samsung,exynos-usi";
		       reg = <0x0 0x10421000 0x4>;
		       /* usi_mode = "hsi2c0" or "hsi2c1" or "spi" or "uart"
			  or "hsi2c0_hsi2c1" or "uart_hsi2c1"    */
		       status = "disabled";
       };

	/* USI_1 */
	usi_1: usi@10421004 {
		       compatible = "samsung,exynos-usi";
		       reg = <0x0 0x10421004 0x4>;
		       /* usi_mode = "hsi2c0" or "hsi2c1" or "spi" or "uart"
			  or "hsi2c0_hsi2c1" or "uart_hsi2c1"    */
		       status = "disabled";
       };

	/* USI_2 */
	usi_2: usi@10421008 {
		       compatible = "samsung,exynos-usi";
		       reg = <0x0 0x10421008 0x4>;
		       /* usi_mode = "hsi2c0" or "hsi2c1" or "spi" or "uart"
			  or "hsi2c0_hsi2c1" or "uart_hsi2c1"    */
		       status = "disabled";
       };

 - Board Specific Portion

	/* USI MODE SETTINGS

	   usi_mode = "hsi2c0" or "hsi2c1" or "spi" or "uart"
			or "hsi2c0_hsi2c1" or "uart_hsi2c1"
	*/

	usi_0: usi@10421000 {
		 usi_mode = "spi";
		 status = "okay";
	 };

	usi_1: usi@10421004 {
		       usi_mode = "spi";
		       status = "okay";
	};

	usi_2: usi@10421008 {
		       usi_mode = "hsi2c0";
		       status = "okay";
	};


If USI configuration was done successfully, the booting log will be shown as below.

[    0.700485]  [1:      swapper/0:    1] usi 10421000.usi: usi_probe() mode:4
[    0.702369]  [1:      swapper/0:    1] usi 10421004.usi: usi_probe() mode:4
[    0.704134]  [1:      swapper/0:    1] usi 10421008.usi: usi_probe() mode:1

This means the usi_0 was set as "spi" and usi_1 was set as "spi" and
usi_2 was set as "hsi2c0".

The mode values are as below.

/* USI mode */
#define USI_HSI2C0_SINGLE_MODE          0x1
#define USI_HSI2C1_SINGLE_MODE          0x2
#define USI_HSI2C0_HSI2C1_DUAL_MODE     0x3
#define USI_SPI_SINGLE_MODE             0x4
#define USI_UART_SINGLE_MODE            0x8
#define USI_UART_HSI2C1_DUAL_MODE       0xA
```

## Documentation/devicetree/bindings/soc/samsung/usi_v2.txt
```
* EXYNOS - USI(Universal Serial Interface) version 2 devicetree making guide

The USI can operate as UART, HSI2C and SPI.
So the configuration for one specific function
should be needed with SYSREG(System Registers).

To configure USI port as one specific function,
function string(ex, "spi" or "i2c" or "spi" or "uart")
should be declared in "usi_mode" property in board devicetree file.

Becuase USI configuration can differ from board schematic.

* Required SoC Specific Properties:

 - compatible: should be one of the following.
   - samsung,exynos-usi-v2: for exynos7, exynos8 platforms.

 - reg: physical base address of the SYSREG for specific USI port
	and length of memory mapped region.

* Required Board Specific Properties:
 - usi_v2_mode: function string for one specific IP operation.
             i2c: for HSI2C
             spi: for SPI
             uart: for UART

* Compare to USI version 1, there are few differences.
 - HW I2C has been changed
	I2C hw logic has been developed by usi_v2 including timing parameter logic.
	HSI2C driver must be upgraded from usi_v2.
 - USI structure has been changed.
	One USIv2 chanenl is composed of "USI + HSI2C" hw logic.

* Exsamples:

 - SoC Specific Portion

	/* USI_00 */
	usi_0: usi@10411004 {
		compatible = "samsung,exynos-usi-v2";
		reg = <0x0 0x10411004 0x4>;
		/*	usi_mode_v2 = "i2c" or "spi" or "uart"	*/
		status = "disabled";
	};

	/* USI_00_I2C */
	usi_0_i2c: usi@10411008 {
		compatible = "samsung,exynos-usi-v2";
		reg = <0x0 0x10411008 0x4>;
		/*	usi_mode_v2 = "i2c" */
		status = "disabled";
	};

 - Board Specific Portion

	/* USI_00 */
	usi_0: usi@10411004 {
		usi_v2_mode = "spi";
		status = "okay";
	};

	/* USI_01 */
	usi_1: usi@1041100c {
		usi_v2_mode = "spi";
		status = "okay";
	};

	/* USI_02 */
	usi_2: usi@10411014 {
		usi_v2_mode = "spi";
		status = "okay";
	};

	/* USI_03 */
	usi_3: usi@1041101C {
		usi_v2_mode = "i2c";
		status = "okay";
	};

If USI configuration was done successfully, the booting log will be shown as below.

[    1.817710]  [7:      swapper/0:    1] usi_v2 10411004.usi: usi_v2_probe() mode:2
[    1.820072]  [7:      swapper/0:    1] usi_v2 1041100c.usi: usi_v2_probe() mode:2
[    1.822549]  [7:      swapper/0:    1] usi_v2 10411014.usi: usi_v2_probe() mode:2
[    1.825060]  [7:      swapper/0:    1] usi_v2 1041101c.usi: usi_v2_probe() mode:4

This means the usi_0, usi_1, usi_2 were set as "spi" and usi_3 was set "i2c"

The mode values are as below.

/* USI v2 mode */
#define I2C_SW_CONF		(1<<2)
#define SPI_SW_CONF		(1<<1)
#define UART_SW_CONF		(1<<0)
```

## arch/arm/Kconfig.sec
```kconfig
config SEC_J2ESSLTE_PROJECT
		depends on ARCH_MSM8937
		default n
		bool "Samsung J2ESSLTE Project"
		help
		Support for Samsung J2ESSLTE Project.

config MACH_J2ESSLTE_SWA_INS
		depends on SEC_J2ESSLTE_PROJECT
		default n
		bool "Samsung J2ESSLTE SWA INS"
		help
		Support for Samsung J2ESSLTE SWA INS device.
```

## arch/arm/configs/msm8937_sec_elitelte_chn_defconfig
```kconfig
CONFIG_SEC_MSM8917_PROJECT=y
CONFIG_SEC_ELITELTE_PROJECT=y
CONFIG_MACH_ELITELTE_CHN_OPEN=y

CONFIG_DRV_SAMSUNG=y

#INPUT MODULES
CONFIG_KEYBOARD_STMPE1801=y
CONFIG_TOUCHSCREEN_IST3026C=y

#MUIC
CONFIG_USE_MUIC=y
CONFIG_MUIC_NOTIFIER=y
CONFIG_MUIC_UNIVERSAL=y
CONFIG_MUIC_UNIVERSAL_SM5703=y
CONFIG_MUIC_UART_SWITCH=y
CONFIG_MUIC_SUPPORT_EARJACK=y
# CONFIG_MUIC_UNIVERSAL_SM5705 is not set
# CONFIG_MUIC_UNIVERSAL_SM5705_AFC is not set
CONFIG_MUIC_PINCTRL=y
CONFIG_MUIC_SUPPORT_RUSTPROOF=y
CONFIG_MFD_SM5703=y
CONFIG_MFD_SM5703_USE_DT=y
CONFIG_REGULATOR_SM5703=y

#USB Host
# CONFIG_USB_HOST_NOTIFY is not set

# BATTERY & CHARGER
CONFIG_SAMSUNG_LPM_MODE=y
CONFIG_BATTERY_SAMSUNG=y
CONFIG_PREVENT_SOC_JUMP=y
CONFIG_SW_SELF_DISCHARGING=y
CONFIG_CHARGER_SM5703=y
CONFIG_CHARGER_SM5703_DUALPATH=y
CONFIG_FUELGAUGE_SM5703=y
CONFIG_BATTERY_SWELLING=y
CONFIG_SEC_MPP_SHARE=y

CONFIG_SYSFS=y
CONFIG_INPUT=y
CONFIG_INPUT_MISC=y
CONFIG_INPUT_GPIO=y
CONFIG_INPUT_POLLDEV=y

#SENSORS
CONFIG_SENSORS=y
CONFIG_SENSORS_CORE=y
CONFIG_SENSORS_K2HH=y
CONFIG_SENSORS_STK3013=y

#NFC

#MMC
CONFIG_NO_DETECT_PIN=y
#HALL IC
CONFIG_SENSORS_HALL=y
CONFIG_SENSORS_HALL_FOLDER=y

#CAMERA
CONFIG_IMX135=y
CONFIG_S5K5E3YX=y
CONFIG_MSM_FRONT_EEPROM=y

#AUDIO
# CONFIG_SLIMBUS is not set
# CONFIG_SLIMBUS_MSM_NGD is not set
# CONFIG_SOUNDWIRE is not set

#FLASH
CONFIG_FLASHLIGHT=y
CONFIG_SM_FLASH_LED=y
CONFIG_FLED_SM5703=y

#DISPLAY
CONFIG_PANEL_SC7798D_BV038WVM_WVGA=y

# MOTOR
CONFIG_MSM_VIBRATOR=y

#SVC LEDS
CONFIG_LEDS_KTD2026=y

#Power off Alarm
CONFIG_RTC_AUTO_PWRON=y

# Legacy alarm dev
CONFIG_ANDROID_INTF_ALARM_DEV=y

CONFIG_NR_CPUS=4

# SSWAP
CONFIG_SWAP=y
CONFIG_FRONTSWAP=y
CONFIG_ZSMALLOC=y
CONFIG_ZSMALLOC_STAT=y
CONFIG_ZSMALLOC_OBJ_SEQ=n
CONFIG_PGTABLE_MAPPING=y
CONFIG_ZSWAP=y
CONFIG_ZSWAP_COMPACTION=y
CONFIG_ZSWAP_ENABLE_WRITEBACK=n
CONFIG_ZPOOL=y
CONFIG_DIRECT_RECLAIM_FILE_PAGES_ONLY=y
CONFIG_INCREASE_MAXIMUM_SWAPPINESS=y
CONFIG_FIX_INACTIVE_RATIO=y
CONFIG_TIGHT_PGDAT_BALANCE=y
CONFIG_VNSWAP=y
CONFIG_SWAP_ENABLE_READAHEAD=n

# MMAP READAROUND
CONFIG_MMAP_READAROUND_LIMIT=16

# KNOX SDP and DLP
CONFIG_SDP=y
CONFIG_DLP=y
```

## arch/arm/configs/msm8937_sec_eng_defconfig
```kconfig
# CONFIG_RCU_FAST_NO_HZ is not set
CONFIG_CGROUP_DEBUG=y
CONFIG_OPROFILE=m
CONFIG_KPROBES=y
# CONFIG_PROCESS_RECLAIM is not set
CONFIG_BALANCE_ANON_FILE_RECLAIM=y
CONFIG_DEBUG_GPIO=y
CONFIG_MSMB_CAMERA_DEBUG=y
CONFIG_MSM_DEBUG_LAR_UNLOCK=y
CONFIG_MSM_CORE_HANG_DETECT=y
CONFIG_MSM_DCC=y
CONFIG_MSM_IPC_ROUTER_GLINK_XPRT=y
CONFIG_MSM_GLINK_PKT=y
# CONFIG_ARM_GIC_PANIC_HANDLER is not set
# CONFIG_CORESIGHT_CTI_SAVE_DISABLE is not set
CONFIG_CORESIGHT_TPDA=y
CONFIG_CORESIGHT_TPDM=y
CONFIG_CORESIGHT_DBGUI=y
CONFIG_CORESIGHT_ETMV4=y
CONFIG_CORESIGHT_REMOTE_ETM=y
CONFIG_CORESIGHT_QPDI=y
CONFIG_LOG_BUF_MAGIC=y
CONFIG_DYNAMIC_DEBUG=y
CONFIG_PAGE_OWNER=y
CONFIG_PM_DEBUG=y
CONFIG_DEBUG_PAGEALLOC=y
CONFIG_SLUB_DEBUG_PANIC_ON=y
CONFIG_DEBUG_OBJECTS=y
CONFIG_DEBUG_OBJECTS_FREE=y
CONFIG_DEBUG_OBJECTS_TIMERS=y
CONFIG_DEBUG_OBJECTS_WORK=y
CONFIG_DEBUG_OBJECTS_RCU_HEAD=y
CONFIG_DEBUG_OBJECTS_PERCPU_COUNTER=y
CONFIG_SLUB_DEBUG_ON=y
CONFIG_DEBUG_KMEMLEAK=y
CONFIG_DEBUG_KMEMLEAK_EARLY_LOG_SIZE=4000
CONFIG_DEBUG_KMEMLEAK_DEFAULT_OFF=y
CONFIG_DEBUG_STACK_USAGE=y
CONFIG_DEBUG_VM=y
CONFIG_DEBUG_MEMORY_INIT=y
CONFIG_DEBUG_HIGHMEM=y
CONFIG_DEBUG_SPINLOCK=y
CONFIG_DEBUG_MUTEXES=y
CONFIG_DEBUG_SPINLOCK_PANIC_ON_BUG=y
CONFIG_DEBUG_LOCK_ALLOC=y
CONFIG_DEBUG_ATOMIC_SLEEP=y
CONFIG_DEBUG_LIST=y
CONFIG_SEC_FILE_LEAK_DEBUG=y
CONFIG_FAULT_INJECTION=y
CONFIG_FAIL_PAGE_ALLOC=y
CONFIG_UFS_FAULT_INJECTION=y
CONFIG_FAULT_INJECTION_DEBUG_FS=y
CONFIG_FAULT_INJECTION_STACKTRACE_FILTER=y
CONFIG_BLK_DEV_IO_TRACE=y
CONFIG_PANIC_ON_DATA_CORRUPTION=y
CONFIG_DEBUG_USER=y
CONFIG_FREE_PAGES_RDONLY=y
CONFIG_DEBUG_SET_MODULE_RONX=y
CONFIG_TRUSTONIC_TEE_DEBUG=y

CONFIG_FTRACE=y
CONFIG_IRQSOFF_TRACER=y
CONFIG_PREEMPT_TRACER=y

# CONFIG_SEC_RESTRICT_ROOTING is not set
# CONFIG_SEC_RESTRICT_SETUID is not set
# CONFIG_SEC_RESTRICT_FORK is not set
# CONFIG_SEC_RESTRICT_ROOTING_LOG is not set
#
# Enable SEC_PM Feature
#
CONFIG_SEC_GPIO_DVS=y

# SEC DEBUG features
CONFIG_SEC_DEBUG_FORCE_ERROR=y

# CONFIG_CORESIGHT is not set
CONFIG_CORESIGHT_EVENT=y
CONFIG_CORESIGHT_FUSE=y
CONFIG_CORESIGHT_CTI=y
CONFIG_CORESIGHT_CTI_SAVE_DISABLE=y
CONFIG_CORESIGHT_TMC=y
CONFIG_CORESIGHT_TPIU=y
CONFIG_CORESIGHT_FUNNEL=y
CONFIG_CORESIGHT_REPLICATOR=y
CONFIG_CORESIGHT_STM=y
CONFIG_CORESIGHT_HWEVENT=y
CONFIG_SAMSUNG_BATTERY_ENG_TEST=y


#knox test
CONFIG_KNOX_TEST=y
```

## arch/arm/configs/msm8937_sec_gta2slte_chn_open_defconfig
```kconfig
CONFIG_SEC_MSM8917_PROJECT=y
CONFIG_SEC_GTA2SLTE_PROJECT=y
CONFIG_MACH_GTA2SLTE_CHN_OPEN=y

CONFIG_DRV_SAMSUNG=y

CONFIG_3G_DDR_SUPPORT=y

#INPUT MODULES
CONFIG_TOUCHSCREEN_FTS8=y
# CONFIG_TOUCHSCREEN_DUMP_MODE is not set

#CCIC
CONFIG_CCIC_NOTIFIER=y
CONFIG_CCIC_S2MM005=y
CONFIG_CCIC_ALTERNATE_MODE=y
CONFIG_MUIC_SUPPORT_CCIC=y
CONFIG_USB_TYPEC_MANAGER_NOTIFIER=y
CONFIG_CCIC_LPM_ENABLE=y

#MUIC
CONFIG_USE_MUIC=y
CONFIG_MUIC_NOTIFIER=y
CONFIG_MUIC_UNIVERSAL=y
CONFIG_MUIC_UNIVERSAL_SM5703=y
CONFIG_MUIC_UART_SWITCH=y
# CONFIG_MUIC_SUPPORT_EARJACK is not set
# CONFIG_MUIC_UNIVERSAL_SM5705 is not set
# CONFIG_MUIC_UNIVERSAL_SM5705_AFC is not set
CONFIG_MUIC_PINCTRL=y
CONFIG_MUIC_SUPPORT_RUSTPROOF=y
CONFIG_MFD_SM5703=y
CONFIG_MUIC_SM570X_SWITCH_CONTROL_GPIO=y
CONFIG_MUIC_SLAVE_MODE_CONTROL_VBUS=y

#USB Host
CONFIG_USB_HOST_NOTIFY=y
CONFIG_VBUS_NOTIFIER=y

# BATTERY & CHARGER
CONFIG_SAMSUNG_LPM_MODE=y
CONFIG_BATTERY_SAMSUNG_V2=y
CONFIG_BATTERY_SAMSUNG=y
CONFIG_BATTERY_NOTIFIER=y
CONFIG_PREVENT_SOC_JUMP=y
CONFIG_CHARGER_SM5703=y
CONFIG_FUELGAUGE_SM5703=y
CONFIG_BATTERY_SWELLING=y
CONFIG_SEC_MPP_SHARE=y
# CONFIG_DISABLE_SAFETY_TIMER is not set
CONFIG_INBATVOLT_FG=y
CONFIG_CHARGER_SM5703_DUALPATH=y
CONFIG_AFC_CHARGER_MODE=y
CONFIG_STEP_CHARGING=y
CONFIG_TABLET_MODEL_CONCEPT=y
CONFIG_BATTERY_CISD=y
CONFIG_BATTERY_AGE_FORECAST=y

CONFIG_SYSFS=y
CONFIG_INPUT=y
CONFIG_INPUT_MISC=y
CONFIG_INPUT_GPIO=y
CONFIG_INPUT_POLLDEV=y

#SENSORS
CONFIG_SENSORS=y
CONFIG_SENSORS_CORE=y
CONFIG_SENSORS_K2HH=y
CONFIG_SENSORS_SX9306=y
CONFIG_SENSORS_SX9306_SUB=y
CONFIG_SENSORS_SX9306_WIFI=y
CONFIG_SENSORS_GRIP_CHK_HALLIC=y
#NFC

#HALL IC
CONFIG_SENSORS_HALL=y

#CAMERA
CONFIG_S5K5E3YX=y
CONFIG_ACTIVE_FLASH=y
CONFIG_USE_CAMERA_HW_BIG_DATA=y

#EEPROM
CONFIG_GET_REAR_MODULE_ID=y

#AUDIO
CONFIG_SAMSUNG_JACK=y
CONFIG_SND_EXT_MIC_BIAS=y
# CONFIG_SLIMBUS is not set
# CONFIG_SLIMBUS_MSM_NGD is not set
# CONFIG_SOUNDWIRE is not set

#FLASH
CONFIG_FLASHLIGHT=y
CONFIG_SM_FLASH_LED=y
CONFIG_FLED_SM5703=y

#SD
CONFIG_SEC_HYBRID_TRAY=y

#DISPLAY
CONFIG_PANEL_S6D7AA0X11_TV080WXM_WXGA=y
CONFIG_SAMSUNG_12_8MHZ_ESC_CLOCK=y

# MOTOR
CONFIG_MSM_VIBRATOR=y
CONFIG_REGULATOR_SM5703=y
CONFIG_SM5703_VIBRATOR=y

#SVC LEDS
CONFIG_LEDS_KTD2026=y

#Power off Alarm
CONFIG_RTC_AUTO_PWRON=y

# Legacy alarm dev
# CONFIG_ANDROID_INTF_ALARM_DEV is not set

CONFIG_NR_CPUS=4

# KNOX SDP and DLP
CONFIG_SDP=y
CONFIG_DLP=y

# HQM
CONFIG_SEC_DEBUG_APPS_CLK_LOGGING=y
CONFIG_SEC_AP_HEALTH=y

# SSWAP
CONFIG_SWAP=y
CONFIG_FRONTSWAP=y
CONFIG_ZSMALLOC=y
CONFIG_ZSMALLOC_STAT=y
CONFIG_ZSMALLOC_OBJ_SEQ=n
CONFIG_PGTABLE_MAPPING=y
CONFIG_ZSWAP=y
CONFIG_ZSWAP_COMPACTION=y
CONFIG_ZSWAP_ENABLE_WRITEBACK=n
CONFIG_ZSWAP_SAME_PAGE_SHARING=n
CONFIG_ZPOOL=y
CONFIG_DIRECT_RECLAIM_FILE_PAGES_ONLY=y
CONFIG_INCREASE_MAXIMUM_SWAPPINESS=y
CONFIG_FIX_INACTIVE_RATIO=y
CONFIG_TIGHT_PGDAT_BALANCE=y
CONFIG_VNSWAP=y
CONFIG_SWAP_ENABLE_READAHEAD=n

# MMAP READAROUND
CONFIG_MMAP_READAROUND_LIMIT=16
```

## arch/arm/configs/msm8937_sec_j3llte_usa_spr_defconfig
```kconfig
CONFIG_SEC_MSM8917_PROJECT=y
CONFIG_SEC_J3LLTE_PROJECT=y
CONFIG_MACH_J3LLTE_USA_SPR=y

CONFIG_DRV_SAMSUNG=y

#INPUT MODULES
CONFIG_KEYBOARD_ABOV_TOUCH=y
CONFIG_KEYBOARD_MELFAS_MHS204=y
CONFIG_KEYBOARD_STMPE1801=y
CONFIG_TOUCHSCREEN_IST3026C=y

#MUIC
CONFIG_USE_MUIC=y
CONFIG_MUIC_NOTIFIER=y
CONFIG_MUIC_UNIVERSAL=y
CONFIG_MUIC_UNIVERSAL_SM5703=y
CONFIG_MUIC_UART_SWITCH=y
CONFIG_MUIC_SUPPORT_EARJACK=y
# CONFIG_MUIC_UNIVERSAL_SM5705 is not set
# CONFIG_MUIC_UNIVERSAL_SM5705_AFC is not set
CONFIG_MUIC_PINCTRL=y
# CONFIG_MUIC_SUPPORT_RUSTPROOF is not set
CONFIG_MFD_SM5703=y

#USB Host
CONFIG_USB_HOST_NOTIFY=y

# BATTERY & CHARGER
CONFIG_SAMSUNG_LPM_MODE=y
CONFIG_BATTERY_SAMSUNG=y
CONFIG_PREVENT_SOC_JUMP=y
CONFIG_SW_SELF_DISCHARGING=y
CONFIG_CHARGER_SM5703=y
CONFIG_FUELGAUGE_SM5703=y
CONFIG_BATTERY_SWELLING=y
CONFIG_SEC_MPP_SHARE=y

CONFIG_SYSFS=y
CONFIG_INPUT=y
CONFIG_INPUT_MISC=y
CONFIG_INPUT_GPIO=y
CONFIG_INPUT_POLLDEV=y

#SENSORS
CONFIG_SENSORS=y
CONFIG_SENSORS_CORE=y
CONFIG_SENSORS_K2HH=y
CONFIG_SENSORS_STK3013=y

#NFC

#HALL IC
CONFIG_SENSORS_HALL=y

#CAMERA
CONFIG_IMX135=y
CONFIG_S5K5E3YX=y

#AUDIO
# CONFIG_SLIMBUS is not set
# CONFIG_SLIMBUS_MSM_NGD is not set
# CONFIG_SOUNDWIRE is not set

#FLASH
CONFIG_FLASHLIGHT=y
CONFIG_SM_FLASH_LED=y
CONFIG_FLED_SM5703=y

#DISPLAY
CONFIG_PANEL_SC7798D_BV038WVM_WVGA=y

# MOTOR
CONFIG_MSM_VIBRATOR=y

#SVC LEDS
CONFIG_LEDS_KTD2026=y

#Power off Alarm
# CONFIG_RTC_AUTO_PWRON is not set

# Legacy alarm dev
# CONFIG_ANDROID_INTF_ALARM_DEV is not set

CONFIG_NR_CPUS=4
```
