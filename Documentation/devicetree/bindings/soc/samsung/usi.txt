## arch/arm64/configs/exynos8890-base_defconfig
```kconfig
# CONFIG_SWAP is not set
CONFIG_SYSVIPC=y
CONFIG_NO_HZ=y
CONFIG_HIGH_RES_TIMERS=y
CONFIG_CPUSETS=y
CONFIG_CGROUPS=y
CONFIG_CGROUP_DEBUG=y
CONFIG_CGROUP_FREEZER=y
CONFIG_CGROUP_CPUACCT=y
CONFIG_RESOURCE_COUNTERS=y
CONFIG_CGROUP_SCHED=y
CONFIG_FAIR_GROUP_SCHED=y
CONFIG_GROUP_SCHED=y
CONFIG_CFS_BANDWIDTH=y
CONFIG_RT_GROUP_SCHED=y
CONFIG_NAMESPACES=y
CONFIG_BLK_DEV_INITRD=y
CONFIG_CC_OPTIMIZE_FOR_SIZE=y
CONFIG_EMBEDDED=y
# CONFIG_COMPAT_BRK is not set
CONFIG_PROFILING=y
# CONFIG_MODULES is not set
# CONFIG_MODVERSIONS is not set
# CONFIG_BLK_DEV_BSG is not set
CONFIG_PARTITION_ADVANCED=y
# CONFIG_IOSCHED_DEADLINE is not set
CONFIG_SOC_EXYNOS8890=y
CONFIG_SOC_EXYNOS8890_EVT1=y
CONFIG_ARCH_EXYNOS8=y
CONFIG_NETDEVICES=y
CONFIG_BROADCOM_WIFI=y
CONFIG_NL80211_TESTMODE=y
CONFIG_BCMDHD_FW_PATH="/system/etc/wifi/bcmdhd_sta.bin"
CONFIG_BCMDHD_NVRAM_PATH="/system/etc/wifi/nvram_net.txt"
CONFIG_SPLIT_ARGOS_SET=y
CONFIG_WIRELESS=y
CONFIG_WIRELESS_EXT_SYSFS=y
CONFIG_WEXT_CORE=y
CONFIG_WEXT_PROC=y
CONFIG_CFG80211=y
CONFIG_CFG80211_DEFAULT_PS=y
CONFIG_CFG80211_ALLOW_RECONNECT=y
CONFIG_WLAN=y
CONFIG_WIFI_CONTROL_FUNC=y
CONFIG_BROADCOM_WIFI_RESERVED_MEM=y
CONFIG_CFG80211_REG_NOT_UPDATED=y
CONFIG_WIFI_MULTICAST_LOG=y
CONFIG_BCMDHD_PCIE=y
CONFIG_BCMDHD_PREALLOC_MEMDUMP=y
CONFIG_BCMDHD_PREALLOC_PKTIDMAP=y
CONFIG_PCI=y
CONFIG_PCI_MSI=y
CONFIG_PCI_EXYNOS=y
CONFIG_SMP=y
CONFIG_SCHED_MC=y
CONFIG_DISABLE_CPU_SCHED_DOMAIN_BALANCE=y
CONFIG_SCHED_HMP=y
CONFIG_HMP_FAST_CPU_MASK="4-7"
CONFIG_HMP_SLOW_CPU_MASK="0-3"
CONFIG_HMP_VARIABLE_SCALE=y
CONFIG_SCHED_HMP_DOWN_MIGRATION_COMPENSATION=y
CONFIG_NR_CPUS=8
CONFIG_PREEMPT=y
CONFIG_KSM=y
CONFIG_FRONTSWAP=y
CONFIG_CMA_PINPAGE_MIGRATION=y
CONFIG_ESWAP=y
CONFIG_ZSMALLOC=y
CONFIG_ARMV8_DEPRECATED=y
CONFIG_SWP_EMULATION=y
CONFIG_CP15_BARRIER_EMULATION=y
CONFIG_SETEND_EMULATION=y
CONFIG_SECCOMP=y
CONFIG_SEC_BSP=y
CONFIG_SEC_NAD=y
CONFIG_SEC_INITCALL_DEBUG=y
# CONFIG_EFI is not set
# CONFIG_CORE_DUMP_DEFAULT_ELF_HEADERS is not set
CONFIG_COMPAT=y
CONFIG_PM_AUTOSLEEP=y
CONFIG_PM_WAKELOCKS=y
CONFIG_PM_WAKELOCKS_LIMIT=0
# CONFIG_PM_WAKELOCKS_GC is not set
CONFIG_PM_RUNTIME=y
CONFIG_PM_DEBUG=y
CONFIG_SUSPEND_TIME=y
CONFIG_FOTA_LIMIT=y
CONFIG_CPU_IDLE=y
CONFIG_CPU_IDLE_STOP_IDLE_DURING_HOTPLUG=y
CONFIG_ARM64_EXYNOS_CPUIDLE=y
CONFIG_CPU_FREQ=y
CONFIG_CPU_FREQ_DEFAULT_GOV_INTERACTIVE=y
CONFIG_CPU_FREQ_GOV_PERFORMANCE=y
CONFIG_CPU_FREQ_GOV_USERSPACE=y
CONFIG_CPUFREQ_DT=y
CONFIG_ARM_EXYNOS_MP_CPUFREQ=y
CONFIG_EXYNOS_PM_DVS=y
CONFIG_EXYNOS_HOTPLUG_GOVERNOR=y
CONFIG_EXYNOS_BIG_FREQ_BOOST=y
CONFIG_NET=y
CONFIG_USB_USBNET=y
CONFIG_USB_NET_SMSC75XX=y
CONFIG_USB_NET_SMSC95XX=y
CONFIG_USB_ACM=y
CONFIG_USB_RTL8152=y
CONFIG_USB_RTL8150=y
CONFIG_USB_NET_CDC_EEM=y
CONFIG_USB_NET_CDC_MBIM=y
CONFIG_PACKET=y
CONFIG_UNIX=y
CONFIG_NET_KEY=y
CONFIG_INET=y
CONFIG_IP_MULTICAST=y
CONFIG_IP_ADVANCED_ROUTER=y
CONFIG_IP_MULTIPLE_TABLES=y
CONFIG_IP_PNP=y
CONFIG_IP_PNP_DHCP=y
CONFIG_IP_PNP_BOOTP=y
CONFIG_IP_PNP_RARP=y
CONFIG_INET_AH=y
CONFIG_INET_ESP=y
CONFIG_INET_IPCOMP=y
CONFIG_INET_XFRM_TUNNEL=y
CONFIG_INET_XFRM_MODE_TRANSPORT=y
CONFIG_INET_XFRM_MODE_TUNNEL=y
CONFIG_INET_XFRM_MODE_BEET=y
# CONFIG_INET_LRO is not set
CONFIG_INET_DIAG=y
CONFIG_INET_DIAG_DESTROY=y
CONFIG_TCP_CONG_ADVANCED=y
CONFIG_TCP_CONG_BIC=y
CONFIG_DEFAULT_BIC=y
CONFIG_DEFAULT_TCP_CONG="bic"
CONFIG_PPP=y
CONFIG_PPP_DEFLATE=y
CONFIG_PPP_BSDCOMP=y
CONFIG_PPP_MPPE=y
CONFIG_PPPOLAC=y
CONFIG_PPPOPNS=y
CONFIG_TUN=y
CONFIG_IPV6=y
CONFIG_IPV6_ROUTER_PREF=y
CONFIG_IPV6_ROUTE_INFO=y
CONFIG_IPV6_OPTIMISTIC_DAD=y
CONFIG_INET6_AH=y
CONFIG_INET6_ESP=y
CONFIG_INET6_IPCOMP=y
CONFIG_INET6_XFRM_MODE_BEET=y
CONFIG_INET6_XFRM_MODE_TRANSPORT=y
CONFIG_INET6_XFRM_MODE_TUNNEL=y
CONFIG_IPV6_MIP6=y
CONFIG_IPV6_TUNNEL=y
CONFIG_IPV6_MULTIPLE_TABLES=y
CONFIG_NETWORK_SECMARK=y
CONFIG_NETFILTER=y
CONFIG_NETFILTER_XTABLES=y
CONFIG_NF_CONNTRACK=y
CONFIG_NF_CONNTRACK_SECMARK=y
CONFIG_NF_CONNTRACK_EVENTS=y
CONFIG_NF_CT_PROTO_DCCP=y
CONFIG_NF_CT_PROTO_SCTP=y
CONFIG_NF_CT_PROTO_UDPLITE=y
CONFIG_NF_CONNTRACK_AMANDA=y
CONFIG_NF_CONNTRACK_FTP=y
CONFIG_NF_CONNTRACK_H323=y
CONFIG_NF_CONNTRACK_IRC=y
CONFIG_NF_CONNTRACK_NETBIOS_NS=y
CONFIG_NF_CONNTRACK_PPTP=y
CONFIG_NF_CONNTRACK_SANE=y
CONFIG_NF_CONNTRACK_TFTP=y
CONFIG_NF_CT_NETLINK=y
CONFIG_NETFILTER_XT_TARGET_CLASSIFY=y
CONFIG_NETFILTER_XT_TARGET_CONNMARK=y
CONFIG_NETFILTER_XT_TARGET_CONNSECMARK=y
CONFIG_NETFILTER_XT_TARGET_IDLETIMER=y
CONFIG_NETFILTER_XT_TARGET_LOG=y
CONFIG_NETFILTER_XT_TARGET_MARK=y
CONFIG_NETFILTER_XT_TARGET_NETMAP=y
CONFIG_NETFILTER_XT_TARGET_NFLOG=y
CONFIG_NETFILTER_XT_TARGET_NFQUEUE=y
CONFIG_NETFILTER_XT_TARGET_REDIRECT=y
CONFIG_NETFILTER_XT_TARGET_SECMARK=y
CONFIG_NETFILTER_XT_TARGET_TCPMSS=y
CONFIG_NETFILTER_XT_MATCH_COMMENT=y
CONFIG_NETFILTER_XT_MATCH_CONNBYTES=y
CONFIG_NETFILTER_XT_MATCH_CONNLABEL=y
CONFIG_NETFILTER_XT_MATCH_CONNLIMIT=y
CONFIG_NETFILTER_XT_MATCH_CONNMARK=y
CONFIG_NETFILTER_XT_MATCH_CONNTRACK=y
CONFIG_NETFILTER_XT_MATCH_HASHLIMIT=y
CONFIG_NETFILTER_XT_MATCH_HELPER=y
CONFIG_NETFILTER_XT_MATCH_IPRANGE=y
CONFIG_NETFILTER_XT_MATCH_LENGTH=y
CONFIG_NETFILTER_XT_MATCH_LIMIT=y
CONFIG_NETFILTER_XT_MATCH_MAC=y
CONFIG_NETFILTER_XT_MATCH_MARK=y
CONFIG_NETFILTER_XT_MATCH_POLICY=y
CONFIG_NETFILTER_XT_MATCH_PKTTYPE=y
CONFIG_NETFILTER_XT_MATCH_QTAGUID=y
CONFIG_NETFILTER_XT_MATCH_QUOTA=y
CONFIG_NETFILTER_XT_MATCH_QUOTA2=y
CONFIG_NETFILTER_XT_MATCH_QUOTA2_LOG=y
CONFIG_NETFILTER_XT_MATCH_SCTP=y
CONFIG_NETFILTER_XT_MATCH_STATE=y
CONFIG_NETFILTER_XT_MATCH_STATISTIC=y
CONFIG_NETFILTER_XT_MATCH_STRING=y
CONFIG_NETFILTER_XT_MATCH_TIME=y
CONFIG_NETFILTER_XT_MATCH_U32=y
CONFIG_XFRM_USER=y
CONFIG_NETFILTER_XT_TARGET_TPROXY=y
CONFIG_NETFILTER_XT_TARGET_TRACE=y
CONFIG_NETFILTER_XT_MATCH_SOCKET=y
CONFIG_ANDROID_INTF_ALARM_DEV=y
CONFIG_NF_CONNTRACK_IPV4=y
CONFIG_NF_NAT_IPV4=y
CONFIG_IP_NF_IPTABLES=y
CONFIG_IP_NF_MATCH_AH=y
CONFIG_IP_NF_MATCH_ECN=y
CONFIG_IP_NF_MATCH_TTL=y
CONFIG_IP_NF_FILTER=y
CONFIG_IP_NF_TARGET_REJECT=y
CONFIG_IP_NF_NAT=y
CONFIG_IP_NF_TARGET_MASQUERADE=y
CONFIG_IP_NF_TARGET_NETMAP=y
CONFIG_IP_NF_TARGET_REDIRECT=y
CONFIG_IP_NF_MANGLE=y
CONFIG_IP_NF_RAW=y
CONFIG_IP_NF_ARPTABLES=y
CONFIG_IP_NF_ARPFILTER=y
CONFIG_IP_NF_ARP_MANGLE=y
CONFIG_NF_CONNTRACK_IPV6=y
CONFIG_IP6_NF_IPTABLES=y
CONFIG_IP6_NF_FILTER=y
CONFIG_IP6_NF_TARGET_REJECT=y
CONFIG_IP6_NF_MANGLE=y
CONFIG_IP6_NF_RAW=y
CONFIG_IP6_NF_NAT=y
CONFIG_IP6_NF_TARGET_MASQUERADE=y
CONFIG_PHONET=y
CONFIG_NET_SCHED=y
CONFIG_NET_SCH_HTB=y
CONFIG_NET_SCH_INGRESS=y
CONFIG_NET_CLS_U32=y
CONFIG_NET_EMATCH=y
CONFIG_NET_EMATCH_U32=y
CONFIG_NET_CLS_ACT=y
CONFIG_NET_ACT_POLICE=y
CONFIG_NET_ACT_GACT=y
CONFIG_NET_ACT_MIRRED=y
CONFIG_UEVENT_HELPER_PATH="/sbin/hotplug"
CONFIG_DEVTMPFS=y
CONFIG_FW_LOADER_USER_HELPER_FALLBACK=y
CONFIG_ZRAM=y
CONFIG_CMA_SIZE_MBYTES=24
CONFIG_BLK_DEV_LOOP=y
CONFIG_BLK_DEV_RAM=y
CONFIG_BLK_DEV_RAM_SIZE=8192
CONFIG_UID_STAT=y
CONFIG_UID_CPUTIME=y
CONFIG_MCU_IPC=y
CONFIG_MCU_IPC_LOG=y
CONFIG_SHM_IPC=y
CONFIG_SEC_SIPC_MODEM_IF=y
CONFIG_ONESHOT_UID=y
CONFIG_USE_MUIC=y
CONFIG_USE_SAFEOUT=y
CONFIG_MUIC_NOTIFIER=y
CONFIG_MUIC_UNIVERSAL=y
CONFIG_MUIC_UNIVERSAL_MAX77854=y
CONFIG_VBUS_NOTIFIER=y
# CONFIG_MUIC_ADCMODE_SWITCH_WA is not set
# CONFIG_MUIC_RUSTPROOF_ON_USER is not set
# CONFIG_MUIC_MAX77854 is not set
# CONFIG_HV_MUIC_MAX77854_AFC is not set
# CONFIG_MUIC_MAX77854_IGNORE_ADCERR_WA is not set
CONFIG_SCSI=y
CONFIG_UFS_FMP_DM_CRYPT=y
CONFIG_UFS_FMP_ECRYPT_FS=y
CONFIG_SRPMB=y
CONFIG_BLK_DEV_SD=y
CONFIG_SCSI_MULTI_LUN=y
CONFIG_SCSI_UFSHCD=y
CONFIG_UFS_DYNAMIC_H8=y
CONFIG_UFS_UN_18DIGITS=y
CONFIG_SCSI_SKIP_CPU_SYNC=y
CONFIG_SCSI_UFSHCD_PLATFORM=y
CONFIG_SCSI_UFS_EXYNOS=y
CONFIG_JOURNAL_DATA_TAG=y
CONFIG_MD=y
CONFIG_BLK_DEV_DM=y
CONFIG_DM_CRYPT=y
CONFIG_INPUT_EVDEV=y
CONFIG_INPUT_KEYRESET=y
CONFIG_KEYBOARD_GPIO=y
CONFIG_KEYBOARD_SAMSUNG=y
# CONFIG_INPUT_MOUSE is not set
CONFIG_INPUT_JOYSTICK=y
CONFIG_INPUT_TABLET=y
CONFIG_INPUT_TOUCHSCREEN=y
CONFIG_TOUCHSCREEN_FTS7=y
CONFIG_TOUCHSCREEN_SEC_TS=y
CONFIG_KEYBOARD_ABOV_FT16XX_TOUCH=y
CONFIG_SEC_DEBUG_TSP_LOG=y
CONFIG_INPUT_MISC=y
CONFIG_INPUT_KEYCHORD=y
CONFIG_INPUT_UINPUT=y
CONFIG_INPUT_GPIO=y
CONFIG_HALL=y
CONFIG_CERTIFY_HALL=y
# CONFIG_SERIO_SERPORT is not set
# CONFIG_VT is not set
# CONFIG_LEGACY_PTYS is not set
# CONFIG_DEVMEM is not set
# CONFIG_DEVKMEM is not set
CONFIG_SERIAL_SAMSUNG=y
CONFIG_SERIAL_SAMSUNG_CONSOLE=y
CONFIG_S3C_LOWLEVEL_UART_PORT=4
CONFIG_HW_RANDOM=y
# CONFIG_HW_RANDOM_EXYNOS is not set
CONFIG_EXYRNG_FIPS_COMPLIANCE=y
CONFIG_EXYRNG_FAIL_POLICY_RESET=y
CONFIG_EXYRNG_USE_CRYPTOMANAGER=y
CONFIG_I2C_CHARDEV=y
CONFIG_I2C_GPIO=y
CONFIG_SPI=y
CONFIG_PINCTRL_EXYNOS=y
CONFIG_GPIOLIB=y
# CONFIG_SEC_GPIO_DVS is not set
CONFIG_SENSORS_SEC_THERMISTOR=y
CONFIG_HWMON=y
CONFIG_THERMAL=y
CONFIG_CPU_THERMAL=y
CONFIG_GPU_THERMAL=y
CONFIG_ISP_THERMAL=y
CONFIG_THERMAL_EMULATION=y
CONFIG_EXYNOS_THERMAL=y
CONFIG_EXYNOS_SWTRIP=y
CONFIG_CPU_THERMAL_IPA=y
CONFIG_CPU_THERMAL_IPA_CONTROL=y
CONFIG_EXYNOS_THERMAL_CORE=y
CONFIG_WATCHDOG=y
CONFIG_S3C2410_WATCHDOG=y
CONFIG_MFD_MAX77854=y
CONFIG_MFD_SEC_CORE=y
CONFIG_MFD_S2MPB02=y
CONFIG_REGULATOR_FIXED_VOLTAGE=y
CONFIG_REGULATOR_MAX77838=y
CONFIG_REGULATOR_MAX77854=y
CONFIG_REGULATOR_S2MPS16=y
CONFIG_REGULATOR_S2MPB02=y
CONFIG_MEDIA_SUPPORT=y
CONFIG_MEDIA_CAMERA_SUPPORT=y
CONFIG_V4L_PLATFORM_DRIVERS=y
CONFIG_VIDEO_EXYNOS_SCALER=y
CONFIG_VIDEO_EXYNOS_MFC=y
CONFIG_VIDEO_EXYNOS_FIMG2D_V5=y
CONFIG_VIDEO_EXYNOS_FIMG2D_1SHOT2=y
CONFIG_VIDEO_EXYNOS_SMFC=y
CONFIG_VIDEO_EXYNOS_FIMC_IS2=y
CONFIG_EXYNOS_DEVICE_MIPI_CSIS_VER2=y
CONFIG_CSIS_V4_1=y
CONFIG_CAMERA_SENSOR_2L1_OBJ=y
CONFIG_CAMERA_SENSOR_IMX260_OBJ=y
CONFIG_CAMERA_SENSOR_4E6_OBJ=y
CONFIG_CAMERA_SENSOR_4E6_C2_OBJ=y
CONFIG_FIMC_BNS_V4_20_0=y
CONFIG_FIMC_IS_V4_3_0=y
CONFIG_VENDER_MCD=y
CONFIG_OIS_USE=y
CONFIG_OIS_USE_RUMBA_S4=y
CONFIG_AF_HOST_CONTROL=y
CONFIG_COMPANION_USE=y
CONFIG_COMPANION_C3_USE=y
CONFIG_PREPROCESSOR_STANDBY_USE=y
CONFIG_SENSOR_RETENTION_USE=y
CONFIG_COMPANION_DCDC_USE=y
CONFIG_CAMERA_EEPROM_SUPPORT_FRONT=y
CONFIG_COMPANION_FACTORY_VALIDATION=y
CONFIG_MALI_DVFS=y
CONFIG_MALI_ENABLE_TRACE=y
CONFIG_MALI_EXYNOS_TRACE=y
CONFIG_MALI_DEBUG_SYS=y
CONFIG_MALI_EXPERT=y
CONFIG_MALI_PLATFORM_THIRDPARTY_NAME="8890"
CONFIG_MALI_MIDGARD_ENABLE_TRACE=y
CONFIG_FB=y
CONFIG_FB_SIMPLE=y
CONFIG_EXYNOS_VIDEO=y
CONFIG_EXYNOS_DECON_8890=y
CONFIG_DECON_LPD_DISPLAY=y
CONFIG_FB_WINDOW_UPDATE=y
CONFIG_EXYNOS_DECON_LCD=y
CONFIG_EXYNOS_DECON_LCD_S6E3HF4=y
CONFIG_BACKLIGHT_LCD_SUPPORT=y
CONFIG_LCD_CLASS_DEVICE=y
CONFIG_BACKLIGHT_CLASS_DEVICE=y
# CONFIG_BACKLIGHT_GENERIC is not set
CONFIG_SOUND=y
CONFIG_SND=y
CONFIG_SND_USB=y
CONFIG_SND_USB_AUDIO=y
CONFIG_USB_AUDIO=y
CONFIG_SND_USB_MIDI=y
CONFIG_SND_SOC=y
CONFIG_SND_SOC_SAMSUNG=y
CONFIG_SND_SOC_SAMSUNG_ZERO_CLEARWATER=y
CONFIG_SND_SOC_SAMSUNG_LUCKY_MOON=y
CONFIG_SND_SOC_MAX98505=y
CONFIG_SND_SOC_MAX98506=y
CONFIG_SND_SAMSUNG_SEIREN=y
CONFIG_SND_SAMSUNG_SEIREN_OFFLOAD=y
CONFIG_HIDRAW=y
CONFIG_HID_OVR=y
CONFIG_UHID=y
CONFIG_HID_A4TECH=y
CONFIG_HID_ACRUX=y
CONFIG_HID_ACRUX_FF=y
CONFIG_HID_APPLE=y
CONFIG_HID_BELKIN=y
CONFIG_HID_CHERRY=y
CONFIG_HID_CHICONY=y
CONFIG_HID_CYPRESS=y
CONFIG_HID_DRAGONRISE=y
CONFIG_DRAGONRISE_FF=y
CONFIG_HID_EMS_FF=y
CONFIG_HID_ELECOM=y
CONFIG_HID_EZKEY=y
CONFIG_HID_KEYTOUCH=y
CONFIG_HID_KYE=y
CONFIG_HID_UCLOGIC=y
CONFIG_HID_WALTOP=y
CONFIG_HID_GYRATION=y
CONFIG_HID_TWINHAN=y
CONFIG_HID_KENSINGTON=y
CONFIG_HID_LCPOWER=y
CONFIG_HID_LOGITECH=y
CONFIG_HID_LOGITECH_DJ=y
CONFIG_LOGITECH_FF=y
CONFIG_LOGIRUMBLEPAD2_FF=y
CONFIG_LOGIG940_FF=y
CONFIG_SONY_FF=y
CONFIG_HID_MAGICMOUSE=y
CONFIG_HID_MICROSOFT=y
CONFIG_HID_MONTEREY=y
CONFIG_HID_MULTITOUCH=y
CONFIG_HID_MADCATZ=y
CONFIG_HID_ORTEK=y
CONFIG_HID_PANTHERLORD=y
CONFIG_PANTHERLORD_FF=y
CONFIG_HID_PETALYNX=y
CONFIG_HID_PICOLCD=y
CONFIG_HID_PRIMAX=y
CONFIG_HID_SAITEK=y
CONFIG_HID_SAMSUNG=y
CONFIG_HID_SYNAPTICS_BT=y
CONFIG_HID_SPEEDLINK=y
CONFIG_HID_SUNPLUS=y
CONFIG_HID_GREENASIA=y
CONFIG_GREENASIA_FF=y
CONFIG_HID_SMARTJOYPLUS=y
CONFIG_SMARTJOYPLUS_FF=y
CONFIG_HID_TIVO=y
CONFIG_HID_TOPSEED=y
CONFIG_HID_THRUSTMASTER=y
CONFIG_HID_WACOM=y
CONFIG_HID_WIIMOTE=y
CONFIG_HID_ZEROPLUS=y
CONFIG_HID_ZYDACRON=y
CONFIG_HID_HOLTEK=y
CONFIG_HID_NTRIG=y
CONFIG_HID_PRODIKEYS=y
CONFIG_HID_ROCCAT=y
CONFIG_HID_SONY=y
CONFIG_TABLET_USB_ACECAD=y
CONFIG_TABLET_USB_AIPTEK=y
CONFIG_TABLET_USB_GTCO=y
CONFIG_TABLET_USB_HANWANG=y
CONFIG_TABLET_USB_KBTAB=y
CONFIG_TABLET_USB_WACOM=y
CONFIG_JOYSTICK_XPAD=y
CONFIG_JOYSTICK_XPAD_FF=y
CONFIG_JOYSTICK_XPAD_LEDS=y
CONFIG_USB=y
CONFIG_USB_DEBUG=y
CONFIG_USB_DEBUG_DETAILED_LOG=y
CONFIG_USB_HMT_SAMSUNG_INPUT=y
CONFIG_USB_HIDDEV=y
CONFIG_USB_XHCI_HCD=y
CONFIG_USB_PRINTER=y
CONFIG_USB_STORAGE=y
CONFIG_USB_STORAGE_DETECT=y
CONFIG_USB_PRINTER=y
CONFIG_USB_ANNOUNCE_NEW_DEVICES=y
CONFIG_USB_HOST_NOTIFY=y
CONFIG_USB_NOTIFY_LAYER=y
CONFIG_USB_NOTIFY_PROC_LOG=y
CONFIG_USB_NOTIFIER=y
CONFIG_USB_EXTERNAL_NOTIFY=y
CONFIG_USB_DWC3=y
CONFIG_USB_SERIAL=y
CONFIG_USB_SERIAL_FTDI_SIO=y
CONFIG_USB_SERIAL_PL2303=y
CONFIG_USB_GADGET=y
CONFIG_USB_G_ANDROID=y
CONFIG_USB_ANDROID_SAMSUNG_COMPOSITE=y
CONFIG_USB_ANDROID_SAMSUNG_MTP=y
CONFIG_USB_DUN_SUPPORT=y
CONFIG_USBIRQ_BALANCING_LTE_HIGHTP=y
CONFIG_USB_NCM_SUPPORT_MTU_CHANGE=y
CONFIG_USB_RNDIS_MULTIPACKET=y
# CONFIG_USB_LOCK_SUPPORT_FOR_MDM is not set
CONFIG_NEW_LEDS=y
CONFIG_LEDS_CLASS=y
CONFIG_LEDS_S2MPB02=y
CONFIG_MMC=y
CONFIG_MMC_CLKGATE=y
CONFIG_MMC_DW=y
CONFIG_MMC_DW_IDMAC=y
CONFIG_MMC_DW_64BIT_DESC=y
CONFIG_MMC_DW_EXYNOS=y
CONFIG_MMC_DW_DEBUG=y
CONFIG_MMC_DW_FORCE_32BIT_SFR_RW=y
CONFIG_MMC_BLOCK_DEFERRED_RESUME=y
CONFIG_RTC_CLASS=y
CONFIG_EXYNOS_PERSISTENT_CLOCK=y
CONFIG_RTC_DRV_SEC=y
CONFIG_STAGING=y
CONFIG_ANDROID=y
CONFIG_ANDROID_BINDER_IPC=y
CONFIG_ASHMEM=y
CONFIG_ANDROID_LOGGER=y
CONFIG_ANDROID_LOW_MEMORY_KILLER=y
CONFIG_SYNC=y
CONFIG_SW_SYNC=y
CONFIG_SW_SYNC_USER=y
CONFIG_ION=y
CONFIG_ION_EXYNOS=y
CONFIG_ION_EXYNOS_OF=y
CONFIG_SEC_EXT=y
CONFIG_EXYNOS_CHIPID=y
CONFIG_EXYNOS_REBOOT=y
CONFIG_SAMSUNG_CORE_TEST=y
CONFIG_ECT=y
CONFIG_ECT_DUMP=y
CONFIG_PM_DEVFREQ=y
CONFIG_ARM_EXYNOS_DEVFREQ=y
CONFIG_IIO=y
CONFIG_EXYNOS_ADC=y
CONFIG_PWM=y
CONFIG_PWM_SAMSUNG=y
CONFIG_BATTERY_SAMSUNG=y
CONFIG_BATTERY_SWELLING=y
# CONFIG_BATTERY_SWELLING_SELF_DISCHARGING is not set
# CONFIG_BATTERY_AGE_FORECAST is not set
CONFIG_MULTI_CHARGING=y
CONFIG_FUELGAUGE_MAX77854=y
CONFIG_CHARGER_MAX77854=y
# CONFIG_PHY_EXYNOS_MIPI_VIDEO is not set
CONFIG_PHY_EXYNOS_MIPI=y
# CONFIG_PHY_EXYNOS_DP_VIDEO is not set
CONFIG_EXYNOS_CORESIGHT=y
CONFIG_EXYNOS8890_BTS_OPTIMIZATION=y
CONFIG_TRUSTONIC_TEE=y
CONFIG_SECURE_OS_CONTROL=y
CONFIG_SECURE_OS_BOOSTER_API=y
CONFIG_EXYNOS_APM=y
CONFIG_EXYNOS_CL_DVFS_CPU=y
CONFIG_EXYNOS_CL_DVFS_G3D=y
CONFIG_EXYNOS_CL_DVFS_MIF=y
CONFIG_EXT2_FS=y
CONFIG_EXT3_FS=y
CONFIG_EXT4_FS=y
CONFIG_EXT4_FS_SECURITY=y
CONFIG_FUSE_FS=y
CONFIG_MSDOS_FS=y
CONFIG_VFAT_FS=y
CONFIG_EXFAT_FS=y
CONFIG_SDFAT_FS=y
CONFIG_TMPFS=y
CONFIG_TMPFS_POSIX_ACL=y
# CONFIG_ECRYPT_FS is set at 'ODE and DIR Encryption'.
CONFIG_CRAMFS=y
CONFIG_EXYNOS_SNAPSHOT_PSTORE=y
CONFIG_NLS_CODEPAGE_437=y
CONFIG_NLS_ISO8859_1=y
CONFIG_PRINTK_TIME=y
CONFIG_PRINTK_PROCESS=y
CONFIG_MAGIC_SYSRQ=y
CONFIG_DEBUG_INFO=y
CONFIG_LOCKUP_DETECTOR=y
CONFIG_BOOTPARAM_HARDLOCKUP_PANIC=y
CONFIG_BOOTPARAM_SOFTLOCKUP_PANIC=y
CONFIG_PANIC_TIMEOUT=5
CONFIG_SCHEDSTATS=y
CONFIG_TIMER_STATS=y
# CONFIG_DEBUG_PREEMPT is not set
CONFIG_ENABLE_DEFAULT_TRACERS=y
CONFIG_ATOMIC64_SELFTEST=y

CONFIG_BT=y
CONFIG_RFKILL=y
CONFIG_BCM4359=y
CONFIG_BT_BCM4359=y

# CONFIG_KEYS is set at 'ODE and DIR Encryption'.
CONFIG_CRYPTO_NULL=y
CONFIG_FMP_UFS=y
CONFIG_FIPS_FMP=y

# GPS
CONFIG_GPS_BCMxxxxx=y
CONFIG_GPS_BCM47531=y
CONFIG_GPIO_SYSFS=y

# SensorHub
#CONFIG_SENSORS_SSP_STM=y
#CONFIG_SENSORS_SSP_ATMEL=y
CONFIG_GPS_BCM4773=y
CONFIG_SENSORS_SSP_BBD=y
CONFIG_SENSORS_SSP=y
CONFIG_SENSORS_SYSFS=y
CONFIG_SENSORS_SSP_SENSORHUB=y
CONFIG_SENSORS_SSP_FACTORY=y
# CONFIG_SENSORS_SSP_BMI058 is not set
#CONFIG_SENSORS_SSP_ICM20610=y
#CONFIG_SENSORS_SSP_MPU6500=y
CONFIG_SENSORS_SSP_K6DS3TR=y
#CONFIG_SENSORS_SSP_BMP182=y
CONFIG_SENSORS_SSP_LPS25H=y
#CONFIG_SENSORS_SSP_YAS532 is not set
CONFIG_SENSORS_SSP_YAS537=y
#CONFIG_SENSORS_SSP_YAS539 is not set
#CONFIG_SENSORS_SSP_TMG399x=y
CONFIG_SENSORS_SSP_TMD4903=y
CONFIG_SENSORS_SSP_IRDATA_FOR_CAMERA=y
CONFIG_SENSORS_SSP_INTERRUPT_GYRO_SENSOR=y
CONFIG_SENSORS_SSP_PROX_FACTORYCAL=y
CONFIG_SENSORS_SSP_MOBEAM=y
CONFIG_SENSORS_MULTIPLE_GLASS_TYPE=y
# CONFIG_SENSORS_SSP_MAX88921 is not set
# CONFIG_SENSORS_SSP_SHTC1=y
# CONFIG_SENSORS_SSP_SHTC1_VER="SM-G900H"
CONFIG_SENSORS_SSP_HIFI_BATCHING=y
CONFIG_IIO=y
CONFIG_IIO_BUFFER=y
CONFIG_IIO_KFIFO_BUF=y
CONFIG_IIO_TRIGGER=y
#CONFIG_IIO_ST_HWMON=y

# NFC
CONFIG_NFC=y
CONFIG_SEC_NFC=y
CONFIG_ESE_P3_LSI=y
CONFIG_ESE_SECURE=y
CONFIG_ESE_SECURE_SPI_PORT=3
CONFIG_ESE_SECURE_GPIO="gpf2"
# CONFIG_ESE_COFFEE is not set

#
# SELinux
#
CONFIG_EXT2_FS_XATTR=y
CONFIG_EXT2_FS_SECURITY=y
CONFIG_EXT4_FS_XATTR=y
CONFIG_EXT4_FS_SECURITY=y
CONFIG_AUDIT=y
CONFIG_SECURITY=y
CONFIG_LSM_MMAP_MIN_ADDR=4096
CONFIG_SECURITY_NETWORK=y
CONFIG_SECURITY_SELINUX=y
CONFIG_DEFAULT_SECURITY_SELINUX=y
CONFIG_NETWORK_SECMARK=y
CONFIG_NETFILTER_XT_TARGET_CONNSECMARK=y
CONFIG_NETFILTER_ADVANCED=y
CONFIG_IP_NF_SECURITY=y
CONFIG_AUDITSYSCALL=y
CONFIG_SEC_AVC_LOG=y
CONFIG_SDCARD_FS_XATTR=y
CONFIG_ECRYPT_FS_VIRTUAL_FAT_XATTR=y
CONFIG_FAT_VIRTUAL_XATTR=y
CONFIG_EXFAT_VIRTUAL_XATTR=y

#
# ODE and DIR Encryption
#
CONFIG_CRYPTO=y
CONFIG_CRYPTO_SHA1=y
CONFIG_CRYPTO_AES=y
CONFIG_CRYPTO_TWOFISH=y
CONFIG_CRYPTO_CBC=y
CONFIG_ECRYPT_FS=y
CONFIG_WTL_ENCRYPTION_FILTER=y
CONFIG_KEYS=y
CONFIG_KEYS_DEBUG_PROC_KEYS=y
#CONFIG_ECRYPTFS_FEK_INTEGRITY=y

#
# Finger print sensor
#
CONFIG_SENSORS_FINGERPRINT=y
CONFIG_SENSORS_FINGERPRINT_SYSFS=y
CONFIG_SENSORS_VFS7XXX=y
CONFIG_SENSORS_ET320=y
CONFIG_SENSORS_FINGERPRINT_DUALIZATION=y
CONFIG_SENSORS_FP_SPI_GPIO="gpf3"
CONFIG_SENSORS_FP_SPI_NUMBER=4
CONFIG_SENSORS_FP_LOCKSCREEN_MODE=y

#
# KNOX KAP
#
CONFIG_KNOX_KAP=y

#
# BEGIN RKP_CFP
# CONFIG_RKP_CFP_ROPP is not set
CONFIG_RKP_CFP_JOPP=y
CONFIG_RKP_CFP_JOPP_MAGIC=0x00be7bad
# CONFIG_BPF_SYSCALL is not set
#
# END RKP_CFP
#

#
# DMVerity
#
CONFIG_DM_VERITY=y

# Samsung Argos
CONFIG_ARGOS=y

# SEC Param
CONFIG_SEC_PARAM=y
CONFIG_CM_OFFSET=7340596

# HRM
CONFIG_SENSORS_MAX86902=y

CONFIG_AVERAGE=y

# KNOX SDP and DLP
CONFIG_SDP=y
CONFIG_DLP=y

# KASLR
CONFIG_RELOCATABLE_KERNEL=y

# TIMA
#
CONFIG_SEC_DEBUG_TIMA_LOG=y
CONFIG_TIMA=y

#TUI
CONFIG_TRUSTONIC_TRUSTED_UI=y

# CONFIG_ARM_PATCH_PHYS_VIRT is not set
# CONFIG_FUNCTION_TRACER is not set

CONFIG_TIMA_RKP=y
CONFIG_RKP_KDP=y
CONFIG_RKP_NS_PROT=y
CONFIG_RKP_DMAP_PROT=y

# Rooting prevention
#
CONFIG_SEC_RESTRICT_ROOTING=y
CONFIG_SEC_RESTRICT_SETUID=y
CONFIG_SEC_RESTRICT_FORK=y
CONFIG_SEC_RESTRICT_ROOTING_LOG=y

#
# FIPS for Kernel Crypto API
#
CONFIG_CRYPTO_TEST=y
CONFIG_CRYPTO_MANAGER_DISABLE_TESTS=n
CONFIG_CRYPTO_DRBG_MENU=y
CONFIG_CRYPTO_DRBG=y
CONFIG_CRYPTO_DRBG_HMAC=y
CONFIG_CRYPTO_DRBG_HASH=y
CONFIG_CRYPTO_DRBG_CTR=y
CONFIG_CRYPTO_FIPS=y
CONFIG_CRYPTO_SHA256=y
CONFIG_CRYPTO_SHA512=y
CONFIG_CRYPTO_GCM=y
CONFIG_LOG_BUF_SHIFT=19
CONFIG_CRYPTO_AEAD2=y
CONFIG_CRYPTO_LZO=y
CONFIG_CRYPTO_POST_DEFERRED_INIT=y

CONFIG_DEFERRED_INITCALLS=y

#EPDG
CONFIG_NET_CORE=y
CONFIG_NET_SCH_PRIO=y
CONFIG_NET_CLS_BASIC=y # required if basic is being used as a filter. depends on CONFIG_NET_CLS so enabling it by default
CONFIG_NET_CLS=y

CONFIG_ARM64_CRYPTO=y
CONFIG_CRYPTO_SHA1_ARM64_CE=y
CONFIG_CRYPTO_SHA2_ARM64_CE=y
CONFIG_CRYPTO_AES_ARM64_CE=y
CONFIG_CRYPTO_AES_ARM64_CE_BLK=y

CONFIG_SEC_DEBUG=y
CONFIG_SEC_TRACE_BINDERCNT=y

# User version reset tracking
CONFIG_USER_RESET_DEBUG=y
CONFIG_SEC_DUMP_SUMMARY=y

# Kernel Fault Auto Summary
CONFIG_KFAULT_AUTO_SUMMARY=y

# CONFIG_SLUB_DEBUG is not set
CONFIG_SLUB_DEBUG_LIGHT=y
# CONFIG_SLUB_DEBUG_ON is not set

CONFIG_LARGE_DIRTY_BUFFER=y

# performance monitoring unit
CONFIG_PERF_EVENTS=y
CONFIG_HW_PERF_EVENTS=y
```
