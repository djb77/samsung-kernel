/*
 * Copyright (c) 2015-2016, The Linux Foundation. All rights reserved.
 *
 * This program is free software; you can redistribute it and/or modify
 * it under the terms of the GNU General Public License version 2 and
 * only version 2 as published by the Free Software Foundation.
 *
 * This program is distributed in the hope that it will be useful,
 * but WITHOUT ANY WARRANTY; without even the implied warranty of
 * MERCHANTABILITY or FITNESS FOR A PARTICULAR PURPOSE.  See the
 * GNU General Public License for more details.
 */

/dts-v1/;

#include "../../qcom/msm8917.dtsi"
#include "msm8917-sec-gta2slte-r05.dtsi"
#include "../../../../../../drivers/video/msm/mdss/samsung/S6D7AA0X11_TV080WXM/dsi_panel_S6D7AA0X11_TV080WXM_wxga_video_chn.dtsi"

/ {
	model = "Samsung GTA2SLTE CHN OPEN PROJECT Rev05";
	compatible = "qcom,msm8917-mtp", "qcom,msm8917", "qcom,mtp";
	qcom,board-id= <8 5>;
	qcom,pmic-id = <0x10019 0x020037 0x0 0x0>;
};

