/*
 * Copyright (c) 2015-2016, The Linux Foundation. All rights reserved.
 *
 * This program is free software; you can redistribute it and/or modify
 * it under the terms of the GNU General Public License version 2 and
 * only version 2 as published by the Free Software Foundation.
 *
 * This program is distributed in the hope that it will be useful,
 * but WITHOUT ANY WARRANTY; without even the implied warranty of
 * MERCHANTABILITY or FITNESS FOR A PARTICULAR PURPOSE.  See the
 * GNU General Public License for more details.
 */

/dts-v1/;

#include "../../qcom/msm8917.dtsi"
#include "msm8917-sec-on5xllte-chn-r01.dtsi"

/ {
	model = "Samsung ON5XLLTE CHN PROJECT Rev01";
	compatible = "qcom,msm8917-mtp", "qcom,msm8917", "qcom,mtp";
	qcom,board-id= <8 1>;
	qcom,pmic-id = <0x10019 0x020037 0x0 0x0>;
};

&soc{
	sec_thermistor {
		compatible = "samsung,sec-ap-thermistor";
		qcom,therm-vadc = <&pm8937_vadc>;
		status = "okay";
		adc_channel = <19>;
		adc_array = <25668 26221 26498 26830 27144 27529 28040 28161
                                              28282 28312 28523 28645 28762 28911 29059 29196
											  29332 29475 29618 29770 29922 30065 30203 30351
											  30498 30581 30770 30980 31143 31331 31463 31694
											  31882 32067 32309 32549 32750 32855 33052 33248
											  33451 33640 33860 34079 34282 34480 34706 34930
											  35158 35385 35686 35987 36121 36240 36355 36470
											  36664 37115 37313 37491 37650 37790 38065 38176
											  38286 38509 38732 39114 39160 39206 39459 39716
											  39970 40006 40034 40165 40297 40334 40371 40445
											  40519 40672 40823 40935 41044 41136 41445 41705
											  42004>;
  
		temp_array = <900 850 800 750 700 650 600 590 580 570
			560 550 540 530 520 510 500 490 480 470
			460 450 440 430 420 410 400 390 380 370
			360 350 340 330 320 310 300 290 280 270
			260 250 240 230 220 210 200 190 180 170
			160 150 140 130 120 110 100 90 80 70
			60 50 40 30 20 10 0 (-10) (-20) (-30)
			(-40) (-50) (-60) (-70) (-80) (-90) (-100) (-110) (-120) (-130)
			(-140) (-150) (-160) (-170) (-180) (-190) (-200) (-250) (-300)>;
	};
};
