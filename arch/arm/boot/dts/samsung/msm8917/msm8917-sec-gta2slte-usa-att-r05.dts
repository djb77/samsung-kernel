/*
 * Copyright (c) 2015-2016, The Linux Foundation. All rights reserved.
 *
 * This program is free software; you can redistribute it and/or modify
 * it under the terms of the GNU General Public License version 2 and
 * only version 2 as published by the Free Software Foundation.
 *
 * This program is distributed in the hope that it will be useful,
 * but WITHOUT ANY WARRANTY; without even the implied warranty of
 * MERCHANTABILITY or FITNESS FOR A PARTICULAR PURPOSE.  See the
 * GNU General Public License for more details.
 */

/dts-v1/;

#include "../../qcom/msm8917.dtsi"
#include "msm8917-sec-gta2slte-r05.dtsi"

/ {
	model = "Samsung GTA2SLTE USA ATT PROJECT Rev05";
	compatible = "qcom,msm8917-mtp", "qcom,msm8917", "qcom,mtp";
	qcom,board-id= <8 5>;
	qcom,pmic-id = <0x10019 0x020037 0x0 0x0>;
};

&soc{
	sound {
		/delete-property/ qcom,mainmic-bias-gpio;
		pinctrl-4 = <&submic_bias_active>;
		pinctrl-5 = <&submic_bias_sus>;
	};

	tlmm: pinctrl@1000000 {
		/delete-node/ mainmic_bias_gpio;
	};
};