/*
* SAMSUNG EXYNOS9810 ECD device tree source
*
* Copyright (c) 2017 Samsung Electronics Co., Ltd.
*		http://www.samsung.com
*
* SAMSUNG EXYNOS9810 ECD device nodes are listed in this file.
* EXYNOS9810 based board files can include this file and provide
* values for board specfic bindings.
*
* This program is free software; you can redistribute it and/or modify
* it under the terms of the GNU General Public License version 2 as
* published by the Free Software Foundation.
*/
/ {
       /* UART_DBG */
       exynos_console_debugger {
	       compatible = "samsung,exynos_console_debugger";
	       reg = <0x0 0x10440000 0x100>;
	       interrupts = <0 INTREQ__UART_DBG 0>;
	       interrupt-names = "uart_irq";
	       pinctrl-names = "default";
	       pinctrl-0 = <&uart0_bus>;
	       uart_port = <0>;
	       /* <sfr_base_address sfr_size> */
	       sfr_reg = <0x10000000 0x10000000>;
	       samsung,usi-serial-v2;
	       status = "ok";
       };
};
