/*
 * SAMSUNG UNIVERSAL5433 board device tree source
 *
 * Copyright (c) 2013 Samsung Electronics Co., Ltd.
 *		http://www.samsung.com
 *
 * This program is free software; you can redistribute it and/or modify
 * it under the terms of the GNU General Public License version 2 as
 * published by the Free Software Foundation.
 */

#include "battery_data_crownlte_common.dtsi"

/ {
	max77705-fuelgauge {
		fuelgauge,v_empty = <0xA05F>; /* Empty: 3260mV, Recover: 3480mV */
		fuelgauge,qrtable20 = <0x0D06>;
		fuelgauge,qrtable30 = <0x0B04>;
		fuelgauge,capacity = <0x0F80>;
	};
};

