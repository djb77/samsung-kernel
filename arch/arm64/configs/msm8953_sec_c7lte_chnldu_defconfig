## arch/arm64/configs/universal8890_defconfig
```kconfig
CONFIG_SYSVIPC=y
CONFIG_NO_HZ=y
CONFIG_HIGH_RES_TIMERS=y
CONFIG_CGROUPS=y
CONFIG_CGROUP_DEBUG=y
CONFIG_CGROUP_FREEZER=y
CONFIG_CGROUP_CPUACCT=y
CONFIG_RESOURCE_COUNTERS=y
CONFIG_CGROUP_SCHED=y
CONFIG_RT_GROUP_SCHED=y
CONFIG_NAMESPACES=y
CONFIG_BLK_DEV_INITRD=y
CONFIG_CC_OPTIMIZE_FOR_SIZE=y
CONFIG_EMBEDDED=y
# CONFIG_COMPAT_BRK is not set
CONFIG_PROFILING=y
CONFIG_MODULES=y
CONFIG_MODULE_UNLOAD=y
CONFIG_MODULE_FORCE_UNLOAD=y
# CONFIG_BLK_DEV_BSG is not set
CONFIG_PARTITION_ADVANCED=y
# CONFIG_IOSCHED_DEADLINE is not set
CONFIG_SOC_EXYNOS8890=y
CONFIG_SOC_EXYNOS8890_EVT1=y
CONFIG_ARCH_EXYNOS8=y
CONFIG_ZONE_DMA_ALLOW_CUSTOM_SIZE=y
CONFIG_ZONE_DMA_SIZE_MBYTES=512
CONFIG_PCI=y
CONFIG_PCI_MSI=y
CONFIG_PCI_EXYNOS=y
CONFIG_PCI_EXYNOS_TEST=y
CONFIG_SMP=y
CONFIG_SCHED_MC=y
CONFIG_DISABLE_CPU_SCHED_DOMAIN_BALANCE=y
CONFIG_SCHED_HMP=y
CONFIG_HMP_FAST_CPU_MASK="4-7"
CONFIG_HMP_SLOW_CPU_MASK="0-3"
CONFIG_HMP_VARIABLE_SCALE=y
CONFIG_SCHED_HMP_DOWN_MIGRATION_COMPENSATION=y
CONFIG_NR_CPUS=8
CONFIG_PREEMPT=y
CONFIG_KSM=y
CONFIG_FRONTSWAP=y
CONFIG_CMA_PINPAGE_MIGRATION=y
CONFIG_ESWAP=y
CONFIG_ZSMALLOC=y
CONFIG_ARMV8_DEPRECATED=y
CONFIG_SWP_EMULATION=y
CONFIG_CP15_BARRIER_EMULATION=y
CONFIG_SETEND_EMULATION=y
# CONFIG_EFI is not set
# CONFIG_CORE_DUMP_DEFAULT_ELF_HEADERS is not set
CONFIG_COMPAT=y
CONFIG_PM_AUTOSLEEP=y
CONFIG_PM_WAKELOCKS=y
CONFIG_PM_WAKELOCKS_LIMIT=0
# CONFIG_PM_WAKELOCKS_GC is not set
CONFIG_PM_RUNTIME=y
CONFIG_PM_DEBUG=y
CONFIG_SUSPEND_TIME=y
CONFIG_CPU_IDLE=y
CONFIG_CPU_IDLE_STOP_IDLE_DURING_HOTPLUG=y
CONFIG_ARM64_EXYNOS_CPUIDLE=y
CONFIG_CPU_FREQ=y
CONFIG_CPU_FREQ_DEFAULT_GOV_INTERACTIVE=y
CONFIG_CPU_FREQ_GOV_PERFORMANCE=y
CONFIG_CPU_FREQ_GOV_USERSPACE=y
CONFIG_CPUFREQ_DT=y
CONFIG_ARM_EXYNOS_MP_CPUFREQ=y
CONFIG_EXYNOS_PM_DVS=y
CONFIG_EXYNOS_HOTPLUG_GOVERNOR=y
CONFIG_EXYNOS_BIG_FREQ_BOOST=y
CONFIG_NET=y
CONFIG_PACKET=y
CONFIG_UNIX=y
CONFIG_XFRM_USER=y
CONFIG_NET_KEY=y
CONFIG_INET=y
CONFIG_IP_ADVANCED_ROUTER=y
CONFIG_IP_MULTIPLE_TABLES=y
CONFIG_IP_PNP=y
CONFIG_IP_PNP_DHCP=y
CONFIG_IP_PNP_BOOTP=y
CONFIG_IP_PNP_RARP=y
CONFIG_INET_ESP=y
# CONFIG_INET_XFRM_MODE_TUNNEL is not set
# CONFIG_INET_XFRM_MODE_BEET is not set
# CONFIG_INET_LRO is not set
# CONFIG_INET_DIAG is not set
CONFIG_IPV6=y
CONFIG_IPV6_ROUTER_PREF=y
CONFIG_IPV6_ROUTE_INFO=y
CONFIG_IPV6_OPTIMISTIC_DAD=y
CONFIG_INET6_AH=y
CONFIG_INET6_ESP=y
CONFIG_INET6_IPCOMP=y
CONFIG_IPV6_MIP6=y
CONFIG_IPV6_TUNNEL=y
CONFIG_IPV6_MULTIPLE_TABLES=y
CONFIG_NETWORK_SECMARK=y
CONFIG_NETFILTER=y
CONFIG_NF_CONNTRACK=y
CONFIG_NF_CONNTRACK_EVENTS=y
CONFIG_NF_CT_PROTO_DCCP=y
CONFIG_NF_CT_PROTO_SCTP=y
CONFIG_NF_CT_PROTO_UDPLITE=y
CONFIG_NF_CONNTRACK_AMANDA=y
CONFIG_NF_CONNTRACK_FTP=y
CONFIG_NF_CONNTRACK_H323=y
CONFIG_NF_CONNTRACK_IRC=y
CONFIG_NF_CONNTRACK_NETBIOS_NS=y
CONFIG_NF_CONNTRACK_PPTP=y
CONFIG_NF_CONNTRACK_SANE=y
CONFIG_NF_CONNTRACK_TFTP=y
CONFIG_NF_CT_NETLINK=y
CONFIG_NETFILTER_XT_TARGET_CLASSIFY=y
CONFIG_NETFILTER_XT_TARGET_CONNMARK=y
CONFIG_NETFILTER_XT_TARGET_MARK=y
CONFIG_NETFILTER_XT_TARGET_NFLOG=y
CONFIG_NETFILTER_XT_TARGET_NFQUEUE=y
CONFIG_NETFILTER_XT_TARGET_TPROXY=y
CONFIG_NETFILTER_XT_TARGET_TRACE=y
CONFIG_NETFILTER_XT_TARGET_TCPMSS=y
CONFIG_NETFILTER_XT_MATCH_COMMENT=y
CONFIG_NETFILTER_XT_MATCH_CONNBYTES=y
CONFIG_NETFILTER_XT_MATCH_CONNLABEL=y
CONFIG_NETFILTER_XT_MATCH_CONNLIMIT=y
CONFIG_NETFILTER_XT_MATCH_CONNMARK=y
CONFIG_NETFILTER_XT_MATCH_CONNTRACK=y
CONFIG_NETFILTER_XT_MATCH_HASHLIMIT=y
CONFIG_NETFILTER_XT_MATCH_HELPER=y
CONFIG_NETFILTER_XT_MATCH_IPRANGE=y
CONFIG_NETFILTER_XT_MATCH_LENGTH=y
CONFIG_NETFILTER_XT_MATCH_LIMIT=y
CONFIG_NETFILTER_XT_MATCH_MAC=y
CONFIG_NETFILTER_XT_MATCH_MARK=y
CONFIG_NETFILTER_XT_MATCH_POLICY=y
CONFIG_NETFILTER_XT_MATCH_PKTTYPE=y
CONFIG_NETFILTER_XT_MATCH_QTAGUID=y
CONFIG_NETFILTER_XT_MATCH_QUOTA=y
CONFIG_NETFILTER_XT_MATCH_QUOTA2=y
CONFIG_NETFILTER_XT_MATCH_SCTP=y
CONFIG_NETFILTER_XT_MATCH_SOCKET=y
CONFIG_NETFILTER_XT_MATCH_STATE=y
CONFIG_NETFILTER_XT_MATCH_STATISTIC=y
CONFIG_NETFILTER_XT_MATCH_STRING=y
CONFIG_NETFILTER_XT_MATCH_TIME=y
CONFIG_NETFILTER_XT_MATCH_U32=y
CONFIG_NF_CONNTRACK_IPV4=y
CONFIG_NF_NAT_IPV4=y
CONFIG_IP_NF_IPTABLES=y
CONFIG_IP_NF_MATCH_AH=y
CONFIG_IP_NF_MATCH_ECN=y
CONFIG_IP_NF_MATCH_TTL=y
CONFIG_IP_NF_FILTER=y
CONFIG_IP_NF_TARGET_REJECT=y
CONFIG_IP_NF_NAT=y
CONFIG_IP_NF_TARGET_MASQUERADE=y
CONFIG_IP_NF_MANGLE=y
CONFIG_IP_NF_RAW=y
CONFIG_IP_NF_ARPTABLES=y
CONFIG_IP_NF_ARPFILTER=y
CONFIG_IP_NF_ARP_MANGLE=y
CONFIG_NF_CONNTRACK_IPV6=y
CONFIG_IP6_NF_IPTABLES=y
CONFIG_IP6_NF_FILTER=y
CONFIG_IP6_NF_TARGET_REJECT=y
CONFIG_IP6_NF_MANGLE=y
CONFIG_IP6_NF_RAW=y
CONFIG_PHONET=y
CONFIG_NET_SCHED=y
CONFIG_NET_SCH_HTB=y
CONFIG_NET_SCH_INGRESS=y
CONFIG_NET_CLS_U32=y
CONFIG_NET_EMATCH=y
CONFIG_NET_EMATCH_U32=y
CONFIG_NET_CLS_ACT=y
CONFIG_NET_ACT_POLICE=y
CONFIG_NET_ACT_GACT=y
CONFIG_NET_ACT_MIRRED=y
CONFIG_UEVENT_HELPER_PATH="/sbin/hotplug"
CONFIG_DEVTMPFS=y
CONFIG_FW_LOADER_USER_HELPER_FALLBACK=y
CONFIG_ZRAM=y
CONFIG_CMA_SIZE_MBYTES=24
CONFIG_BLK_DEV_LOOP=y
CONFIG_BLK_DEV_RAM=y
CONFIG_BLK_DEV_RAM_SIZE=8192
CONFIG_UID_STAT=y
CONFIG_MCU_IPC=y
CONFIG_SHM_IPC=y
CONFIG_SEC_SIPC_MODEM_IF=y
CONFIG_USE_MUIC=y
CONFIG_USE_SAFEOUT=y
CONFIG_MUIC_NOTIFIER=y
CONFIG_MUIC_UNIVERSAL=y
CONFIG_MUIC_UNIVERSAL_MAX77854=y
# CONFIG_MUIC_ADCMODE_SWITCH_WA is not set
# CONFIG_MUIC_RUSTPROOF_ON_USER is not set
# CONFIG_MUIC_MAX77854 is not set
# CONFIG_HV_MUIC_MAX77854_AFC is not set
# CONFIG_MUIC_MAX77854_IGNORE_ADCERR_WA is not set
CONFIG_SCSI=y
CONFIG_UFS_FMP_DM_CRYPT=y
CONFIG_UFS_FMP_ECRYPT_FS=y
CONFIG_BLK_DEV_SD=y
CONFIG_SCSI_UFSHCD=y
CONFIG_UFS_DYNAMIC_H8=y
CONFIG_SCSI_SKIP_CACHE_OP=y
CONFIG_SCSI_SKIP_CPU_SYNC=y
CONFIG_SCSI_UFSHCD_PLATFORM=y
CONFIG_SCSI_UFS_EXYNOS=y
CONFIG_MD=y
CONFIG_BLK_DEV_DM=y
CONFIG_DM_CRYPT=y
CONFIG_INPUT_EVDEV=y
CONFIG_INPUT_KEYRESET=y
CONFIG_KEYBOARD_GPIO=y
CONFIG_KEYBOARD_SAMSUNG=y
# CONFIG_INPUT_MOUSE is not set
CONFIG_INPUT_JOYSTICK=y
CONFIG_INPUT_TABLET=y
CONFIG_INPUT_TOUCHSCREEN=y
CONFIG_TOUCHSCREEN_FTS=y
CONFIG_INPUT_MISC=y
CONFIG_INPUT_KEYCHORD=y
CONFIG_INPUT_UINPUT=y
CONFIG_INPUT_GPIO=y
# CONFIG_SERIO_SERPORT is not set
# CONFIG_VT is not set
# CONFIG_LEGACY_PTYS is not set
CONFIG_SERIAL_SAMSUNG=y
CONFIG_SERIAL_SAMSUNG_CONSOLE=y
CONFIG_S3C_LOWLEVEL_UART_PORT=4
CONFIG_HW_RANDOM=y
# CONFIG_HW_RANDOM_EXYNOS is not set
CONFIG_EXYRNG_FIPS_COMPLIANCE=y
CONFIG_EXYRNG_FAIL_POLICY_RESET=y
CONFIG_EXYRNG_USE_CRYPTOMANAGER=y
CONFIG_I2C_CHARDEV=y
CONFIG_I2C_GPIO=y
CONFIG_SPI=y
CONFIG_PINCTRL_EXYNOS=y
CONFIG_GPIOLIB=y
# CONFIG_HWMON is not set
CONFIG_THERMAL=y
CONFIG_CPU_THERMAL=y
CONFIG_GPU_THERMAL=y
CONFIG_ISP_THERMAL=y
CONFIG_THERMAL_EMULATION=y
CONFIG_EXYNOS_THERMAL=y
CONFIG_EXYNOS_SWTRIP=y
CONFIG_CPU_THERMAL_IPA=y
CONFIG_CPU_THERMAL_IPA_CONTROL=y
CONFIG_EXYNOS_THERMAL_CORE=y
CONFIG_WATCHDOG=y
CONFIG_S3C2410_WATCHDOG=y
CONFIG_MFD_MAX77854=y
CONFIG_MFD_SEC_CORE=y
CONFIG_MFD_S2MPB02=y
CONFIG_REGULATOR_FIXED_VOLTAGE=y
CONFIG_REGULATOR_MAX77838=y
CONFIG_REGULATOR_S2MPS16=y
CONFIG_REGULATOR_S2MPB02=y
CONFIG_MEDIA_SUPPORT=y
CONFIG_MEDIA_CAMERA_SUPPORT=y
CONFIG_V4L_PLATFORM_DRIVERS=y
CONFIG_VIDEO_EXYNOS_SCALER=y
CONFIG_VIDEO_EXYNOS_MFC=y
CONFIG_VIDEO_EXYNOS_FIMG2D_V5=y
CONFIG_VIDEO_EXYNOS_FIMG2D_1SHOT2=y
CONFIG_VIDEO_EXYNOS_SMFC=y
CONFIG_VIDEO_EXYNOS_FIMC_IS2=y
CONFIG_EXYNOS_DEVICE_MIPI_CSIS_VER2=y
CONFIG_CSIS_V4_1=y
CONFIG_CAMERA_SENSOR_2P2_OBJ=y
CONFIG_CAMERA_SENSOR_IMX240_OBJ=y
CONFIG_CAMERA_SENSOR_4E6_OBJ=y
CONFIG_CAMERA_SENSOR_4E6_C2_OBJ=y
CONFIG_FIMC_BNS_V4_20_0=y
CONFIG_FIMC_IS_V4_3_0=y
CONFIG_VENDER_MCD=y
CONFIG_COMPANION_USE=y
CONFIG_COMPANION_C2_USE=y
CONFIG_PREPROCESSOR_STANDBY_USE=y
CONFIG_MALI_DVFS=y
CONFIG_MALI_ENABLE_TRACE=y
CONFIG_MALI_EXYNOS_TRACE=y
CONFIG_MALI_DEBUG_SYS=y
CONFIG_MALI_EXPERT=y
CONFIG_MALI_PLATFORM_THIRDPARTY_NAME="8890"
CONFIG_MALI_MIDGARD_ENABLE_TRACE=y
CONFIG_FB=y
CONFIG_FB_SIMPLE=y
CONFIG_EXYNOS_VIDEO=y
CONFIG_EXYNOS_DECON_8890=y
CONFIG_DECON_LPD_DISPLAY=y
CONFIG_FB_WINDOW_UPDATE=y
CONFIG_EXYNOS_DECON_LCD=y
CONFIG_EXYNOS_DECON_LCD_S6E3HF4=y
CONFIG_BACKLIGHT_LCD_SUPPORT=y
CONFIG_LCD_CLASS_DEVICE=y
CONFIG_BACKLIGHT_CLASS_DEVICE=y
# CONFIG_BACKLIGHT_GENERIC is not set
CONFIG_SOUND=y
CONFIG_SND=y
CONFIG_SND_SOC=y
CONFIG_SND_SOC_SAMSUNG=y
CONFIG_SND_SOC_SAMSUNG_LUCKY_MOON=y
CONFIG_SND_SAMSUNG_SEIREN=y
CONFIG_SND_SAMSUNG_SEIREN_OFFLOAD=y
CONFIG_HIDRAW=y
CONFIG_UHID=y
CONFIG_HID_A4TECH=y
CONFIG_HID_ACRUX=y
CONFIG_HID_ACRUX_FF=y
CONFIG_HID_APPLE=y
CONFIG_HID_BELKIN=y
CONFIG_HID_CHERRY=y
CONFIG_HID_CHICONY=y
CONFIG_HID_CYPRESS=y
CONFIG_HID_DRAGONRISE=y
CONFIG_DRAGONRISE_FF=y
CONFIG_HID_EMS_FF=y
CONFIG_HID_ELECOM=y
CONFIG_HID_EZKEY=y
CONFIG_HID_KEYTOUCH=y
CONFIG_HID_KYE=y
CONFIG_HID_UCLOGIC=y
CONFIG_HID_WALTOP=y
CONFIG_HID_GYRATION=y
CONFIG_HID_TWINHAN=y
CONFIG_HID_KENSINGTON=y
CONFIG_HID_LCPOWER=y
CONFIG_HID_LOGITECH=y
CONFIG_HID_LOGITECH_DJ=y
CONFIG_LOGITECH_FF=y
CONFIG_LOGIRUMBLEPAD2_FF=y
CONFIG_LOGIG940_FF=y
CONFIG_HID_MAGICMOUSE=y
CONFIG_HID_MICROSOFT=y
CONFIG_HID_MONTEREY=y
CONFIG_HID_MULTITOUCH=y
CONFIG_HID_ORTEK=y
CONFIG_HID_PANTHERLORD=y
CONFIG_PANTHERLORD_FF=y
CONFIG_HID_PETALYNX=y
CONFIG_HID_PICOLCD=y
CONFIG_HID_PRIMAX=y
CONFIG_HID_SAITEK=y
CONFIG_HID_SAMSUNG=y
CONFIG_HID_SPEEDLINK=y
CONFIG_HID_SUNPLUS=y
CONFIG_HID_GREENASIA=y
CONFIG_GREENASIA_FF=y
CONFIG_HID_SMARTJOYPLUS=y
CONFIG_SMARTJOYPLUS_FF=y
CONFIG_HID_TIVO=y
CONFIG_HID_TOPSEED=y
CONFIG_HID_THRUSTMASTER=y
CONFIG_HID_WACOM=y
CONFIG_HID_WIIMOTE=y
CONFIG_HID_ZEROPLUS=y
CONFIG_HID_ZYDACRON=y
CONFIG_USB=y
CONFIG_USB_XHCI_HCD=y
CONFIG_USB_PRINTER=y
CONFIG_USB_STORAGE=y
CONFIG_USB_HOST_NOTIFY=y
CONFIG_USB_NOTIFY_LAYER=y
CONFIG_USB_NOTIFIER=y
CONFIG_USB_DWC3=y
CONFIG_USB_GADGET=y
CONFIG_USB_G_ANDROID=y
CONFIG_USB_ANDROID_SAMSUNG_COMPOSITE=y
CONFIG_USB_RNDIS_MULTIPACKET=y
CONFIG_NEW_LEDS=y
CONFIG_LEDS_CLASS=y
CONFIG_LEDS_S2MPB02=y
CONFIG_RTC_CLASS=y
CONFIG_RTC_DRV_SEC=y
CONFIG_STAGING=y
CONFIG_ANDROID=y
CONFIG_ANDROID_BINDER_IPC=y
CONFIG_ASHMEM=y
CONFIG_ANDROID_TIMED_GPIO=y
CONFIG_ANDROID_LOW_MEMORY_KILLER=y
CONFIG_ANDROID_INTF_ALARM_DEV=y
CONFIG_SYNC=y
CONFIG_SW_SYNC=y
CONFIG_SW_SYNC_USER=y
CONFIG_ION=y
CONFIG_ION_EXYNOS=y
CONFIG_ION_EXYNOS_OF=y
CONFIG_SEC_EXT=y
CONFIG_EXYNOS_CHIPID=y
CONFIG_EXYNOS_REBOOT=y
CONFIG_SAMSUNG_CORE_TEST=y
CONFIG_ECT=y
CONFIG_ECT_DUMP=y
CONFIG_PM_DEVFREQ=y
CONFIG_ARM_EXYNOS_DEVFREQ=y
CONFIG_EXTCON=y
CONFIG_EXTCON_ADC_JACK=y
CONFIG_EXTCON_GPIO=y
CONFIG_IIO=y
CONFIG_EXYNOS_ADC=y
CONFIG_PWM=y
CONFIG_PWM_SAMSUNG=y
CONFIG_BATTERY_SAMSUNG=y
CONFIG_BATTERY_SWELLING=y
CONFIG_BATTERY_SWELLING_SELF_DISCHARGING=y
CONFIG_BATTERY_AGE_FORECAST=y
CONFIG_MULTI_CHARGING=y
CONFIG_FUELGAUGE_MAX77854=y
CONFIG_CHARGER_MAX77854=y
# CONFIG_PHY_EXYNOS_MIPI_VIDEO is not set
CONFIG_PHY_EXYNOS_MIPI=y
# CONFIG_PHY_EXYNOS_DP_VIDEO is not set
CONFIG_EXYNOS_CORESIGHT=y
CONFIG_EXYNOS8890_BTS_OPTIMIZATION=y
CONFIG_TRUSTONIC_TEE=y
CONFIG_SECURE_OS_CONTROL=y
CONFIG_SECURE_OS_BOOSTER_API=y
CONFIG_EXYNOS_APM=y
CONFIG_EXYNOS_CL_DVFS_CPU=y
CONFIG_EXYNOS_CL_DVFS_G3D=y
CONFIG_EXYNOS_CL_DVFS_MIF=y
CONFIG_EXT2_FS=y
CONFIG_EXT3_FS=y
CONFIG_EXT4_FS=y
CONFIG_EXT4_FS_SECURITY=y
CONFIG_FUSE_FS=y
CONFIG_MSDOS_FS=y
CONFIG_VFAT_FS=y
CONFIG_TMPFS=y
CONFIG_TMPFS_POSIX_ACL=y
CONFIG_ECRYPT_FS=y
CONFIG_CRAMFS=y
CONFIG_PSTORE_CONSOLE=y
CONFIG_NLS_CODEPAGE_437=y
CONFIG_NLS_ISO8859_1=y
CONFIG_PRINTK_TIME=y
CONFIG_PRINTK_CORE_NUM=y
CONFIG_PRINTK_PROCESS=y
CONFIG_DEBUG_INFO=y
CONFIG_LOCKUP_DETECTOR=y
CONFIG_BOOTPARAM_HARDLOCKUP_PANIC=y
CONFIG_BOOTPARAM_SOFTLOCKUP_PANIC=y
CONFIG_PANIC_TIMEOUT=5
CONFIG_SCHEDSTATS=y
CONFIG_TIMER_STATS=y
# CONFIG_DEBUG_PREEMPT is not set
CONFIG_ENABLE_DEFAULT_TRACERS=y
CONFIG_ATOMIC64_SELFTEST=y
CONFIG_KEYS=y
CONFIG_FMP_UFS=y
CONFIG_FIPS_FMP=y
CONFIG_ARM64_CRYPTO=y
CONFIG_CRYPTO_SHA1_ARM64_CE=y
CONFIG_CRYPTO_SHA2_ARM64_CE=y
CONFIG_CRYPTO_AES_ARM64_CE=y
CONFIG_CRYPTO_AES_ARM64_CE_BLK=y
```

## arch/arm64/mach-exynos/Kconfig
```kconfig
# arch/arm64/mach-exynos/Kconfig
#
# Copyright (c) 2016 Samsung Electronics Co., Ltd.
#		http://www.samsung.com/
#
# Licensed under GPLv2

# Configuration options for the EXYNOS8

if ARCH_EXYNOS

menu "SAMSUNG EXYNOS SoCs Support"

config SKIP_HW_BREAKPOINT
	bool "support skip hw breakpoint"
	default n
	help
	  Support early param for T32 onchip breakpoint

endmenu

endif
```

## drivers/ccic/Kconfig
```kconfig
#
# CCIC devices
#

comment "CCIC configs"

config CCIC_NOTIFIER
	bool "CCIC notifier support"
	depends on I2C
	default n
	help
	  If you say yes here you will get support for
	  the CCIC attached device status change notification.

config CCIC_S2MM003 
	bool "CCIC S2MM003"
	depends on I2C 
	default n
	help
	  If you say yes here you will get support for
	  s2mm003 ccic full version chipset 
```

## drivers/clk/samsung/Kconfig
```kconfig
config COMMON_CLK_SAMSUNG
	bool
	select COMMON_CLK

config COMPOSITE_CLK_SAMSUNG
	bool
	default y
	depends on ARCH_EXYNOS8 || ARCH_EXYNOS7

config S3C2410_COMMON_CLK
	bool
	select COMMON_CLK_SAMSUNG
	help
	  Build the s3c2410 clock driver based on the common clock framework.

config S3C2410_COMMON_DCLK
	bool
	select COMMON_CLK_SAMSUNG
	select REGMAP_MMIO
	help
	  Temporary symbol to build the dclk driver based on the common clock
	  framework.

config S3C2412_COMMON_CLK
	bool
	select COMMON_CLK_SAMSUNG

config S3C2443_COMMON_CLK
	bool
	select COMMON_CLK_SAMSUNG
```

## drivers/crypto/fmp/Kconfig
```kconfig
config FMP_UFS
	tristate "Samsung EXYNOS FMP Driver for UFS"
	depends on SCSI_UFSHCD && SCSI_UFSHCD_PLATFORM
	depends on UFS_FMP_DM_CRYPT || UFS_FMP_ECRYPT_FS || UFS_FMP_EXT4CRYPT_FS
	---help---
	  This is EXYNOS FMP UFS driver.

	  It is enabled automatically when any UFS FMP feature is enabled.

config FMP_MMC
	tristate "Samsung EXYNOS FMP Driver for MMC"
	depends on MMC_DW
	depends on MMC_DW_FMP_DM_CRYPT || MMC_DW_FMP_ECRYPT_FS || MMC_DW_FMP_EXT4CRYPT_FS
	---help---
	  This is EXYNOS FMP MMC driver.

	  It is enabled automatically when any MMC FMP feature is enabled.

config FMP_DM_CRYPT
	tristate "Samsung EXYNOS FMP DM_CRYPT Driver"
        depends on DM_CRYPT
	depends on UFS_FMP_DM_CRYPT || MMC_DW_FMP_DM_CRYPT
	---help---
	  This is EXYNOS FMP DM_CRYPT driver.

	  It is enabled automatically when any FMP DM_CRYPT feature is enabled.

config FMP_ECRYPT_FS
	tristate "Samsung EXYNOS FMP ECRYPT_FS Driver"
        depends on ECRYPT_FS
	depends on UFS_FMP_ECRYPT_FS || MMC_DW_FMP_ECRYPT_FS
	---help---
	  This is EXYNOS FMP ECRYPT_FS driver.

	  It is enabled automatically when any FMP ECRYPT_FS feature is enabled.

config FMP_EXT4CRYPT_FS
	tristate "Samsung EXYNOS FMP Ext4Crypt FS ENcryption Driver"
        depends on EXT4_FS_ENCRYPTION
	depends on UFS_FMP_EXT4CRYPT_FS || MMC_DW_FMP_EXT4CRYPT_FS
	---help---
	  This is EXYNOS FMP Ext4Crypt FS ENCRYPTION driver.

	  It is enabled automatically when any Ext4Crypt FMP FS feature is enabled.

config FIPS_FMP
	tristate "Samsung EXYNOS FMP Validation Driver for FIPS"
	depends on FMP_UFS
	depends on !FUNCTION_TRACER
	---help---
	  This selects Samsung EXYNOS FMP Validation driver for FIPS.

	  If you have a controller with this interface, say Y here.

	  If unsure, say N.

choice
	prompt "Option for self-test failure"
	depends on FIPS_FMP
	default NODE_FOR_SELFTEST_FAIL

config NODE_FOR_SELFTEST_FAIL
	bool "Set fips fmp node when self-test fails"
	depends on FIPS_FMP
	help
	   This select that fips fmp node was set to zero when FMP self-test fails.

config PANIC_FOR_SELFTEST_FAIL
	bool "Panic when self-test fails"
	depends on FIPS_FMP
	help
	   This select that kernel panic occurs when FMP self-test fails.

endchoice
```

## drivers/debug/Kconfig
```kconfig
# When adding new entries keep the list in alphabetical order

choice
	prompt "Version of GAF structure"
	depends on SEC_DEBUG
	default SEC_DEBUG_GAF_V4 if FIVE
	default SEC_DEBUG_GAF_V3

	config SEC_DEBUG_GAF_V3
		bool "Use GAF structure version 3"
		help
		  Default option for FIVE-disabled kernel

	config SEC_DEBUG_GAF_V4
		bool "Use GAF structure version 4"
		help
		  Default option for FIVE-enabled kernel
endchoice

source "drivers/debug/user_reset/Kconfig"
```
