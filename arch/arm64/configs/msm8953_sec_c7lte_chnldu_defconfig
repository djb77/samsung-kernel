## arch/arm64/configs/msm8953_sec_eng_defconfig
```kconfig
CONFIG_CGROUP_DEBUG=y
CONFIG_REGULATOR_PROXY_CONSUMER=y
CONFIG_FB_MSM_MDSS_XLOG_DEBUG=y
CONFIG_CP_ACCESS64=y
CONFIG_MSM_FORCE_WDOG_BITE_ON_PANIC=y
CONFIG_LOG_BUF_MAGIC=y
CONFIG_DYNAMIC_DEBUG=y
CONFIG_DEBUG_OBJECTS=y
CONFIG_DEBUG_OBJECTS_FREE=y
CONFIG_DEBUG_OBJECTS_TIMERS=y
CONFIG_DEBUG_OBJECTS_WORK=y
CONFIG_DEBUG_OBJECTS_RCU_HEAD=y
CONFIG_DEBUG_OBJECTS_PERCPU_COUNTER=y
CONFIG_DEBUG_KMEMLEAK=y
CONFIG_DEBUG_KMEMLEAK_DEFAULT_OFF=y
CONFIG_DEBUG_STACK_USAGE=y
CONFIG_DEBUG_MEMORY_INIT=y
CONFIG_LOCKUP_DETECTOR=y
CONFIG_BOOTPARAM_SOFTLOCKUP_PANIC=y
CONFIG_DETECT_HUNG_TASK=y
CONFIG_DEBUG_MUTEXES=y
CONFIG_DEBUG_ATOMIC_SLEEP=y
CONFIG_DEBUG_LIST=y
CONFIG_FAULT_INJECTION=y
CONFIG_FAIL_PAGE_ALLOC=y
CONFIG_UFS_FAULT_INJECTION=y
CONFIG_FAULT_INJECTION_DEBUG_FS=y
CONFIG_FAULT_INJECTION_STACKTRACE_FILTER=y
CONFIG_BLK_DEV_IO_TRACE=y
CONFIG_SLUB_DEBUG=y
CONFIG_SLUB_DEBUG_ON=y
CONFIG_PAGE_OWNER=y
CONFIG_PM_DEBUG=y
CONFIG_IOMMU_DEBUG_TRACKING=y
CONFIG_IRQSOFF_TRACER=y
CONFIG_PREEMPT_TRACER=y
CONFIG_PANIC_ON_DATA_CORRUPTION=y
CONFIG_ARM64_PTDUMP=y
CONFIG_TRUSTONIC_TEE_DEBUG=y
#CONFIG_FREE_PAGES_RDONLY is not set
#CONFIG_KERNEL_TEXT_RDONLY is not set
CONFIG_SLABINFO=y
CONFIG_DEBUG_PAGEALLOC=y
CONFIG_SLUB_DEBUG_PANIC_ON=y

#
# DS5 Streamline v22
#
CONFIG_HW_PERF_EVENTS=y
CONFIG_PERF_EVENTS=y
CONFIG_FTRACE=y
CONFIG_HIGH_RES_TIMERS=y
CONFIG_LOCAL_TIMERS=y
CONFIG_GATOR=m

#
# Kernel Atrace
#
CONFIG_KERNEL_ATRACE=y


#
# TIMA RKP
#
# CONFIG_RKP_KDP is not set
# CONFIG_RKP_NS_PROT is not set

#
# Enable SEC_PM Feature
#
CONFIG_SEC_GPIO_DVS=y

#QDSS debug flags
CONFIG_CORESIGHT=y
CONFIG_CORESIGHT_EVENT=y
CONFIG_CORESIGHT_FUSE=y
CONFIG_CORESIGHT_CTI=y
CONFIG_CORESIGHT_CTI_SAVE_DISABLE=y
CONFIG_CORESIGHT_TMC=y
CONFIG_CORESIGHT_TPIU=y
CONFIG_CORESIGHT_FUNNEL=y
CONFIG_CORESIGHT_REPLICATOR=y
CONFIG_CORESIGHT_TPDA=y
CONFIG_CORESIGHT_TPDM=y
CONFIG_CORESIGHT_DBGUI=y
CONFIG_CORESIGHT_STM=y
CONFIG_CORESIGHT_HWEVENT=y
CONFIG_CORESIGHT_ETMV4=y
CONFIG_CORESIGHT_REMOTE_ETM=y
CONFIG_CORESIGHT_QPDI=y
CONFIG_MSM_DEBUG_LAR_UNLOCK=y
#flags to check the corruption
CONFIG_FORCE_PAGES=y
CONFIG_FREE_PAGES_RDONLY=y
CONFIG_KERNEL_TEXT_RDONLY=y

# Lock Debugging (spinlocks)
CONFIG_DEBUG_SPINLOCK=y
CONFIG_DEBUG_SPINLOCK_PANIC_ON_BUG=y
CONFIG_DEBUG_LOCK_ALLOC=y

# SEC DEBUG features
CONFIG_USER_RESET_DEBUG_TEST=y
CONFIG_SEC_DEBUG_FORCE_ERROR=y

# Rooting Prevention
# CONFIG_SEC_RESTRICT_ROOTING is not set
# CONFIG_SEC_RESTRICT_SETUID is not set
# CONFIG_SEC_RESTRICT_FORK is not set
# CONFIG_SEC_RESTRICT_ROOTING_LOG is not set
```

## arch/arm64/configs/msm8953_sec_gtaxlqlte_usa_spr_defconfig
```kconfig
# msm8953_sec_gtaxlqlte_usa_spr_defconfig

#
# BSP
#
CONFIG_SEC_MSM8953_PROJECT=y
CONFIG_SEC_GTAXLQLTE_USA_SPR=y

#
# Display
#
CONFIG_PANEL_HX8279_TV101WUM_1_WUXGA=y
CONFIG_FB_MSM_MDSS_SAMSUNG=y
CONFIG_PANEL_POWER_ISL98608=y

# BATTERY & Charger
CONFIG_SAMSUNG_LPM_MODE=y
CONFIG_BATTERY_SAMSUNG=y
# CONFIG_AFC_CHARGER_MODE is not set
CONFIG_PREVENT_SOC_JUMP=y
CONFIG_SEC_MPP_SHARE=y
CONFIG_SW_SELF_DISCHARGING=y
CONFIG_CHARGER_SM5703=y
CONFIG_FUELGAUGE_SM5703=y
CONFIG_BATTERY_SWELLING=y
CONFIG_INBATVOLT_FG=y
CONFIG_SW_SELF_DISCHARGING=y

#
# InputDevice
#
CONFIG_TOUCHSCREEN_FTS7=y
CONFIG_TOUCHSCREEN_DUMP_MODE=y
# CONFIG_SECURE_TOUCH is not set

# CONFIG_MFD_SM5705 is not set
# CONFIG_SM5705_SUPPORT_GAMEPAD is not set
CONFIG_MFD_SM5703=y
CONFIG_REGULATOR_SM5703=y

#
# Sensor
#
CONFIG_SENSORS=y
CONFIG_SENSORS_CORE=y
CONFIG_SENSORS_K2HH=y
CONFIG_SENSORS_CM3323=y
CONFIG_SENSORS_SX9306=y
CONFIG_SENSORS_SX9306_WIFI=y
CONFIG_SENSORS_GRIP_CHK_HALLIC=y

#HALL IC
CONFIG_SENSORS_HALL=y
# CONFIG_CERTIFY_HALL is not set

#
# MUIC
#
CONFIG_USE_MUIC=y
CONFIG_MUIC_NOTIFIER=y
CONFIG_MUIC_UNIVERSAL=y
CONFIG_MUIC_UNIVERSAL_SM5703=y
# CONFIG_MUIC_UNIVERSAL_SM5705 is not set
# CONFIG_MUIC_UNIVERSAL_SM5705_AFC is not set
CONFIG_MUIC_PINCTRL=y
CONFIG_USB_HOST_NOTIFY=y
CONFIG_MUIC_SUPPORT_RUSTPROOF=y
CONFIG_MUIC_SUPPORT_LANHUB=y

#
# MOTOR
#
CONFIG_MSM_VIBRATOR=y
# CONFIG_DC_MOTOR_PMIC is not set

#
# NFC ESE
#

#EEPROM
CONFIG_GET_REAR_MODULE_ID=y

#FLASH
CONFIG_FLASHLIGHT=y
CONFIG_SM_FLASH_LED=y
CONFIG_FLED_SM5703=y

#CAMERA
CONFIG_SR259=y
CONFIG_ACTIVE_FLASH=y

#
# Audio
#
CONFIG_SND_SOC_MSM8X16_RT5659=y
# CONFIG_SND_SOC_MSM8X16 is not set

# Earjack
CONFIG_SAMSUNG_JACK=y

# undefine hbtp
CONFIG_INPUT_HBTP_INPUT=n

#Power off Alarm
# CONFIG_RTC_AUTO_PWRON is not set

# Legacy alarm dev
# CONFIG_ANDROID_INTF_ALARM_DEV is not set

# Service LED
# CONFIG_LEDS_SM5705_RGB is not set

# MMC
CONFIG_SEC_HYBRID_TRAY=y

# Scheduler
CONFIG_SEC_ADAPTIVE_LOAD_TRACKING=y

# SDP and DLP
CONFIG_SDP=y
CONFIG_DLP=y

# SSWAP
CONFIG_SWAP=y
CONFIG_FRONTSWAP=y
CONFIG_ZSMALLOC=y
CONFIG_ZSMALLOC_STAT=y
CONFIG_ZSMALLOC_OBJ_SEQ=n
CONFIG_PGTABLE_MAPPING=y
CONFIG_ZSWAP=y
CONFIG_ZSWAP_COMPACTION=y
CONFIG_ZSWAP_ENABLE_WRITEBACK=n
CONFIG_ZPOOL=y
CONFIG_DIRECT_RECLAIM_FILE_PAGES_ONLY=y
CONFIG_INCREASE_MAXIMUM_SWAPPINESS=y
CONFIG_FIX_INACTIVE_RATIO=y
CONFIG_TIGHT_PGDAT_BALANCE=y
CONFIG_VNSWAP=y
CONFIG_SWAP_ENABLE_READAHEAD=n

#CPU WEAR LEVELING
CONFIG_SS_THERMAL_CPU_WEAR_LEVEL=y
```

## arch/arm64/configs/msm8953_sec_j7poplte_usa_usc_defconfig
```kconfig
# msm8953_sec_j7poplte_usa_usc_defconfig

#
# BSP
#
CONFIG_SEC_MSM8953_PROJECT=y
CONFIG_SEC_J7POPLTE_USA_USC=y

#
# Display
#
CONFIG_FB_MSM_MDSS_SAMSUNG=y
CONFIG_PANEL_TD4100_5_5_HD=y
CONFIG_BLIC_ISL98611=y

# BATTERY & Charger
CONFIG_SAMSUNG_LPM_MODE=y
CONFIG_BATTERY_SAMSUNG=y
# CONFIG_AFC_CHARGER_MODE is not set
CONFIG_PREVENT_SOC_JUMP=y
CONFIG_SEC_MPP_SHARE=y
CONFIG_CHARGER_SM5703=y
CONFIG_FUELGAUGE_SM5703=y
CONFIG_BATTERY_SWELLING=y
CONFIG_INBATVOLT_FG=y
CONFIG_CHARGER_SM5703_DUALPATH=y
CONFIG_BATTERY_CISD=y
CONFIG_BATTERY_AGE_FORECAST=y
CONFIG_BATTERY_AGE_FORECAST_DETACHABLE=y

#
# InputDevice
#
CONFIG_SEC_INCELL=y
CONFIG_TOUCHSCREEN_SYNAPTICS_INCELL=y
CONFIG_KEYBOARD_TC3XXK=y
CONFIG_TOUCHKEY_GRIP=y


# CONFIG_MFD_SM5705 is not set
# CONFIG_SM5705_SUPPORT_GAMEPAD is not set
CONFIG_MFD_SM5703=y
CONFIG_REGULATOR_SM5703=y

#SENSORS
CONFIG_SENSORS=y
CONFIG_SENSORS_CORE=y
CONFIG_SENSORS_STK3013=y
CONFIG_SENSORS_K2HH=y
CONFIG_ST_LSM6DS3=y
CONFIG_ST_LSM6DS3_I2C=y
CONFIG_SENSORS_YAS537=y


#HALL IC
CONFIG_SENSORS_HALL=y
# CONFIG_CERTIFY_HALL is not set

#
# MUIC
#
CONFIG_USE_MUIC=y
CONFIG_MUIC_NOTIFIER=y
CONFIG_MUIC_UNIVERSAL=y
CONFIG_MUIC_UNIVERSAL_SM5703=y
# CONFIG_MUIC_UNIVERSAL_SM5705 is not set
# CONFIG_MUIC_UNIVERSAL_SM5705_AFC is not set
CONFIG_MUIC_PINCTRL=y
CONFIG_USB_HOST_NOTIFY=y
CONFIG_MUIC_SUPPORT_RUSTPROOF=y

#
# MOTOR
#
CONFIG_MSM_VIBRATOR=y
# CONFIG_DC_MOTOR_PMIC is not set

#
# NFC ESE
#

#FLASH
CONFIG_FLASHLIGHT=y
CONFIG_SM_FLASH_LED=y
CONFIG_FLED_SM5703=y

#CAMERA
CONFIG_S5K5E3YX=y
CONFIG_ACTIVE_FLASH=y

#EEPROM
CONFIG_GET_REAR_MODULE_ID=y
#CONFIG_GET_FRONT_MODULE_ID=y

#AUDIO
# CONFIG_SLIMBUS is not set
# CONFIG_SLIMBUS_MSM_NGD is not set
# CONFIG_SOUNDWIRE is not set

# Earjack
CONFIG_SAMSUNG_JACK=y

# undefine hbtp
CONFIG_INPUT_HBTP_INPUT=n

#Power off Alarm
# CONFIG_RTC_AUTO_PWRON is not set

# Legacy alarm dev
# CONFIG_ANDROID_INTF_ALARM_DEV is not set

# Service LED
# CONFIG_LEDS_SM5705_RGB is not set

# MMC
CONFIG_SEC_HYBRID_TRAY=y

# Scheduler
CONFIG_SEC_ADAPTIVE_LOAD_TRACKING=y

# SDP and DLP
CONFIG_SDP=y
CONFIG_DLP=y

# SSWAP
CONFIG_SWAP=y
CONFIG_FRONTSWAP=y
CONFIG_ZSMALLOC=y
CONFIG_ZSMALLOC_STAT=y
CONFIG_ZSMALLOC_OBJ_SEQ=n
CONFIG_PGTABLE_MAPPING=y
CONFIG_ZSWAP=y
CONFIG_ZSWAP_COMPACTION=y
CONFIG_ZSWAP_ENABLE_WRITEBACK=n
CONFIG_ZPOOL=y
CONFIG_DIRECT_RECLAIM_FILE_PAGES_ONLY=y
CONFIG_INCREASE_MAXIMUM_SWAPPINESS=y
CONFIG_FIX_INACTIVE_RATIO=y
CONFIG_TIGHT_PGDAT_BALANCE=y
CONFIG_VNSWAP=y
CONFIG_SWAP_ENABLE_READAHEAD=n
CONFIG_BALANCE_ANON_FILE_RECLAIM=y

CONFIG_MMAP_READAROUND_LIMIT=16

#CPU WEAR LEVELING
CONFIG_SS_THERMAL_CPU_WEAR_LEVEL=y

#Disabling slub debug on user binary as in N OS
CONFIG_SLUB_DEBUG=n
```

## arch/arm64/configs/msm8953_sec_msm8953lte_chn_defconfig
```kconfig
# msm8953_sec_msm8953lte_chn_defconfig

#
# BSP
#
CONFIG_SEC_MSM8953_PROJECT=y
CONFIG_SEC_MSM8953LTE_CHN=y

#
# Display
#
CONFIG_PANEL_S6E3FA3_AMS598KH01_FHD=y
CONFIG_FB_MSM_MDSS_SAMSUNG=y

# BATTERY & Charger
CONFIG_SAMSUNG_LPM_MODE=y
CONFIG_BATTERY_SAMSUNG=y
CONFIG_AFC_CHARGER_MODE=y
CONFIG_PREVENT_SOC_JUMP=y
CONFIG_CHARGER_SM5705=y
CONFIG_FUELGAUGE_SM5705=y
CONFIG_SEC_MPP_SHARE=y
CONFIG_SW_SELF_DISCHARGING=y
CONFIG_BATTERY_SWELLING=y

#
# InputDevice
#
CONFIG_TOUCHSCREEN_MELFAS_MMS449=y
# CONFIG_KEYBOARD_ABOV_TOUCH_18XX is not set
# CONFIG_KEYBOARD_ABOV_TOUCH_16XX is not set
# CONFIG_TOUCHSCREEN_DUMP_MODE is not set
# CONFIG_SECURE_TOUCH is not set
CONFIG_KEYBOARD_ABOV_TOUCH_18XX=y
# CONFIG_KEYBOARD_ABOV_TOUCH_16XX is not set

CONFIG_MFD_SM5705=y

# Finger print sensor
CONFIG_SENSORS_FINGERPRINT=y
CONFIG_SENSORS_FINGERPRINT_SYSFS=y
CONFIG_SENSORS_VFS7XXX=y
CONFIG_SENSORS_ET320=y
CONFIG_SENSORS_FINGERPRINT_DUALIZATION=y
CONFIG_SENSORS_FP_SPI_NUMBER=4
CONFIG_SENSORS_FP_SPI_GPIO_START=12
CONFIG_SENSORS_FP_SPI_GPIO_END=15
# CONFIG_SENSORS_FP_LOCKSCREEN_MODE is not set

#
# Sensor
#
CONFIG_SENSORS=y
CONFIG_SENSORS_CORE=y
CONFIG_SENSORS_SSC=y
CONFIG_SENSORS_BHI=y
CONFIG_IIO_BUFFER=y
CONFIG_IIO=y
CONFIG_IIO_KFIFO_BUF=y
CONFIG_IIO_TRIGGER=y
CONFIG_IIO_ST_HWMON=y
CONFIG_SENSORS_CM36655=y
CONFIG_SENSORS_CM36655_LEDA_EN_GPIO=y
CONFIG_SENSOR_CM36655_VIO=y
CONFIG_SENSORS_AK09916C=y
CONFIG_SENSORS_SW_RESET=y

#HALL IC
CONFIG_SENSORS_HALL=y
CONFIG_CERTIFY_HALL=y

#
# MUIC
#
CONFIG_USE_MUIC=y
CONFIG_MUIC_NOTIFIER=y
CONFIG_MUIC_UNIVERSAL=y
CONFIG_MUIC_UNIVERSAL_SM5705=y
CONFIG_MUIC_UNIVERSAL_SM5705_AFC=y
CONFIG_MUIC_PINCTRL=y
CONFIG_USB_HOST_NOTIFY=y
# CONFIG_MUIC_SUPPORT_RUSTPROOF is not set

#
# MOTOR
#
CONFIG_MSM_VIBRATOR=y

#
# NFC
#
CONFIG_SAMSUNG_NFC=y
CONFIG_SEC_NFC=y
CONFIG_ESE_P3=y

#
# Audio
#
CONFIG_SND_SOC_MSM8X16_RT5659=y
# CONFIG_SND_SOC_MSM8X16 is not set

# Earjack
CONFIG_SAMSUNG_JACK=y

# undefine hbtp
CONFIG_INPUT_HBTP_INPUT=n

#MMC
CONFIG_SEC_HYBRID_TRAY=y

#Power off Alarm
CONFIG_RTC_AUTO_PWRON=y
```

## arch/arm64/configs/msm8953_sec_on7xlte_chn_defconfig
```kconfig
# msm8953_sec_on7xlte_chn_defconfig

#
# BSP
#
CONFIG_SEC_ON7XLTE_CHN=y

#
# Display
#
CONFIG_PANEL_TD4300_BS055FHM_FHD=y
CONFIG_FB_MSM_MDSS_SAMSUNG=y
CONFIG_BLIC_ISL98611=y

# BATTERY & Charger
CONFIG_SAMSUNG_LPM_MODE=y
CONFIG_BATTERY_SAMSUNG=y
CONFIG_AFC_CHARGER_MODE=y
CONFIG_PREVENT_SOC_JUMP=y
CONFIG_CHARGER_SM5705=y
CONFIG_FUELGAUGE_SM5705=y
CONFIG_SEC_MPP_SHARE=y
CONFIG_SW_SELF_DISCHARGING=y
CONFIG_BATTERY_SWELLING=y
# CONFIG_MULTI_CHARGING is not set
# CONFIG_STEP_CHARGING is not set
# CONFIG_CHARGER_DA9155 is not set
#
# InputDevice
#
CONFIG_KEYBOARD_MELFAS_MHS204=y
CONFIG_SEC_INCELL=y
CONFIG_TOUCHSCREEN_SYNAPTICS_INCELL=y
CONFIG_SECURE_TOUCH=y
CONFIG_MFD_SM5705=y
# CONFIG_SM5705_SUPPORT_GAMEPAD is not set
CONFIG_MFD_SM5703=y
CONFIG_REGULATOR_SM5705=y

# Finger print sensor
CONFIG_SENSORS_FINGERPRINT=y
CONFIG_SENSORS_FINGERPRINT_SYSFS=y
CONFIG_SENSORS_ET510=y
CONFIG_SENSORS_FP_SPI_NUMBER=4
CONFIG_SENSORS_FP_SPI_GPIO_START=12
CONFIG_SENSORS_FP_SPI_GPIO_END=15

#
# Sensor
#
CONFIG_SENSORS=y
CONFIG_SENSORS_CORE=y
CONFIG_SENSORS_K2HH=y
CONFIG_SENSORS_STK3013=y

#HALL IC
# CONFIG_SENSORS_HALL is not set

#SVC LEDS
#REV00
CONFIG_LEDS_KTD2026=y
#REV01
CONFIG_LEDS_SM5705_RGB=y 

#
# MUIC
#
CONFIG_USE_MUIC=y
CONFIG_MUIC_NOTIFIER=y
CONFIG_MUIC_UNIVERSAL=y
CONFIG_MUIC_UNIVERSAL_MULTI_SUPPORT=y
CONFIG_MUIC_UNIVERSAL_SM5703=y
CONFIG_MUIC_UNIVERSAL_SM5705=y
CONFIG_MUIC_UNIVERSAL_SM5705_AFC=y
CONFIG_MUIC_PINCTRL=y
CONFIG_USB_HOST_NOTIFY=y
CONFIG_MUIC_SUPPORT_RUSTPROOF=y
CONFIG_MUIC_HV=y

#
# MOTOR
#REV00
CONFIG_MSM_VIBRATOR=y
# CONFIG_DC_MOTOR_PMIC is not set
#REV01
CONFIG_SM5703_VIBRATOR=y

#
# NFC ESE
#
CONFIG_SAMSUNG_NFC=y
CONFIG_NFC_PN547=y

#EEPROM
CONFIG_GET_REAR_MODULE_ID=y

#FLASH
CONFIG_LEDS_SM5705=y
CONFIG_LEDS_SEPARATE_PREFLASH=y
# CONFIG_DUAL_LEDS_FLASH is not set
#
# Audio
#
# CONFIG_SND_SOC_MSM8X16_RT5659 is not set
# CONFIG_MSM_ULTRASOUND is not set
CONFIG_WCD9335_CODEC=y

# Earjack
CONFIG_SAMSUNG_JACK=y

# undefine hbtp
CONFIG_INPUT_HBTP_INPUT=n

#Power off Alarm
CONFIG_RTC_AUTO_PWRON=y

# Legacy alarm dev
CONFIG_ANDROID_INTF_ALARM_DEV=y

# MMC
CONFIG_SEC_HYBRID_TRAY=y

# SDP and DLP
CONFIG_SDP=y
CONFIG_DLP=y

# SSWAP
CONFIG_SWAP=y
CONFIG_FRONTSWAP=y
CONFIG_ZSMALLOC=y
CONFIG_ZSMALLOC_STAT=y
CONFIG_ZSMALLOC_OBJ_SEQ=n
CONFIG_PGTABLE_MAPPING=y
CONFIG_ZSWAP=y
CONFIG_ZSWAP_COMPACTION=y
CONFIG_ZSWAP_ENABLE_WRITEBACK=n
CONFIG_ZPOOL=y
CONFIG_DIRECT_RECLAIM_FILE_PAGES_ONLY=y
CONFIG_INCREASE_MAXIMUM_SWAPPINESS=y
CONFIG_FIX_INACTIVE_RATIO=y
CONFIG_TIGHT_PGDAT_BALANCE=y
CONFIG_VNSWAP=y
CONFIG_SWAP_ENABLE_READAHEAD=n

# WLAN
CONFIG_WLAN_FEATURE_11W=n
```

## arch/arm64/configs/msm8953_sec_userdebug_defconfig
```kconfig
CONFIG_IKCONFIG=y
CONFIG_IKCONFIG_PROC=y

CONFIG_DYNAMIC_DEBUG=y

#
# DS5 Streamline v22
#
CONFIG_HW_PERF_EVENTS=y
CONFIG_PERF_EVENTS=y
CONFIG_FTRACE=y
CONFIG_LOCAL_TIMERS=y
CONFIG_GATOR=m
CONFIG_BLK_DEV_IO_TRACE=y

#
# Samsung Rooting Restriction Feature
#
# CONFIG_SEC_RESTRICT_ROOTING is not set
# CONFIG_SEC_RESTRICT_SETUID is not set
# CONFIG_SEC_RESTRICT_FORK is not set
# CONFIG_SEC_RESTRICT_ROOTING_LOG is not set
```
