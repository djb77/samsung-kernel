## arch/arm64/configs/sdm450_sec_a6plte_mea_open_defconfig
```kconfig
# sdm845_sec_a6plte_mea_open_defconfig

CONFIG_SEC_A6PLTE_PROJECT=y
CONFIG_MACH_A6PLTE_MEA_OPEN=y

#
# Display
#
CONFIG_PANEL_S6E3FA7_AMS604NL01_FHD=y
CONFIG_FB_MSM_MDSS_SAMSUNG=y

# BATTERY configs
CONFIG_BATTERY_SAMSUNG=y
CONFIG_BATTERY_SAMSUNG_V2=y
CONFIG_BATTERY_NOTIFIER=y
CONFIG_SAMSUNG_LPM_MODE=y
CONFIG_BATTERY_SWELLING=y
CONFIG_CHARGER_SM5708=y
CONFIG_FUELGAUGE_SM5708=y
CONFIG_BATTERY_AGE_FORECAST=y
# CONFIG_UPDATE_BATTERY_DATA is not set
CONFIG_BATTERY_CISD=y
CONFIG_SEC_ABC=y
CONFIG_SEC_MPP_SHARE=y

#MUIC configs
CONFIG_MFD_CORE=y
CONFIG_USE_MUIC=y
#CONFIG_MUIC_SUPPORT_CCIC=y
CONFIG_MUIC_NOTIFIER=y
CONFIG_VBUS_NOTIFIER=y
CONFIG_VBUS_NOTIFIER_WORK=y
#CONFIG_MUIC_HV=y is not set
CONFIG_UART3=y

# Audio
CONFIG_SAMSUNG_JACK=y
CONFIG_SND_SOC_TFA9872=y
CONFIG_SEC_SND_ADAPTATION=y
CONFIG_SEC_SND_TFA98XX=y

#MUIC-SM5708

CONFIG_MFD_SM5708=y
CONFIG_MUIC_UNIVERSAL=y
CONFIG_MUIC_UNIVERSAL_SM5708=y
#CONFIG_MUIC_UNIVERSAL_SM5705_AFC is not set
#CONFIG_MUIC_SM5705_SWITCH_CONTROL_GPIO is not set
CONFIG_MUIC_PINCTRL=y
CONFIG_MUIC_UNIVERSAL_MULTI_SUPPORT=y
CONFIG_MUIC_SUPPORT_RUSTPROOF=y

#
# TSP
#
CONFIG_TOUCHSCREEN_SEC_TS=y

# SD card
CONFIG_SEC_HYBRID_TRAY=y

#MOTOR
CONFIG_MSM_VIBRATOR=y

#GPIO EXPANDER
CONFIG_GPIO_PCAL6416A=y

#HALL
CONFIG_SENSORS_HALL=y

#NFC
CONFIG_SAMSUNG_NFC=y
CONFIG_SEC_NFC=y
CONFIG_SEC_NFC_LOGGER=y

#Sensor
CONFIG_SENSORS_CORE=y
CONFIG_SENSORS_CM36657=y
CONFIG_SENSORS_CM36658=y
CONFIG_SENSORS_YAS539=y
CONFIG_SENSORS_LSM6DSL=y
CONFIG_SENSORS_LSM6DSL_I2C=y
CONFIG_SENSORS_A96T3X6=y

#Fingerprint sensor
CONFIG_SENSORS_FINGERPRINT=y
CONFIG_SENSORS_ET5XX=y
CONFIG_SENSORS_FP_SPI_NUMBER=4
CONFIG_SENSORS_FP_SPI_GPIO_START=12
CONFIG_SENSORS_FP_SPI_GPIO_END=15

#FLASH
CONFIG_LEDS_SM5708=y
CONFIG_DUAL_LEDS_FLASH=y
##CONFIG_REAR_DUAL_LED_FLASH=y
CONFIG_FRONT_LED_FLASH=y
##CONFIG_FRONT_DUAL_LED_FLASH=y
CONFIG_LEDS_SEPARATE_PREFLASH=y

#CAMERA
CONFIG_CAMERA_SYSFS_V2=y
CONFIG_GET_REAR_MODULE_ID=y
CONFIG_GET_FRONT_MODULE_ID=y
CONFIG_MSM_FRONT_EEPROM=y
CONFIG_SAMSUNG_MULTI_CAMERA=y
CONFIG_CAMERA_DUAL_REAR=y
#CONFIG_CAMERA_DUAL_FRONT is not set

#EPDG
CONFIG_NET_CORE=y
CONFIG_NET_SCH_PRIO=y
CONFIG_NET_SCHED=y   #depends on CONFIG_NET  which is enabled by default.. coz not seeing in the config file
CONFIG_NET_CLS_BASIC=y # required if basic is being used as a filter. depends on CONFIG_NET_CLS so enabling it by default
CONFIG_NET_CLS=y
CONFIG_NET_CLS_ACT=y # for enabling the action target.
CONFIG_NET_ACT_MIRRED=y  # for enabling the mirred target for redirecting the packet between the devices.
CONFIG_NET_EMATCH=y   #basic uses extended matches so this has to be present
CONFIG_NET_SCH_INGRESS=y # classifier for ingress packet
#EPDG

# SSWAP
CONFIG_SWAP=y
CONFIG_FRONTSWAP=y
CONFIG_ZSMALLOC=y
CONFIG_ZSMALLOC_STAT=y
CONFIG_ZSMALLOC_OBJ_SEQ=n
CONFIG_PGTABLE_MAPPING=y
CONFIG_ZSWAP=y
CONFIG_ZSWAP_COMPACTION=y
CONFIG_ZSWAP_ENABLE_WRITEBACK=n
CONFIG_ZPOOL=y
CONFIG_DIRECT_RECLAIM_FILE_PAGES_ONLY=y
CONFIG_INCREASE_MAXIMUM_SWAPPINESS=y
CONFIG_FIX_INACTIVE_RATIO=y
CONFIG_TIGHT_PGDAT_BALANCE=y
CONFIG_VNSWAP=y
CONFIG_SWAP_ENABLE_READAHEAD=n

CONFIG_MMAP_READAROUND_LIMIT=16

#Wi-Fi
CONFIG_WLAN_USE_OLD_NV=3
```
