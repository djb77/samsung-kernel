## drivers/debug/user_reset/Kconfig
```kconfig
# When adding new entries keep the list in alphabetical order

config USER_RESET_DEBUG
	bool "reset reason debug feature in user version"
	default n
	help
	  This option provides reset history log in user version.
	  This option enable proc/reset_reason support
	  
config SUPPORT_DEBUG_PARTITION
	bool "reset reason & BigData store debug partition feature"
	depends on USER_RESET_DEBUG
	default n
	help
	  This option should be check project pit table. 

config USER_RESET_DEBUG_TEST
	bool "reset reason debug test feature in eng version"
	depends on USER_RESET_DEBUG
	default n
	help
	  This option enable for test in eng version(KP, DP, TP, WP)
```

## drivers/fingerprint/Kconfig
```kconfig
#
# Sensor  drivers configuration
#
menuconfig SENSORS_FINGERPRINT
	bool "Finger Print Sensor devices"
	help
	  Say Y here, and a list of sensors drivers will be displayed.
	  Everything that didn't fit into the other categories is here. This option
	  doesn't affect the kernel.
	  If unsure, say Y.

config SENSORS_FPRINT_SECURE
	tristate "fingerprint sensor support"
	default n
	help
	  If you say yes here you get support for Trustzone.
	  In case of user binary, fingerprint sensor operates within trustzone.
	  If this feature enabled, spi communication is controlled by Trusted Application.
	  Then it should be enabled in the user binary.

config SENSORS_FINGERPRINT_32BITS_PLATFORM_ONLY
	tristate "Fingerprint sensor supports only 32bits platform"
	default n
	help
	  If you say yes here the non TZ device driver will only supports
	  32bits platform.
	  In case of Exynos7580, this feature should be enabled.
	  And you should be use the compat_ioctl not the unlocked_ioctl.

config SENSORS_VFS7XXX
	tristate "VFS7XXX fingerprint sensor support"
	default n
	help
	  Fingerprint sensor driver.
	  If you say yes here you get support for viper2 sensor.
	  Viper2 is the touch type fingerprint sensor.
	  Viper2 82E5 module can support WOG mode.

config SENSORS_VFS8XXX
	tristate "VFS8XXX fingerprint sensor support"
	default n
	help
	  Fingerprint sensor driver.
	  If you say yes here you get support for Namsan sensor.
	  Namsan is the touch type fingerprint sensor.
	  Namsan module can support WOF mode.

config SENSORS_VFS9XXX
	tristate "VFS9XXX fingerprint sensor support"
	default n
	help
	  Fingerprint sensor driver.
	  If you say yes here you get support for CPID sensor.
	  CPID is the indisplay touch type fingerprint sensor.
	  CPID module can not support WOF mode.

config SENSORS_ET5XX
	tristate "ET5XX fingerprint sensor supprot"
	default n
	help
	  Fingerprint sensor driver.
	  If you say yes here you get support for ET5XX sensor.
	  ET5XX is the touch type fingerprint sensor.
	  ET5XX module can support WOF mode.
```

## drivers/five/five_tee_driver/Kconfig
```kconfig
#
# TEE Driver configuration
#

config FIVE_TEE_DRIVER
    bool "Integrity TEE Driver"
    depends on FIVE && QSEECOM
    default y
    help
      Enable Integrity Trusted Execution Environment support

config TEE_DRIVER_DEBUG
    bool "Integrity TEE Driver Debug mode"
    depends on FIVE_TEE_DRIVER
    default n
    help
      Enable Debug mode in TEE Driver

config FIVE_EARLY_LOAD_TRUSTED_APP
    bool "Load trusted application in early boot"
    depends on FIVE_TEE_DRIVER
    default y
    help
      Enable the load of trusted application on during initialization of driver
```

## drivers/gpu/arm/t8xx/Kconfig
```kconfig
#
# (C) COPYRIGHT 2012-2013 ARM Limited. All rights reserved.
#
# This program is free software and is provided to you under the terms of the
# GNU General Public License version 2 as published by the Free Software
# Foundation, and any use by you of this program is subject to the terms
# of such GNU licence.
#
# A copy of the licence is included with the program, and can also be obtained
# from Free Software Foundation, Inc., 51 Franklin Street, Fifth Floor,
# Boston, MA  02110-1301, USA.
#
#


menuconfig MALI_T8XX
	tristate "Mali-T8XX support"
	default n
	help
	  Enable this option to build support for the ARM Mali-T7xx GPU.

	  To compile this driver as a module, choose M here:
	  this will generate a single module, called mali_kbase.

choice
	prompt "version Configuration"
	depends on MALI_T8XX
	default MALI_R9P0
	help
	  Select the gpu support version.




config MALI_R9P0
	depends on MALI_T8XX
	bool "r9p0 driver"

endchoice


if MALI_R9P0
source "drivers/gpu/arm/t8xx/r9p0/Kconfig"
endif
```

## drivers/gpu/arm/tMIx/Kconfig
```kconfig
#
# (C) COPYRIGHT 2012-2013 ARM Limited. All rights reserved.
#
# This program is free software and is provided to you under the terms of the
# GNU General Public License version 2 as published by the Free Software
# Foundation, and any use by you of this program is subject to the terms
# of such GNU licence.
#
# A copy of the licence is included with the program, and can also be obtained
# from Free Software Foundation, Inc., 51 Franklin Street, Fifth Floor,
# Boston, MA  02110-1301, USA.
#
#


config DDK_VERSION_OS
	string "version"
	default ANDROID_MAJOR_VERSION
	help
		Android OS major version

menuconfig MALI_TMIX
	tristate "Mali-TMIX support"
	default n
	help
	  Enable this option to build support for the ARM Mali-T7xx GPU.

	  To compile this driver as a module, choose M here:
	  this will generate a single module, called mali_kbase.

choice
	prompt "version Configuration"
	depends on MALI_TMIX
	default MALI_TMIX_R3P0 if ANDROID_VERSION = "70000"
	default MALI_TMIX_R9P0 if ANDROID_VERSION = "80000"
	default MALI_TMIX_R9P0 if ANDROID_VERSION = "80100"
	default MALI_TMIX_R16P0 if ANDROID_VERSION >= "90000"
	help
	  Select the gpu support version.

config MALI_TMIX_R0P0
	depends on MALI_TMIX
	bool "mimir r0p0 driver"

config MALI_TMIX_R2P0
	depends on MALI_TMIX
	bool "mimir r2p0 driver"

config MALI_TMIX_R3P0
	depends on MALI_TMIX
	bool "mimir r3p0 driver"

config MALI_TMIX_R8P0
	depends on MALI_TMIX
	bool "mimir r8p0 driver"
config MALI_TMIX_R9P0
	depends on MALI_TMIX
	bool "mimir r9p0 driver"

config MALI_TMIX_R16P0
	depends on MALI_TMIX
	bool "Bifrost r16p0 driver"

endchoice

if MALI_TMIX_R0P0
source "drivers/gpu/arm/tMIx/r0p0/Kconfig"
endif

if MALI_TMIX_R2P0
source "drivers/gpu/arm/tMIx/r2p0/Kconfig"
endif

if MALI_TMIX_R3P0
source "drivers/gpu/arm/tMIx/r3p0/Kconfig"
endif

if MALI_TMIX_R8P0
source "drivers/gpu/arm/tMIx/r8p0/Kconfig"
endif

if MALI_TMIX_R9P0
source "drivers/gpu/arm/tMIx/r9p0/Kconfig"
endif

if MALI_TMIX_R16P0
source "drivers/gpu/arm/b_r16p0/Kconfig"
endif
```
