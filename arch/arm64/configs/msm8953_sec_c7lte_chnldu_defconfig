## arch/arm64/configs/msm8953_sec_c7lte_chnldu_defconfig
```kconfig
# msm8953_sec_c7lte_chn_defconfig

#
# BSP
#
CONFIG_SEC_MSM8953_PROJECT=y
CONFIG_SEC_C7LTE_CHN=y
CONFIG_SEC_C7LTE_CHN_LDU=y

#
# Display
#
CONFIG_PANEL_S6E3FA3_AMS568HN31_FHD=y
CONFIG_FB_MSM_MDSS_SAMSUNG=y

# BATTERY & Charger
CONFIG_SAMSUNG_LPM_MODE=y
CONFIG_BATTERY_SAMSUNG=y
CONFIG_AFC_CHARGER_MODE=y
CONFIG_PREVENT_SOC_JUMP=y
CONFIG_CHARGER_SM5705=y
CONFIG_FUELGAUGE_SM5705=y
CONFIG_SEC_MPP_SHARE=y
CONFIG_SW_SELF_DISCHARGING=y
CONFIG_BATTERY_SWELLING=y
CONFIG_MULTI_CHARGING=y
CONFIG_STEP_CHARGING=y
CONFIG_CHARGER_DA9155=y
CONFIG_USE_TEMP_COMPENSATION=n
CONFIG_SEC_MPP_SHARE_LOW_TEMP_WA=y
CONFIG_STORE_MODE=y

#
# InputDevice
#
CONFIG_TOUCHSCREEN_MELFAS_MMS449=y
CONFIG_TOUCHSCREEN_DUMP_MODE=y
CONFIG_SECURE_TOUCH=y
#CONFIG_KEYBOARD_ABOV_TOUCH_18XX is not set
CONFIG_KEYBOARD_ABOV_TOUCH_16XX=y

CONFIG_MFD_SM5705=y
CONFIG_SM5705_SUPPORT_GAMEPAD=y

# Finger print sensor
CONFIG_SENSORS_FINGERPRINT=y
CONFIG_SENSORS_FINGERPRINT_SYSFS=y
CONFIG_SENSORS_VFS7XXX=y
CONFIG_SENSORS_ET320=y
CONFIG_SENSORS_FINGERPRINT_DUALIZATION=y
CONFIG_SENSORS_FP_SPI_NUMBER=4
CONFIG_SENSORS_FP_SPI_GPIO_START=12
CONFIG_SENSORS_FP_SPI_GPIO_END=15
CONFIG_SENSORS_FP_LOCKSCREEN_MODE=y

#
# Sensor
#
CONFIG_SENSORS=y
CONFIG_SENSORS_CORE=y
CONFIG_SENSORS_SSC=y
CONFIG_SENSORS_BHI=y
CONFIG_IIO_BUFFER=y
CONFIG_IIO=y
CONFIG_IIO_KFIFO_BUF=y
CONFIG_IIO_TRIGGER=y
CONFIG_IIO_ST_HWMON=y
CONFIG_SENSORS_SW_RESET=y
CONFIG_SENSORS_TMD3700=y
CONFIG_SENSORS_TMD3700_RESET_DEFENCE_CODE=y
CONFIG_SENSORS_YAS539=y
CONFIG_SENSORS_YAS_RESET_DEFENCE_CODE=y
# CONFIG_SENSORS_YAS539_DEFAULT_MATRIX is not set

#HALL IC
CONFIG_SENSORS_HALL=y
# CONFIG_CERTIFY_HALL is not set

#
# MUIC
#
CONFIG_USE_MUIC=y
CONFIG_MUIC_NOTIFIER=y
CONFIG_MUIC_UNIVERSAL=y
CONFIG_MUIC_UNIVERSAL_SM5705=y
CONFIG_MUIC_UNIVERSAL_SM5705_AFC=y
CONFIG_MUIC_PINCTRL=y
CONFIG_USB_HOST_NOTIFY=y
CONFIG_MUIC_HV=y
# CONFIG_MUIC_SUPPORT_RUSTPROOF is not set

#
# MOTOR
#
CONFIG_MSM_VIBRATOR=y
# CONFIG_DC_MOTOR_PMIC is not set

#
# NFC ESE
#
CONFIG_SAMSUNG_NFC=y
CONFIG_NFC_PN547=y
CONFIG_NFC_PN547_ESE_SUPPORT=y
CONFIG_ESE_SECURE=y
CONFIG_ESE_SECURE_SPI_PORT=1
CONFIG_ESE_SPI_GPIO_START=0
CONFIG_ESE_SPI_GPIO_END=3
# CONFIG_NFC_PM_BBCLK2 is not set

#FLASH
CONFIG_LEDS_SM5705=y
CONFIG_DUAL_LEDS_FLASH=y
#
# Audio
#
CONFIG_SND_SOC_MSM8X16_RT5659=y
# CONFIG_SND_SOC_MSM8X16 is not set

# Earjack
CONFIG_SAMSUNG_JACK=y

# undefine hbtp
CONFIG_INPUT_HBTP_INPUT=n

#Power off Alarm
CONFIG_RTC_AUTO_PWRON=y

# Legacy alarm dev
CONFIG_ANDROID_INTF_ALARM_DEV=y

# Service LED
CONFIG_LEDS_SM5705_RGB=y

# MMC
CONFIG_SEC_HYBRID_TRAY=y

# Scheduler
# CONFIG_SEC_ADAPTIVE_LOAD_TRACKING is not set

# SDP and DLP
CONFIG_SDP=y
CONFIG_DLP=y

# SSWAP
CONFIG_SWAP=y
CONFIG_FRONTSWAP=y
CONFIG_ZSMALLOC=y
CONFIG_ZSMALLOC_STAT=y
CONFIG_ZSMALLOC_OBJ_SEQ=n
CONFIG_PGTABLE_MAPPING=y
CONFIG_ZSWAP=y
CONFIG_ZSWAP_COMPACTION=y
CONFIG_ZSWAP_ENABLE_WRITEBACK=n
CONFIG_ZPOOL=y
CONFIG_DIRECT_RECLAIM_FILE_PAGES_ONLY=y
CONFIG_INCREASE_MAXIMUM_SWAPPINESS=y
CONFIG_FIX_INACTIVE_RATIO=y
CONFIG_TIGHT_PGDAT_BALANCE=y
CONFIG_VNSWAP=y
CONFIG_SWAP_ENABLE_READAHEAD=n

#CPU WEAR LEVELING
CONFIG_SS_THERMAL_CPU_WEAR_LEVEL=y

# WLAN
CONFIG_WLAN_FEATURE_11W=n
```
