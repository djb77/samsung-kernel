## arch/arm64/configs/sdm450_sec_eng_defconfig
```kconfig
########################################################################################
# SAMSUNG SDM450 project : Diff between msmcortex-perf_defconfig and msmcortex_defconfig
########################################################################################
CONFIG_CMA_DEBUGFS=y
CONFIG_MSM_CAMERA_DEBUG=y
CONFIG_MSMB_CAMERA_DEBUG=y
CONFIG_FB_VIRTUAL=y
CONFIG_LT8912=y
CONFIG_IPA3=y
CONFIG_GSI=y
CONFIG_RMNET_IPA3=y
# CONFIG_MSM_SPMI_DEBUGFS_RO is not set
CONFIG_IOMMU_DEBUG=y
CONFIG_IOMMU_DEBUG_TRACKING=y
CONFIG_IOMMU_TESTS=y
CONFIG_MSM_GLADIATOR_ERP=y
CONFIG_PANIC_ON_GLADIATOR_ERROR=y
CONFIG_MSM_GLADIATOR_ERP_V2=y
CONFIG_PANIC_ON_GLADIATOR_ERROR_V2=y
CONFIG_MSM_DEBUG_LAR_UNLOCK=y
CONFIG_MSM_CORE_HANG_DETECT=y
CONFIG_MSM_GLADIATOR_HANG_DETECT=y
CONFIG_MSM_DCC=y
CONFIG_MSM_IPC_ROUTER_GLINK_XPRT=y
CONFIG_MSM_GLINK_PKT=y
CONFIG_TRACER_PKT=y
CONFIG_CORESIGHT_FUSE=y
CONFIG_CORESIGHT_CTI=y
CONFIG_CORESIGHT_TPIU=y
CONFIG_CORESIGHT_TPDA=y
CONFIG_CORESIGHT_TPDM=y
CONFIG_CORESIGHT_DBGUI=y
CONFIG_CORESIGHT_HWEVENT=y
CONFIG_CORESIGHT_ETMV4=y
CONFIG_CORESIGHT_REMOTE_ETM=y
CONFIG_CORESIGHT_QPDI=y
CONFIG_EXT2_FS=y
CONFIG_EXT2_FS_XATTR=y
CONFIG_EXT3_FS=y
# CONFIG_EXT3_DEFAULTS_TO_ORDERED is not set
CONFIG_MSDOS_FS=y
CONFIG_LOG_BUF_MAGIC=y
CONFIG_DYNAMIC_DEBUG=y
CONFIG_PAGE_OWNER=y
CONFIG_SLUB_DEBUG_PANIC_ON=y
CONFIG_SLUB_DEBUG_ON=y
CONFIG_DEBUG_KMEMLEAK=y
CONFIG_DEBUG_KMEMLEAK_EARLY_LOG_SIZE=4000
CONFIG_DEBUG_KMEMLEAK_DEFAULT_OFF=y
CONFIG_DEBUG_STACK_USAGE=y
CONFIG_DEBUG_MEMORY_INIT=y
CONFIG_LOCKUP_DETECTOR=y
CONFIG_BOOTPARAM_SOFTLOCKUP_PANIC=y
# CONFIG_DETECT_HUNG_TASK is not set
CONFIG_PANIC_ON_SCHED_BUG=y
CONFIG_PANIC_ON_RT_THROTTLING=y
CONFIG_DEBUG_SPINLOCK=y
CONFIG_DEBUG_MUTEXES=y
CONFIG_DEBUG_ATOMIC_SLEEP=y
CONFIG_DEBUG_LIST=y
CONFIG_FAULT_INJECTION=y
CONFIG_FAIL_PAGE_ALLOC=y
CONFIG_UFS_FAULT_INJECTION=y
CONFIG_FAULT_INJECTION_DEBUG_FS=y
CONFIG_FAULT_INJECTION_STACKTRACE_FILTER=y
CONFIG_MSM_RTB=y
CONFIG_MSM_RTB_SEPARATE_CPUS=y
CONFIG_BLK_DEV_IO_TRACE=y
#CONFIG_LKDTM is not set
CONFIG_PANIC_ON_DATA_CORRUPTION=y
CONFIG_FREE_PAGES_RDONLY=y
CONFIG_ENG_BATTERY_CONCEPT=y

#
# DS5 Streamline v22
#
CONFIG_HW_PERF_EVENTS=y
CONFIG_PERF_EVENTS=y
CONFIG_FTRACE=y
CONFIG_HIGH_RES_TIMERS=y
CONFIG_LOCAL_TIMERS=y
CONFIG_GATOR=m

#
# Kernel Atrace
#
CONFIG_KERNEL_ATRACE=y


#
# TIMA RKP
#
# CONFIG_RKP_KDP is not set
# CONFIG_RKP_NS_PROT is not set

#
# Enable SEC_PM Feature
#
CONFIG_SEC_GPIO_DVS=y

#QDSS debug flags
CONFIG_CORESIGHT=y
CONFIG_CORESIGHT_EVENT=y
CONFIG_CORESIGHT_FUSE=y
CONFIG_CORESIGHT_CTI=y
CONFIG_CORESIGHT_CTI_SAVE_DISABLE=y
CONFIG_CORESIGHT_TMC=y
CONFIG_CORESIGHT_TPIU=y
CONFIG_CORESIGHT_FUNNEL=y
CONFIG_CORESIGHT_REPLICATOR=y
CONFIG_CORESIGHT_TPDA=y
CONFIG_CORESIGHT_TPDM=y
CONFIG_CORESIGHT_DBGUI=y
CONFIG_CORESIGHT_STM=y
CONFIG_CORESIGHT_HWEVENT=y
CONFIG_CORESIGHT_ETMV4=y
CONFIG_CORESIGHT_REMOTE_ETM=y
CONFIG_CORESIGHT_QPDI=y
CONFIG_MSM_DEBUG_LAR_UNLOCK=y
#flags to check the corruption
CONFIG_FORCE_PAGES=y
CONFIG_FREE_PAGES_RDONLY=y
CONFIG_KERNEL_TEXT_RDONLY=y

# Lock Debugging (spinlocks)
CONFIG_DEBUG_SPINLOCK=y
CONFIG_DEBUG_SPINLOCK_PANIC_ON_BUG=y
CONFIG_DEBUG_LOCK_ALLOC=y

# SEC DEBUG features
CONFIG_USER_RESET_DEBUG_TEST=y
CONFIG_SEC_DEBUG_FORCE_ERROR=y

# Rooting Prevention
# CONFIG_SEC_RESTRICT_ROOTING is not set
# CONFIG_SEC_RESTRICT_SETUID is not set
# CONFIG_SEC_RESTRICT_FORK is not set
# CONFIG_SEC_RESTRICT_ROOTING_LOG is not set

#knox test
CONFIG_KNOX_TEST=y

#debug features
CONFIG_CLEANCACHE=y
CONFIG_PM_DEBUG=y
CONFIG_L2TP_DEBUGFS=y
CONFIG_REGMAP_ALLOW_WRITE_DEBUGFS=y
CONFIG_INPUT_KEYCHORD=y
CONFIG_MMC_PARANOID_SD_INIT=y
CONFIG_MSM_SMD_DEBUG=y
CONFIG_CORESIGHT=y
CONFIG_CORESIGHT_EVENT=y
CONFIG_CORESIGHT_TMC=y
CONFIG_CORESIGHT_FUNNEL=y
CONFIG_CORESIGHT_REPLICATOR=y
CONFIG_CORESIGHT_STM=y
```

## arch/arm64/configs/sdm450_sec_gta2xllte_cis_ser_defconfig
```kconfig
# sdm450_sec_gta2xllte_cis_ser_defconfig

CONFIG_SEC_GTA2XLLTE_PROJECT=y
CONFIG_MACH_GTA2XLLTE_EUR_OPEN=y

#
# Display
#
CONFIG_PANEL_HX8279_TV101WUM_WUXGA=y
CONFIG_FB_MSM_MDSS_SAMSUNG=y
CONFIG_PANEL_POWER_ISL98608=y
CONFIG_SAMSUNG_12_8MHZ_ESC_CLOCK=y

# BATTERY configs
CONFIG_BATTERY_SAMSUNG=y
CONFIG_BATTERY_SAMSUNG_V2=y
CONFIG_BATTERY_NOTIFIER=y
CONFIG_MULTI_PORT_CHARGING=y
CONFIG_SAMSUNG_LPM_MODE=y
CONFIG_BATTERY_SWELLING=y
CONFIG_CHARGER_S2MU004=y
CONFIG_FUELGAUGE_S2MU004=y
CONFIG_CHARGER_BQ25898S=y
CONFIG_SEC_MPP_SHARE=y
CONFIG_TABLET_MODEL_CONCEPT=y
CONFIG_BATTERY_AGE_FORECAST=y
CONFIG_BATTERY_CISD=y
CONFIG_AFC_CHARGER_MODE=y
CONFIG_NEW_FACTORY_MODE=y

#MUIC configs
CONFIG_MFD_CORE=y
CONFIG_MFD_S2MU004=y
CONFIG_USE_MUIC=y
CONFIG_MUIC_S2MU004=y
CONFIG_MUIC_SUPPORT_CCIC=y
CONFIG_MUIC_NOTIFIER=y
CONFIG_MUIC_HV=y
CONFIG_VBUS_NOTIFIER=y
CONFIG_VBUS_NOTIFIER_WORK=y
CONFIG_UART3=y
CONFIG_HICCUP_CHARGER=y
CONFIG_MUIC_KEYBOARD=y

# Audio
CONFIG_SEC_SND_DEBUG=y
CONFIG_SND_SOC_MSM8X16_RT5665=y
# CONFIG_SND_SOC_MSM8X16 is not set
# CONFIG_SAMSUNG_JACK is not set
CONFIG_SND_SOC_TFA9896=y
CONFIG_SEC_SND_ADAPTATION=y
CONFIG_SND_SOC_TDM_INTF=y
# DBMD
CONFIG_SND_SOC_DBMDX=y
CONFIG_SND_SOC_DBMDX_SND_CAPTURE=y

# CCIC(needs to be fixed)
CONFIG_CCIC_S2MM003=y
CONFIG_CCIC_S2MM005=y

CONFIG_CCIC_NOTIFIER=y
CONFIG_USB_TYPEC_MANAGER_NOTIFIER=y
CONFIG_CCIC_TEMP_BLOCK=y

CONFIG_CCIC_ALTERNATE_MODE=y
# CONFIG_CCIC_DP_COMMUNICATION is not set
# CONFIG_SEC_EXT is not set
# CONFIG_SEC_SYSFS is not set
CONFIG_CCIC_LPM_ENABLE=y
CONFIG_DUAL_ROLE_USB_INTF=y
CONFIG_USB_OTG_WHITELIST_FOR_MDM=y

# TSP
#
CONFIG_TOUCHSCREEN_FTS1BA90A=y
CONFIG_TOUCHSCREEN_DUMP_MODE=y
CONFIG_SEC_DEBUG_TSP_LOG=y

# SD card
CONFIG_SEC_HYBRID_TRAY=y

#MOTOR
CONFIG_MSM_VIBRATOR=y

#SVCLED
#CONFIG_LEDS_SM5705_RGB=y

#HALL
CONFIG_SENSORS_HALL=y

#FLASH
CONFIG_FLASHLIGHT=y
CONFIG_ACTIVE_FLASH=y
CONFIG_LEDS_KTD2692=y

#CAMERA
CONFIG_S5K5E3YX=y
CONFIG_CAMERA_SYSFS_V2=y
CONFIG_MSM_FRONT_OTP=y

#EEPROM
CONFIG_GET_REAR_MODULE_ID=y

#Sensor
CONFIG_SENSORS_CORE=y
CONFIG_SENSORS_CM3323=y
CONFIG_SENSORS_YAS539=y
CONFIG_SENSORS_LSM6DSL=y
CONFIG_SENSORS_LSM6DSL_I2C=y
CONFIG_SENSORS_SX9320=y
CONFIG_SENSORS_SX9320_SUB=y
CONFIG_SENSORS_SX9320_WIFI=y

#Fingerprint sensor
CONFIG_SENSORS_FINGERPRINT=y
CONFIG_SENSORS_ET5XX=y
CONFIG_SENSORS_FP_SPI_NUMBER=4
CONFIG_SENSORS_FP_SPI_GPIO_START=12
CONFIG_SENSORS_FP_SPI_GPIO_END=15
```

## arch/arm64/configs/sdm450_sec_j6plte_cis_ser_defconfig
```kconfig
# sdm845_sec_j8plte_cis_ser_defconfig

CONFIG_SEC_J6PLTE_PROJECT=y
CONFIG_MACH_J6PLTE_CIS_SER=y

#
# Display
#
CONFIG_PANEL_S6E3FA7_AMS604NL01_FHD=y
CONFIG_FB_MSM_MDSS_SAMSUNG=y

# BATTERY configs
CONFIG_BATTERY_SAMSUNG=y
CONFIG_BATTERY_SAMSUNG_V2=y
CONFIG_BATTERY_NOTIFIER=y
CONFIG_SAMSUNG_LPM_MODE=y
CONFIG_BATTERY_SWELLING=y
CONFIG_CHARGER_SM5708=y
CONFIG_FUELGAUGE_SM5708=y
CONFIG_BATTERY_AGE_FORECAST=y
# CONFIG_UPDATE_BATTERY_DATA is not set
CONFIG_BATTERY_CISD=y
CONFIG_SEC_ABC=y
CONFIG_SEC_MPP_SHARE=y

#MUIC configs
CONFIG_MFD_CORE=y
CONFIG_USE_MUIC=y
#CONFIG_MUIC_SUPPORT_CCIC=y
CONFIG_MUIC_NOTIFIER=y
CONFIG_VBUS_NOTIFIER=y
CONFIG_VBUS_NOTIFIER_WORK=y
#CONFIG_MUIC_HV=y is not set
CONFIG_UART3=y

# Audio
CONFIG_SAMSUNG_JACK=y
CONFIG_SND_SOC_TFA9896=y
CONFIG_SEC_SND_ADAPTATION=y
CONFIG_SEC_SND_TFA98XX=y

#MUIC-SM5708

CONFIG_MFD_SM5708=y
CONFIG_MUIC_UNIVERSAL=y
CONFIG_MUIC_UNIVERSAL_SM5708=y
#CONFIG_MUIC_UNIVERSAL_SM5705_AFC is not set
#CONFIG_MUIC_SM5705_SWITCH_CONTROL_GPIO is not set
CONFIG_MUIC_PINCTRL=y
CONFIG_MUIC_UNIVERSAL_MULTI_SUPPORT=y

#
# TSP
#
CONFIG_TOUCHSCREEN_ZINITIX_ZT75XX_TCLM=y
# temp
CONFIG_INPUT_TOUCHSCREEN_TCLMV2=n
CONFIG_INPUT_TOUCHSCREEN_TCLM=y

# SD card
CONFIG_SEC_HYBRID_TRAY=y

#MOTOR
CONFIG_MSM_VIBRATOR=y

#GPIO EXPANDER
CONFIG_GPIO_PCAL6416A=y

#HALL
CONFIG_SENSORS_HALL=y

#NFC
CONFIG_SAMSUNG_NFC=y
CONFIG_SEC_NFC=y
CONFIG_SEC_NFC_LOGGER=y

#Sensor
CONFIG_SENSORS_CORE=y
CONFIG_SENSORS_CM36657=y
CONFIG_SENSORS_CM36658=y
CONFIG_SENSORS_YAS539=y
CONFIG_SENSORS_LSM6DSL=y
CONFIG_SENSORS_LSM6DSL_I2C=y
CONFIG_SENSORS_A96T3X6=y

#Fingerprint sensor
CONFIG_SENSORS_FINGERPRINT=y
CONFIG_SENSORS_ET5XX=y
CONFIG_SENSORS_FP_SPI_NUMBER=4
CONFIG_SENSORS_FP_SPI_GPIO_START=12
CONFIG_SENSORS_FP_SPI_GPIO_END=15

#FLASH
CONFIG_LEDS_SM5708=y
CONFIG_DUAL_LEDS_FLASH=y
##CONFIG_REAR_DUAL_LED_FLASH=y
CONFIG_FRONT_LED_FLASH=y
##CONFIG_FRONT_DUAL_LED_FLASH=y
CONFIG_LEDS_SEPARATE_PREFLASH=y

#CAMERA
CONFIG_CAMERA_SYSFS_V2=y
CONFIG_GET_REAR_MODULE_ID=y
CONFIG_GET_FRONT_MODULE_ID=y
CONFIG_MSM_FRONT_EEPROM=y
CONFIG_SAMSUNG_MULTI_CAMERA=y
CONFIG_CAMERA_DUAL_REAR=y
#CONFIG_CAMERA_DUAL_FRONT is not set

#EPDG
CONFIG_NET_CORE=y
CONFIG_NET_SCH_PRIO=y
CONFIG_NET_SCHED=y   #depends on CONFIG_NET  which is enabled by default.. coz not seeing in the config file
CONFIG_NET_CLS_BASIC=y # required if basic is being used as a filter. depends on CONFIG_NET_CLS so enabling it by default
CONFIG_NET_CLS=y
CONFIG_NET_CLS_ACT=y # for enabling the action target.
CONFIG_NET_ACT_MIRRED=y  # for enabling the mirred target for redirecting the packet between the devices.
CONFIG_NET_EMATCH=y   #basic uses extended matches so this has to be present
CONFIG_NET_SCH_INGRESS=y # classifier for ingress packet
#EPDG

# SSWAP
CONFIG_SWAP=y
CONFIG_FRONTSWAP=y
CONFIG_ZSMALLOC=y
CONFIG_ZSMALLOC_STAT=y
CONFIG_ZSMALLOC_OBJ_SEQ=n
CONFIG_PGTABLE_MAPPING=y
CONFIG_ZSWAP=y
CONFIG_ZSWAP_COMPACTION=y
CONFIG_ZSWAP_ENABLE_WRITEBACK=n
CONFIG_ZPOOL=y
CONFIG_DIRECT_RECLAIM_FILE_PAGES_ONLY=y
CONFIG_INCREASE_MAXIMUM_SWAPPINESS=y
CONFIG_FIX_INACTIVE_RATIO=y
CONFIG_TIGHT_PGDAT_BALANCE=y
CONFIG_VNSWAP=y
CONFIG_SWAP_ENABLE_READAHEAD=n

#Wi-Fi
CONFIG_WLAN_USE_OLD_NV=3
```

## arch/arm64/configs/sdm450_sec_j8plte_cis_ser_defconfig
```kconfig
# sdm845_sec_j8plte_cis_ser_defconfig

CONFIG_SEC_J8PLTE_PROJECT=y
CONFIG_MACH_J8PLTE_CIS_SER=y

#
# Display
#
CONFIG_PANEL_S6E3FA7_AMS604NL01_FHD=y
CONFIG_FB_MSM_MDSS_SAMSUNG=y

# BATTERY configs
CONFIG_BATTERY_SAMSUNG=y
CONFIG_BATTERY_SAMSUNG_V2=y
CONFIG_BATTERY_NOTIFIER=y
CONFIG_SAMSUNG_LPM_MODE=y
CONFIG_BATTERY_SWELLING=y
CONFIG_CHARGER_SM5705=y
CONFIG_FUELGAUGE_SM5705=y
CONFIG_BATTERY_AGE_FORECAST=y
# CONFIG_UPDATE_BATTERY_DATA is not set
CONFIG_BATTERY_CISD=y
CONFIG_SEC_ABC=y
CONFIG_SEC_MPP_SHARE=y

#MUIC configs
CONFIG_MFD_CORE=y
CONFIG_USE_MUIC=y
#CONFIG_MUIC_SUPPORT_CCIC=y
CONFIG_MUIC_NOTIFIER=y
CONFIG_VBUS_NOTIFIER=y
CONFIG_VBUS_NOTIFIER_WORK=y
#CONFIG_MUIC_HV=y is not set
CONFIG_UART3=y

# Audio
CONFIG_SAMSUNG_JACK=y
CONFIG_SND_SOC_TFA9872=y
CONFIG_SEC_SND_TFA98XX=y

#MUIC-SM5705

CONFIG_MFD_SM5705=y
CONFIG_MUIC_UNIVERSAL=y
CONFIG_MUIC_UNIVERSAL_SM5705=y
CONFIG_MUIC_UNIVERSAL_SM5705_AFC=y
CONFIG_MUIC_SM5705_SWITCH_CONTROL_GPIO=y
CONFIG_MUIC_PINCTRL=y
CONFIG_MUIC_UNIVERSAL_MULTI_SUPPORT=y

#
# TSP
#
CONFIG_TOUCHSCREEN_SEC_TS=y

# SD card
CONFIG_SEC_HYBRID_TRAY=y

#MOTOR
CONFIG_MSM_VIBRATOR=y

#GPIO EXPANDER
CONFIG_GPIO_PCAL6416A=y

#HALL
CONFIG_SENSORS_HALL=y

#NFC
CONFIG_SAMSUNG_NFC=y
CONFIG_SEC_NFC=y

# SSWAP
CONFIG_SWAP=y
CONFIG_FRONTSWAP=y
CONFIG_ZSMALLOC=y
CONFIG_ZSMALLOC_STAT=y
CONFIG_ZSMALLOC_OBJ_SEQ=n
CONFIG_PGTABLE_MAPPING=y
CONFIG_ZSWAP=y
CONFIG_ZSWAP_COMPACTION=y
CONFIG_ZSWAP_ENABLE_WRITEBACK=n
CONFIG_ZPOOL=y
CONFIG_DIRECT_RECLAIM_FILE_PAGES_ONLY=y
CONFIG_INCREASE_MAXIMUM_SWAPPINESS=y
CONFIG_FIX_INACTIVE_RATIO=y
CONFIG_TIGHT_PGDAT_BALANCE=y
CONFIG_VNSWAP=y
CONFIG_SWAP_ENABLE_READAHEAD=n
```
